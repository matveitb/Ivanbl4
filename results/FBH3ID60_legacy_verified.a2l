ASAP2_VERSION 1 51
/begin PROJECT FBH3ID60 "Bosch M7.9.7 C167"
/begin HEADER "Kia Spectra 1.6 FBH3ID60" VERSION "1.0" /end HEADER
/begin MODULE FBH3ID60_MOD "Bosch M7.9.7"
/begin MOD_COMMON "little endian, alignment 1" BYTE_ORDER MSB_LAST ALIGNMENT_BYTE 1 ALIGNMENT_WORD 1 ALIGNMENT_LONG 1 /end MOD_COMMON
/begin COMPU_METHOD CM_IDENTITY "raw values" RAT_FUNC "%.3f" "" COEFFS 0 1 0 0 0 1 /end COMPU_METHOD
/begin COMPU_METHOD CM_40_0_rpm "scale 40" RAT_FUNC "%.1f" "rpm" COEFFS 0 1 0 0 0 40 /end COMPU_METHOD
/begin COMPU_METHOD CM_0p75_0 "scale 0.75" RAT_FUNC "%.3f" "%" COEFFS 0 1 0 0 0 0.75 /end COMPU_METHOD
/begin COMPU_METHOD CM_0p0234375_0 "scale 0.0234375" RAT_FUNC "%.3f" "%" COEFFS 0 1 0 0 0 0.0234375 /end COMPU_METHOD
/begin COMPU_METHOD CM_0p75_48_GradC "scale 0.75" RAT_FUNC "%.3f" "Grad C" COEFFS 0 1 48 0 0 0.75 /end COMPU_METHOD
/begin COMPU_METHOD CM_4_0_kgh "scale 4" RAT_FUNC "%.1f" "kg/h" COEFFS 0 1 0 0 0 4 /end COMPU_METHOD
/begin COMPU_METHOD CM_100_0_Umins "scale 100" RAT_FUNC "%.1f" "U/min/s" COEFFS 0 1 0 0 0 100 /end COMPU_METHOD
/begin COMPU_METHOD CM_40_0_Upm "scale 40" RAT_FUNC "%.1f" "Upm" COEFFS 0 1 0 0 0 40 /end COMPU_METHOD
/begin COMPU_METHOD CM_0p0625_0 "scale 0.0625" RAT_FUNC "%.3f" "-" COEFFS 0 1 0 0 0 0.0625 /end COMPU_METHOD
/begin COMPU_METHOD CM_0p5_0 "scale 0.5" RAT_FUNC "%.3f" "%" COEFFS 0 1 0 0 0 0.5 /end COMPU_METHOD
/begin COMPU_METHOD CM_0p390625_0 "scale 0.390625" RAT_FUNC "%.3f" "%" COEFFS 0 1 0 0 0 0.390625 /end COMPU_METHOD
/begin COMPU_METHOD CM_0p75_0_gradKW "scale 0.75" RAT_FUNC "%.3f" "grad KW" COEFFS 0 1 0 0 0 0.75 /end COMPU_METHOD
/begin COMPU_METHOD CM_0p00390625_0_Umin "scale 0.00390625" RAT_FUNC "%.3f" "%/(U/min)" COEFFS 0 1 0 0 0 0.00390625 /end COMPU_METHOD
/begin COMPU_METHOD CM_0p217_0_ms2 "scale 0.217" RAT_FUNC "%.3f" "m/s^2" COEFFS 0 1 0 0 0 0.217 /end COMPU_METHOD
/begin COMPU_METHOD CM_0p09803921569_0 "scale 0.0980392" RAT_FUNC "%.3f" "" COEFFS 0 1 0 0 0 0.09803921569 /end COMPU_METHOD
/begin COMPU_METHOD CM_0p03125_0 "scale 0.03125" RAT_FUNC "%.3f" "-" COEFFS 0 1 0 0 0 0.03125 /end COMPU_METHOD
/begin COMPU_METHOD CM_0p0078125_0 "scale 0.0078125" RAT_FUNC "%.3f" "-" COEFFS 0 1 0 0 0 0.0078125 /end COMPU_METHOD
/begin COMPU_METHOD CM_0p1_0_ms "scale 0.1" RAT_FUNC "%.3f" "ms" COEFFS 0 1 0 0 0 0.1 /end COMPU_METHOD
/begin COMPU_METHOD CM_10_0_Umin "scale 10" RAT_FUNC "%.1f" "U/min" COEFFS 0 1 0 0 0 10 /end COMPU_METHOD
/begin COMPU_METHOD CM_0p3906_0 "scale 0.3906" RAT_FUNC "%.3f" "%" COEFFS 0 1 0 0 0 0.3906 /end COMPU_METHOD
/begin COMPU_METHOD CM_n0p00048828125_0_sUmin "scale -0.000488281" RAT_FUNC "%.3f" "(%*s)/(U/min)" COEFFS 0 1 0 0 0 -0.00048828125 /end COMPU_METHOD
/begin COMPU_METHOD CM_0p00390625_0 "scale 0.00390625" RAT_FUNC "%.3f" "-" COEFFS 0 1 0 0 0 0.00390625 /end COMPU_METHOD
/begin COMPU_METHOD CM_0p0023828125_0_sUmin "scale 0.00238281" RAT_FUNC "%.3f" "%/(s*U/min)" COEFFS 0 1 0 0 0 0.0023828125 /end COMPU_METHOD
/begin COMPU_METHOD CM_0p001525878906_0 "scale 0.00152588" RAT_FUNC "%.3f" "-" COEFFS 0 1 0 0 0 0.001525878906 /end COMPU_METHOD
/begin COMPU_METHOD CM_0p02_0_s "scale 0.02" RAT_FUNC "%.3f" "s" COEFFS 0 1 0 0 0 0.02 /end COMPU_METHOD
/begin COMPU_METHOD CM_0p001953125_n0p75 "scale 0.00195312" RAT_FUNC "%.3f" "" COEFFS 0 1 -0.75 0 0 0.001953125 /end COMPU_METHOD
/begin COMPU_METHOD CM_0p25_0_Umin "scale 0.25" RAT_FUNC "%.3f" "U/min" COEFFS 0 1 0 0 0 0.25 /end COMPU_METHOD
/begin COMPU_METHOD CM_0p78_0 "scale 0.78" RAT_FUNC "%.3f" "%" COEFFS 0 1 0 0 0 0.78 /end COMPU_METHOD
/begin COMPU_METHOD CM_0p0001220703125_0 "scale 0.00012207" RAT_FUNC "%.3f" "-" COEFFS 0 1 0 0 0 0.0001220703125 /end COMPU_METHOD
/begin COMPU_METHOD CM_0p09375_0 "scale 0.09375" RAT_FUNC "%.3f" "%" COEFFS 0 1 0 0 0 0.09375 /end COMPU_METHOD
/begin COMPU_METHOD CM_0p002666666667_0_ms "scale 0.00266667" RAT_FUNC "%.3f" "ms" COEFFS 0 1 0 0 0 0.002666666667 /end COMPU_METHOD
/begin COMPU_METHOD CM_0p046875_0 "scale 0.046875" RAT_FUNC "%.3f" "%" COEFFS 0 1 0 0 0 0.046875 /end COMPU_METHOD
/begin COMPU_METHOD CM_3p2_0_kgh "scale 3.2" RAT_FUNC "%.1f" "kg/h" COEFFS 0 1 0 0 0 3.2 /end COMPU_METHOD
/begin COMPU_METHOD CM_1p525878906En05_0 "scale 1.52588e-05" RAT_FUNC "%.3f" "-" COEFFS 0 1 0 0 0 1.525878906e-05 /end COMPU_METHOD
/begin COMPU_METHOD CM_3p051757812En05_0 "scale 3.05176e-05" RAT_FUNC "%.3f" "-" COEFFS 0 1 0 0 0 3.051757812e-05 /end COMPU_METHOD
/begin COMPU_METHOD CM_0p3921568627_0_DK "scale 0.392157" RAT_FUNC "%.3f" "% DK" COEFFS 0 1 0 0 0 0.3921568627 /end COMPU_METHOD
/begin COMPU_METHOD CM_5_50_GradC "scale 5" RAT_FUNC "%.1f" "Grad C" COEFFS 0 1 50 0 0 5 /end COMPU_METHOD
/begin COMPU_METHOD CM_0p01220703125_0_Upm "scale 0.012207" RAT_FUNC "%.3f" "%/Upm" COEFFS 0 1 0 0 0 0.01220703125 /end COMPU_METHOD
/begin COMPU_METHOD CM_0p01_0_s "scale 0.01" RAT_FUNC "%.3f" "s" COEFFS 0 1 0 0 0 0.01 /end COMPU_METHOD
/begin COMPU_METHOD CM_0p09764705882_0 "scale 0.0976471" RAT_FUNC "%.3f" "%" COEFFS 0 1 0 0 0 0.09764705882 /end COMPU_METHOD
/begin COMPU_METHOD CM_0p1960784314_0 "scale 0.196078" RAT_FUNC "%.3f" "%" COEFFS 0 1 0 0 0 0.1960784314 /end COMPU_METHOD
/begin COMPU_METHOD CM_0p1_0_s "scale 0.1" RAT_FUNC "%.3f" "s" COEFFS 0 1 0 0 0 0.1 /end COMPU_METHOD
/begin COMPU_METHOD CM_5_0_GradC "scale 5" RAT_FUNC "%.1f" "Grad C" COEFFS 0 1 0 0 0 5 /end COMPU_METHOD
/begin COMPU_METHOD CM_0p25_0 "scale 0.25" RAT_FUNC "%.3f" "-" COEFFS 0 1 0 0 0 0.25 /end COMPU_METHOD
/begin COMPU_METHOD CM_0p3058103976_0_s "scale 0.30581" RAT_FUNC "%.3f" "%/s" COEFFS 0 1 0 0 0 0.3058103976 /end COMPU_METHOD
/begin COMPU_METHOD CM_0p048828125_0 "scale 0.0488281" RAT_FUNC "%.3f" "%" COEFFS 0 1 0 0 0 0.048828125 /end COMPU_METHOD
/begin COMPU_METHOD CM_0p02275555556_0_kg "scale 0.0227556" RAT_FUNC "%.3f" "kg" COEFFS 0 1 0 0 0 0.02275555556 /end COMPU_METHOD
/begin COMPU_METHOD CM_1_n1 "scale 1" RAT_FUNC "%.1f" "-" COEFFS 0 1 -1 0 0 1 /end COMPU_METHOD
/begin COMPU_METHOD CM_n0p75_0_gradKW "scale -0.75" RAT_FUNC "%.3f" "grad KW" COEFFS 0 1 0 0 0 -0.75 /end COMPU_METHOD
/begin COMPU_METHOD CM_6_0_GradKW "scale 6" RAT_FUNC "%.1f" "Grad KW" COEFFS 0 1 0 0 0 6 /end COMPU_METHOD
/begin COMPU_METHOD CM_0p015625_0 "scale 0.015625" RAT_FUNC "%.3f" "-" COEFFS 0 1 0 0 0 0.015625 /end COMPU_METHOD
/begin COMPU_METHOD CM_0p001953125_0 "scale 0.00195312" RAT_FUNC "%.3f" "-" COEFFS 0 1 0 0 0 0.001953125 /end COMPU_METHOD
/begin COMPU_METHOD CM_4p768359375En05_0_1s "scale 4.76836e-05" RAT_FUNC "%.3f" "1/s" COEFFS 0 1 0 0 0 4.768359375e-05 /end COMPU_METHOD
/begin COMPU_METHOD CM_0p5_0_ms "scale 0.5" RAT_FUNC "%.3f" "ms" COEFFS 0 1 0 0 0 0.5 /end COMPU_METHOD
/begin COMPU_METHOD CM_20_0_s "scale 20" RAT_FUNC "%.1f" "s" COEFFS 0 1 0 0 0 20 /end COMPU_METHOD
/begin COMPU_METHOD CM_0p09103840683_0_kg "scale 0.0910384" RAT_FUNC "%.3f" "kg" COEFFS 0 1 0 0 0 0.09103840683 /end COMPU_METHOD
/begin COMPU_METHOD CM_0p000244140625_0 "scale 0.000244141" RAT_FUNC "%.3f" "-" COEFFS 0 1 0 0 0 0.000244140625 /end COMPU_METHOD
/begin COMPU_METHOD CM_0p1_0_kgh "scale 0.1" RAT_FUNC "%.3f" "kg/h" COEFFS 0 1 0 0 0 0.1 /end COMPU_METHOD
/begin COMPU_METHOD CM_0p003051757812_0 "scale 0.00305176" RAT_FUNC "%.3f" "%" COEFFS 0 1 0 0 0 0.003051757812 /end COMPU_METHOD
/begin COMPU_METHOD CM_0p0390625_0_hPa "scale 0.0390625" RAT_FUNC "%.3f" "hPa" COEFFS 0 1 0 0 0 0.0390625 /end COMPU_METHOD
/begin COMPU_METHOD CM_0p125_0 "scale 0.125" RAT_FUNC "%.3f" "-" COEFFS 0 1 0 0 0 0.125 /end COMPU_METHOD
/begin COMPU_METHOD CM_0p25_0_obmin "scale 0.25" RAT_FUNC "%.3f" "ob/min" COEFFS 0 1 0 0 0 0.25 /end COMPU_METHOD
/begin COMPU_METHOD CM_0p392157_0 "scale 0.392157" RAT_FUNC "%.3f" "%" COEFFS 0 1 0 0 0 0.392157 /end COMPU_METHOD
/begin COMPU_METHOD CM_0p001779359431_0_ms "scale 0.00177936" RAT_FUNC "%.3f" "ms/%" COEFFS 0 1 0 0 0 0.001779359431 /end COMPU_METHOD
/begin COMPU_METHOD CM_0p01953125_0_V "scale 0.0195312" RAT_FUNC "%.3f" "V" COEFFS 0 1 0 0 0 0.01953125 /end COMPU_METHOD
/begin COMPU_METHOD CM_0p75_0_GradKW "scale 0.75" RAT_FUNC "%.3f" "Grad KW" COEFFS 0 1 0 0 0 0.75 /end COMPU_METHOD
/begin COMPU_METHOD CM_0p00048828125_0 "scale 0.000488281" RAT_FUNC "%.3f" "-" COEFFS 0 1 0 0 0 0.00048828125 /end COMPU_METHOD
/begin COMPU_METHOD CM_0p00152588_0_otopornogomoment "scale 0.00152588" RAT_FUNC "%.3f" "% ot opornogo momenta" COEFFS 0 1 0 0 0 0.00152588 /end COMPU_METHOD
/begin COMPU_METHOD CM_0p0234375_0_napolneniya "scale 0.0234375" RAT_FUNC "%.3f" "% napolneniya" COEFFS 0 1 0 0 0 0.0234375 /end COMPU_METHOD
/begin COMPU_METHOD CM_0p001525878906_0_momenta "scale 0.00152588" RAT_FUNC "%.3f" "% momenta" COEFFS 0 1 0 0 0 0.001525878906 /end COMPU_METHOD
/begin COMPU_METHOD CM_0p001525878906_0_otopornogomo "scale 0.00152588" RAT_FUNC "%.3f" "% ot opornogo momenta" COEFFS 0 1 0 0 0 0.001525878906 /end COMPU_METHOD
/begin COMPU_METHOD CM_0p0078125_0_lambda "scale 0.0078125" RAT_FUNC "%.3f" "lambda" COEFFS 0 1 0 0 0 0.0078125 /end COMPU_METHOD
/begin COMPU_METHOD CM_n0p75_0_KV "scale -0.75" RAT_FUNC "%.3f" "KV" COEFFS 0 1 0 0 0 -0.75 /end COMPU_METHOD
/begin COMPU_METHOD CM_40_0_obmin "scale 40" RAT_FUNC "%.1f" "ob/min" COEFFS 0 1 0 0 0 40 /end COMPU_METHOD
/begin COMPU_METHOD CM_5_n50_C "scale 5" RAT_FUNC "%.1f" "C" COEFFS 0 1 -50 0 0 5 /end COMPU_METHOD
/begin COMPU_METHOD CM_0p005215686275_0p2_V "scale 0.00521569" RAT_FUNC "%.3f" "V" COEFFS 0 1 0.2 0 0 0.005215686275 /end COMPU_METHOD
/begin COMPU_METHOD CM_0p52_0_mVms "scale 0.52" RAT_FUNC "%.3f" "mV/ms" COEFFS 0 1 0 0 0 0.52 /end COMPU_METHOD
/begin COMPU_METHOD CM_0p09362_0_1V "scale 0.09362" RAT_FUNC "%.3f" "1/V" COEFFS 0 1 0 0 0 0.09362 /end COMPU_METHOD
/begin COMPU_METHOD CM_0p005215686275_0_V "scale 0.00521569" RAT_FUNC "%.3f" "V" COEFFS 0 1 0 0 0 0.005215686275 /end COMPU_METHOD
/begin COMPU_METHOD CM_0p8695652174_0_mg "scale 0.869565" RAT_FUNC "%.3f" "mg" COEFFS 0 1 0 0 0 0.8695652174 /end COMPU_METHOD
/begin COMPU_METHOD CM_0p8695652174_0_mgs "scale 0.869565" RAT_FUNC "%.3f" "mg/s" COEFFS 0 1 0 0 0 0.8695652174 /end COMPU_METHOD
/begin COMPU_METHOD CM_0p05_0_s "scale 0.05" RAT_FUNC "%.3f" "s" COEFFS 0 1 0 0 0 0.05 /end COMPU_METHOD
/begin COMPU_METHOD CM_0p01_0 "scale 0.01" RAT_FUNC "%.3f" "-" COEFFS 0 1 0 0 0 0.01 /end COMPU_METHOD
/begin COMPU_METHOD CM_0p01_0p05_s "scale 0.01" RAT_FUNC "%.3f" "s" COEFFS 0 1 0.05 0 0 0.01 /end COMPU_METHOD
/begin COMPU_METHOD CM_0p0704_0_V "scale 0.0704" RAT_FUNC "%.3f" "V" COEFFS 0 1 0 0 0 0.0704 /end COMPU_METHOD
/begin COMPU_METHOD CM_0p02392578125_0_1s "scale 0.0239258" RAT_FUNC "%.3f" "1/s" COEFFS 0 1 0 0 0 0.02392578125 /end COMPU_METHOD
/begin COMPU_METHOD CM_0p0444_0_g "scale 0.0444" RAT_FUNC "%.3f" "g" COEFFS 0 1 0 0 0 0.0444 /end COMPU_METHOD
/begin COMPU_METHOD CM_0p2_0_s "scale 0.2" RAT_FUNC "%.3f" "s" COEFFS 0 1 0 0 0 0.2 /end COMPU_METHOD
/begin COMPU_METHOD CM_1p25_0_kmh "scale 1.25" RAT_FUNC "%.1f" "km/h" COEFFS 0 1 0 0 0 1.25 /end COMPU_METHOD
/begin COMPU_METHOD CM_7p8125En06_0_kgh1min "scale 7.8125e-06" RAT_FUNC "%.3f" "(kg/h)/(1/min)/%" COEFFS 0 1 0 0 0 7.8125e-06 /end COMPU_METHOD
/begin COMPU_METHOD CM_0p00078125_0 "scale 0.00078125" RAT_FUNC "%.3f" "" COEFFS 0 1 0 0 0 0.00078125 /end COMPU_METHOD
/begin COMPU_METHOD CM_0p001525878906_0_ugladrossely "scale 0.00152588" RAT_FUNC "%.3f" "% ugla drosselya" COEFFS 0 1 0 0 0 0.001525878906 /end COMPU_METHOD
/begin COMPU_METHOD CM_0p01219512195_0_ugoldrosselya "scale 0.0121951" RAT_FUNC "%.3f" "ugol drosselya, grad" COEFFS 0 1 0 0 0 0.01219512195 /end COMPU_METHOD
/begin COMPU_METHOD CM_0p0078125_0_mnozhitel "scale 0.0078125" RAT_FUNC "%.3f" "mnozhitel" COEFFS 0 1 0 0 0 0.0078125 /end COMPU_METHOD
/begin COMPU_METHOD CM_0p0009765625_0 "scale 0.000976562" RAT_FUNC "%.3f" "-" COEFFS 0 1 0 0 0 0.0009765625 /end COMPU_METHOD
/begin COMPU_METHOD CM_0p0026666667_0_ms "scale 0.00266667" RAT_FUNC "%.3f" "ms" COEFFS 0 1 0 0 0 0.0026666667 /end COMPU_METHOD
/begin COMPU_METHOD CM_0p75_0_K "scale 0.75" RAT_FUNC "%.3f" "K" COEFFS 0 1 0 0 0 0.75 /end COMPU_METHOD
/begin COMPU_METHOD CM_0p25_0_rpm "scale 0.25" RAT_FUNC "%.3f" "rpm" COEFFS 0 1 0 0 0 0.25 /end COMPU_METHOD
/begin COMPU_METHOD CM_0p5_0_GradKW "scale 0.5" RAT_FUNC "%.3f" "Grad KW" COEFFS 0 1 0 0 0 0.5 /end COMPU_METHOD
/begin COMPU_METHOD CM_4p577636719En06_0_hPa "scale 4.57764e-06" RAT_FUNC "%.3f" "%/hPa" COEFFS 0 1 0 0 0 4.577636719e-06 /end COMPU_METHOD
/begin RECORD_LAYOUT RL_AXIS_U8 NO_AXIS_PTS_X 1 UBYTE AXIS_PTS_X 2 UBYTE INDEX_INCR DIRECT /end RECORD_LAYOUT
/begin RECORD_LAYOUT RL_AXIS_U16 NO_AXIS_PTS_X 1 UWORD AXIS_PTS_X 2 UWORD INDEX_INCR DIRECT /end RECORD_LAYOUT
/begin RECORD_LAYOUT RL_GRID_UBYTE FNC_VALUES 1 UBYTE ROW_DIR DIRECT /end RECORD_LAYOUT
/begin RECORD_LAYOUT RL_GRID_SBYTE FNC_VALUES 1 SBYTE ROW_DIR DIRECT /end RECORD_LAYOUT
/begin RECORD_LAYOUT RL_3D_A8_UBYTE NO_AXIS_PTS_Y 1 UBYTE NO_AXIS_PTS_X 2 UBYTE AXIS_PTS_Y 3 UBYTE INDEX_INCR DIRECT AXIS_PTS_X 4 UBYTE INDEX_INCR DIRECT FNC_VALUES 5 UBYTE ROW_DIR DIRECT /end RECORD_LAYOUT
/begin RECORD_LAYOUT RL_2D_A8_UBYTE NO_AXIS_PTS_X 1 UBYTE AXIS_PTS_X 2 UBYTE INDEX_INCR DIRECT FNC_VALUES 3 UBYTE ROW_DIR DIRECT /end RECORD_LAYOUT
/begin RECORD_LAYOUT RL_3D_A8_UWORD NO_AXIS_PTS_Y 1 UBYTE NO_AXIS_PTS_X 2 UBYTE AXIS_PTS_Y 3 UBYTE INDEX_INCR DIRECT AXIS_PTS_X 4 UBYTE INDEX_INCR DIRECT FNC_VALUES 5 UWORD ROW_DIR DIRECT /end RECORD_LAYOUT
/begin RECORD_LAYOUT RL_2D_A16_UWORD NO_AXIS_PTS_X 1 UBYTE AXIS_PTS_X 2 UWORD INDEX_INCR DIRECT FNC_VALUES 3 UWORD ROW_DIR DIRECT /end RECORD_LAYOUT
/begin RECORD_LAYOUT RL_2D_A8_UWORD NO_AXIS_PTS_X 1 UBYTE AXIS_PTS_X 2 UBYTE INDEX_INCR DIRECT FNC_VALUES 3 UWORD ROW_DIR DIRECT /end RECORD_LAYOUT
/begin RECORD_LAYOUT RL_3D_A8_SBYTE NO_AXIS_PTS_Y 1 UBYTE NO_AXIS_PTS_X 2 UBYTE AXIS_PTS_Y 3 UBYTE INDEX_INCR DIRECT AXIS_PTS_X 4 UBYTE INDEX_INCR DIRECT FNC_VALUES 5 SBYTE ROW_DIR DIRECT /end RECORD_LAYOUT
/begin RECORD_LAYOUT RL_GRID_UWORD FNC_VALUES 1 UWORD ROW_DIR DIRECT /end RECORD_LAYOUT
/begin RECORD_LAYOUT RL_GRID_SWORD FNC_VALUES 1 SWORD ROW_DIR DIRECT /end RECORD_LAYOUT
/begin RECORD_LAYOUT RL_2D_A16_UBYTE NO_AXIS_PTS_X 1 UBYTE AXIS_PTS_X 2 UWORD INDEX_INCR DIRECT FNC_VALUES 3 UBYTE ROW_DIR DIRECT /end RECORD_LAYOUT
/begin RECORD_LAYOUT RL_AXIS_BARE_UBYTE AXIS_PTS_X 1 UBYTE INDEX_INCR DIRECT /end RECORD_LAYOUT
/begin RECORD_LAYOUT RL_AXIS_BARE_UWORD AXIS_PTS_X 1 UWORD INDEX_INCR DIRECT /end RECORD_LAYOUT
/begin AXIS_PTS SNM16_ZU "engine speed, 16 points" 0x10103 NO_INPUT_QUANTITY RL_AXIS_U8 0 CM_40_0_rpm 16 0 10200 /end AXIS_PTS
/begin AXIS_PTS SNM16_OP "engine speed for KFZWOP, 16 points" 0x100F2 NO_INPUT_QUANTITY RL_AXIS_U8 0 CM_40_0_rpm 16 0 10200 /end AXIS_PTS
/begin AXIS_PTS SRL12_ZU "relative load, 12 points" 0x10157 NO_INPUT_QUANTITY RL_AXIS_U8 0 CM_0p75_0 12 0 191.25 /end AXIS_PTS
/begin AXIS_PTS SRL11_OP "relative load for KFZWOP, 11 points" 0x14B70 NO_INPUT_QUANTITY RL_AXIS_U16 0 CM_0p0234375_0 11 0 1535.98 /end AXIS_PTS
/begin AXIS_PTS SNM16_GK "engine speed for KFLBTS, 16 points" 0x181F7 NO_INPUT_QUANTITY RL_AXIS_U8 0 CM_40_0_rpm 16 0 10200 /end AXIS_PTS
/begin AXIS_PTS SRL12_GK "relative load for KFLBTS, 12 points" 0x1821E NO_INPUT_QUANTITY RL_AXIS_U8 0 CM_0p75_0 12 0 191.25 /end AXIS_PTS
/begin AXIS_PTS SNM08_KO "engine speed for A/C compressor, 8 points" 0x119D9 NO_INPUT_QUANTITY RL_AXIS_U8 0 CM_40_0_rpm 8 0 10200 /end AXIS_PTS
/begin AXIS_PTS SNM08_WE "engine speed for KFWEE, 8 points" 0x19078 NO_INPUT_QUANTITY RL_AXIS_U8 0 CM_40_0_rpm 8 0 10200 /end AXIS_PTS
/begin AXIS_PTS SRL08_WE "relative load for KFWEE, 8 points" 0x19081 NO_INPUT_QUANTITY RL_AXIS_U8 0 CM_0p75_0 8 0 191.25 /end AXIS_PTS
/begin AXIS_PTS SNM06_DM "engine speed for KFDMDFA, 6 points" 0x181DD NO_INPUT_QUANTITY RL_AXIS_U8 0 CM_40_0_rpm 6 0 10200 /end AXIS_PTS
/begin AXIS_PTS SNM07_WF "engine speed for wall film maps, 7 points" 0x181E4 NO_INPUT_QUANTITY RL_AXIS_U8 0 CM_40_0_rpm 7 0 10200 /end AXIS_PTS
/begin AXIS_PTS STM09_WF "coolant temperature for wall film maps, 9 points" 0x18273 NO_INPUT_QUANTITY RL_AXIS_U8 0 CM_0p75_48_GradC 9 48 191.25 /end AXIS_PTS
/begin AXIS_PTS AX_18FCB_Y "rpm" 0x18FCB NO_INPUT_QUANTITY RL_AXIS_BARE_UBYTE 0 CM_40_0_rpm 6 -0 10200 /end AXIS_PTS
/begin AXIS_PTS AX_18FD8_Y "rpm" 0x18FD8 NO_INPUT_QUANTITY RL_AXIS_BARE_UBYTE 0 CM_40_0_rpm 6 -0 10200 /end AXIS_PTS
/begin AXIS_PTS AX_18FE5_Y "rpm" 0x18FE5 NO_INPUT_QUANTITY RL_AXIS_BARE_UBYTE 0 CM_40_0_rpm 6 -0 10200 /end AXIS_PTS
/begin AXIS_PTS AX_1955C_Y "rpm" 0x1955C NO_INPUT_QUANTITY RL_AXIS_BARE_UBYTE 0 CM_40_0_rpm 6 -0 10200 /end AXIS_PTS
/begin AXIS_PTS AX_19569_Y "rpm" 0x19569 NO_INPUT_QUANTITY RL_AXIS_BARE_UBYTE 0 CM_40_0_rpm 6 -0 10200 /end AXIS_PTS
/begin AXIS_PTS AX_18AC1_Y "Grad C" 0x18AC1 NO_INPUT_QUANTITY RL_AXIS_BARE_UBYTE 0 CM_0p75_48_GradC 8 -48 143.25 /end AXIS_PTS
/begin AXIS_PTS AX_18AD2_Y "rpm" 0x18AD2 NO_INPUT_QUANTITY RL_AXIS_BARE_UBYTE 0 CM_40_0_rpm 8 -0 10200 /end AXIS_PTS
/begin AXIS_PTS AX_14BE0_X "% momenta" 0x14BE0 NO_INPUT_QUANTITY RL_AXIS_BARE_UWORD 0 CM_0p001525878906_0_momenta 12 -0 99.9985 /end AXIS_PTS
/begin AXIS_PTS AX_14BC0_Y "ob/min" 0x14BC0 NO_INPUT_QUANTITY RL_AXIS_BARE_UWORD 0 CM_0p25_0_obmin 16 -0 16383.8 /end AXIS_PTS
/begin AXIS_PTS AX_1512A_X "% napolneniya" 0x1512A NO_INPUT_QUANTITY RL_AXIS_BARE_UWORD 0 CM_0p0234375_0_napolneniya 12 -0 1535.98 /end AXIS_PTS
/begin AXIS_PTS AX_15116_Y "ob/min" 0x15116 NO_INPUT_QUANTITY RL_AXIS_BARE_UWORD 0 CM_0p25_0_obmin 10 -0 16383.8 /end AXIS_PTS
/begin AXIS_PTS AX_10515_Y "lambda" 0x10515 NO_INPUT_QUANTITY RL_AXIS_BARE_UBYTE 0 CM_0p0078125_0_lambda 10 -0 1.99219 /end AXIS_PTS
/begin AXIS_PTS AX_19516_Y "rpm" 0x19516 NO_INPUT_QUANTITY RL_AXIS_BARE_UBYTE 0 CM_40_0_rpm 10 -0 10200 /end AXIS_PTS
/begin AXIS_PTS AX_11581_Y "rpm" 0x11581 NO_INPUT_QUANTITY RL_AXIS_BARE_UBYTE 0 CM_40_0_rpm 6 -0 10200 /end AXIS_PTS
/begin AXIS_PTS AX_15688_X "% ugla drosselya" 0x15688 NO_INPUT_QUANTITY RL_AXIS_BARE_UWORD 0 CM_IDENTITY 6 -0 65535 /end AXIS_PTS
/begin AXIS_PTS AX_15668_Y "pspvdk" 0x15668 NO_INPUT_QUANTITY RL_AXIS_BARE_UWORD 0 CM_IDENTITY 16 -0 65535 /end AXIS_PTS
/begin AXIS_PTS AX_1AC92_X "ob/min" 0x1AC92 NO_INPUT_QUANTITY RL_AXIS_BARE_UWORD 0 CM_0p25_0_obmin 12 -0 16383.8 /end AXIS_PTS
/begin AXIS_PTS AX_1AC7A_Y "ugol drosselya, grad" 0x1AC7A NO_INPUT_QUANTITY RL_AXIS_BARE_UWORD 0 CM_0p01219512195_0_ugoldrosselya 12 -0 799.207 /end AXIS_PTS
/begin AXIS_PTS AX_11A2F_Y "Grad C" 0x11A2F NO_INPUT_QUANTITY RL_AXIS_BARE_UBYTE 0 CM_0p75_48_GradC 6 -48 143.25 /end AXIS_PTS
/begin AXIS_PTS AX_11699_Y "Grad C" 0x11699 NO_INPUT_QUANTITY RL_AXIS_BARE_UBYTE 0 CM_0p75_48_GradC 12 -48 143.25 /end AXIS_PTS
/begin AXIS_PTS AX_1168C_Y "Grad C" 0x1168C NO_INPUT_QUANTITY RL_AXIS_BARE_UBYTE 0 CM_0p75_48_GradC 6 -48 143.25 /end AXIS_PTS
/begin AXIS_PTS AX_116BA_X "-" 0x116BA NO_INPUT_QUANTITY RL_AXIS_BARE_UBYTE 0 CM_IDENTITY 6 -0 255 /end AXIS_PTS
/begin AXIS_PTS AX_116B4_Y "Grad C" 0x116B4 NO_INPUT_QUANTITY RL_AXIS_BARE_UBYTE 0 CM_0p75_48_GradC 6 -48 143.25 /end AXIS_PTS
/begin AXIS_PTS AX_1170C_X "-" 0x1170C NO_INPUT_QUANTITY RL_AXIS_BARE_UBYTE 0 CM_IDENTITY 6 -0 255 /end AXIS_PTS
/begin AXIS_PTS AX_11700_Y "Grad C" 0x11700 NO_INPUT_QUANTITY RL_AXIS_BARE_UBYTE 0 CM_0p75_48_GradC 12 -48 143.25 /end AXIS_PTS
/begin AXIS_PTS AX_116EA_X "rpm" 0x116EA NO_INPUT_QUANTITY RL_AXIS_BARE_UBYTE 0 CM_40_0_rpm 4 -0 10200 /end AXIS_PTS
/begin AXIS_PTS AX_116E6_Y "Grad C" 0x116E6 NO_INPUT_QUANTITY RL_AXIS_BARE_UBYTE 0 CM_0p75_48_GradC 4 -48 143.25 /end AXIS_PTS
/begin AXIS_PTS AX_15F74_X "Grad C" 0x15F74 NO_INPUT_QUANTITY RL_AXIS_BARE_UBYTE 0 CM_0p75_48_GradC 4 -48 143.25 /end AXIS_PTS
/begin AXIS_PTS AX_15F6C_Y "-" 0x15F6C NO_INPUT_QUANTITY RL_AXIS_BARE_UWORD 0 CM_IDENTITY 4 -0 65535 /end AXIS_PTS
/begin AXIS_PTS AX_1B674_X "ms" 0x1B674 NO_INPUT_QUANTITY RL_AXIS_BARE_UWORD 0 CM_0p0026666667_0_ms 16 -0 174.76 /end AXIS_PTS
/begin AXIS_PTS AX_1B664_Y "rpm" 0x1B664 NO_INPUT_QUANTITY RL_AXIS_BARE_UBYTE 0 CM_40_0_rpm 16 -0 10200 /end AXIS_PTS
/begin AXIS_PTS AX_1827E_X "Grad C" 0x1827E NO_INPUT_QUANTITY RL_AXIS_BARE_UBYTE 0 CM_0p75_48_GradC 12 -48 143.25 /end AXIS_PTS
/begin AXIS_PTS AX_10176_Y "Grad C" 0x10176 NO_INPUT_QUANTITY RL_AXIS_BARE_UBYTE 0 CM_0p75_48_GradC 12 -48 143.25 /end AXIS_PTS
/begin AXIS_PTS AX_1AA40_X "rpm" 0x1AA40 NO_INPUT_QUANTITY RL_AXIS_BARE_UWORD 0 CM_0p25_0_rpm 10 -0 16383.8 /end AXIS_PTS
/begin AXIS_PTS AX_1AA36_Y "Grad KW" 0x1AA36 NO_INPUT_QUANTITY RL_AXIS_BARE_UBYTE 0 CM_0p5_0_GradKW 10 -0 127.5 /end AXIS_PTS
/begin AXIS_PTS AX_1AB28_X "rpm" 0x1AB28 NO_INPUT_QUANTITY RL_AXIS_BARE_UWORD 0 CM_0p25_0_rpm 10 -0 16383.8 /end AXIS_PTS
/begin AXIS_PTS AX_1AB1E_Y "Grad KW" 0x1AB1E NO_INPUT_QUANTITY RL_AXIS_BARE_UBYTE 0 CM_0p5_0_GradKW 10 -0 127.5 /end AXIS_PTS
/begin CHARACTERISTIC SNM05DKUB "podtverzhdena damos addr 0x1008D | base point distribution nmot" CURVE 0x1008D RL_GRID_UBYTE 0 CM_40_0_Upm 0 10200
 /begin AXIS_DESCR FIX_AXIS NO_INPUT_QUANTITY CM_IDENTITY 5 0 4 FIX_AXIS_PAR_DIST 0 1 5 /end AXIS_DESCR
/end CHARACTERISTIC
/begin CHARACTERISTIC SNM06LLUB "podtverzhdena damos addr 0x10093 | distribution of engine speed" CURVE 0x10093 RL_GRID_UBYTE 0 CM_40_0_Upm 0 10200
 /begin AXIS_DESCR FIX_AXIS NO_INPUT_QUANTITY CM_IDENTITY 6 0 5 FIX_AXIS_PAR_DIST 0 1 6 /end AXIS_DESCR
/end CHARACTERISTIC
/begin CHARACTERISTIC SNM07LRUB "podtverzhdena damos addr 0x1009A" CURVE 0x1009A RL_GRID_UBYTE 0 CM_40_0_Upm 0 10200
 /begin AXIS_DESCR FIX_AXIS NO_INPUT_QUANTITY CM_IDENTITY 7 0 6 FIX_AXIS_PAR_DIST 0 1 7 /end AXIS_DESCR
/end CHARACTERISTIC
/begin CHARACTERISTIC SNM08DMUB "podtverzhdena damos addr 0x100A2 | Datapoint distribution in DMD, 8 speed datapoints" CURVE 0x100A2 RL_GRID_UBYTE 0 CM_40_0_Upm 0 10200
 /begin AXIS_DESCR FIX_AXIS NO_INPUT_QUANTITY CM_IDENTITY 8 0 7 FIX_AXIS_PAR_DIST 0 1 8 /end AXIS_DESCR
/end CHARACTERISTIC
/begin CHARACTERISTIC SNM08LHUB "podtverzhdena damos addr 0x100AB | nmot dependet basic point (number 8)" CURVE 0x100AB RL_GRID_UBYTE 0 CM_40_0_Upm 0 10200
 /begin AXIS_DESCR FIX_AXIS NO_INPUT_QUANTITY CM_IDENTITY 8 0 7 FIX_AXIS_PAR_DIST 0 1 8 /end AXIS_DESCR
/end CHARACTERISTIC
/begin CHARACTERISTIC SNM08__UB "podtverzhdena damos addr 0x100B4 | Base point distribution engine speed, 8 base points" CURVE 0x100B4 RL_GRID_UBYTE 0 CM_40_0_Upm 0 10200
 /begin AXIS_DESCR FIX_AXIS NO_INPUT_QUANTITY CM_IDENTITY 8 0 7 FIX_AXIS_PAR_DIST 0 1 8 /end AXIS_DESCR
/end CHARACTERISTIC
/begin CHARACTERISTIC SNM10FEUB "podtverzhdena damos addr 0x100BD" CURVE 0x100BD RL_GRID_UBYTE 0 CM_40_0_Upm 0 10200
 /begin AXIS_DESCR FIX_AXIS NO_INPUT_QUANTITY CM_IDENTITY 10 0 9 FIX_AXIS_PAR_DIST 0 1 10 /end AXIS_DESCR
/end CHARACTERISTIC
/begin CHARACTERISTIC SNM12ESUB "podtverzhdena damos addr 0x100C8 | Distribution for the engine speed nmot" CURVE 0x100C8 RL_GRID_UBYTE 0 CM_40_0_Upm 0 10200
 /begin AXIS_DESCR FIX_AXIS NO_INPUT_QUANTITY CM_IDENTITY 12 0 11 FIX_AXIS_PAR_DIST 0 1 12 /end AXIS_DESCR
/end CHARACTERISTIC
/begin CHARACTERISTIC SNM12FEUB "podtverzhdena damos addr 0x100D5 | set points of WDKSMX, WDKUGDN" CURVE 0x100D5 RL_GRID_UBYTE 0 CM_40_0_Upm 0 10200
 /begin AXIS_DESCR FIX_AXIS NO_INPUT_QUANTITY CM_IDENTITY 12 0 11 FIX_AXIS_PAR_DIST 0 1 12 /end AXIS_DESCR
/end CHARACTERISTIC
/begin CHARACTERISTIC SNM16CIUB "podtverzhdena damos addr 0x100E2 | Base point distribution of engine speed, 16 base pts." CURVE 0x100E2 RL_GRID_UBYTE 0 CM_40_0_Upm 0 10200
 /begin AXIS_DESCR FIX_AXIS NO_INPUT_QUANTITY CM_IDENTITY 16 0 15 FIX_AXIS_PAR_DIST 0 1 16 /end AXIS_DESCR
/end CHARACTERISTIC
/begin CHARACTERISTIC SNM16OPUB "podtverzhdena damos addr 0x100F3" CURVE 0x100F3 RL_GRID_UBYTE 0 CM_40_0_Upm 0 10200
 /begin AXIS_DESCR FIX_AXIS NO_INPUT_QUANTITY CM_IDENTITY 16 0 15 FIX_AXIS_PAR_DIST 0 1 16 /end AXIS_DESCR
/end CHARACTERISTIC
/begin CHARACTERISTIC SNM16ZUUB "podtverzhdena damos addr 0x10104 | datapoint distribution engine speed, 16 datapoints" CURVE 0x10104 RL_GRID_UBYTE 0 CM_40_0_Upm 0 10200
 /begin AXIS_DESCR FIX_AXIS NO_INPUT_QUANTITY CM_IDENTITY 16 0 15 FIX_AXIS_PAR_DIST 0 1 16 /end AXIS_DESCR
/end CHARACTERISTIC
/begin CHARACTERISTIC SNM24ZUUB "podtverzhdena damos addr 0x10115 | datapoint distribution of engine speed, 24 datapoints" CURVE 0x10115 RL_GRID_UBYTE 0 CM_40_0_Upm 0 10200
 /begin AXIS_DESCR FIX_AXIS NO_INPUT_QUANTITY CM_IDENTITY 24 0 23 FIX_AXIS_PAR_DIST 0 1 24 /end AXIS_DESCR
/end CHARACTERISTIC
/begin CHARACTERISTIC SQM05TEUB "podtverzhdena damos addr 0x1012E | air mass quotient dependet basic point (number =5)" CURVE 0x1012E RL_GRID_UBYTE 0 CM_0p0625_0 0 15.9375
 /begin AXIS_DESCR FIX_AXIS NO_INPUT_QUANTITY CM_IDENTITY 5 0 4 FIX_AXIS_PAR_DIST 0 1 5 /end AXIS_DESCR
/end CHARACTERISTIC
/begin CHARACTERISTIC SRL06LHUB "podtverzhdena damos addr 0x10134" CURVE 0x10134 RL_GRID_UBYTE 0 CM_0p75_0 0 191.25
 /begin AXIS_DESCR FIX_AXIS NO_INPUT_QUANTITY CM_IDENTITY 6 0 5 FIX_AXIS_PAR_DIST 0 1 6 /end AXIS_DESCR
/end CHARACTERISTIC
/begin CHARACTERISTIC SRL06LRUB "podtverzhdena damos addr 0x1013B" CURVE 0x1013B RL_GRID_UBYTE 0 CM_0p75_0 0 191.25
 /begin AXIS_DESCR FIX_AXIS NO_INPUT_QUANTITY CM_IDENTITY 6 0 5 FIX_AXIS_PAR_DIST 0 1 6 /end AXIS_DESCR
/end CHARACTERISTIC
/begin CHARACTERISTIC SRL08DMUB "podtverzhdena damos addr 0x10142" CURVE 0x10142 RL_GRID_UBYTE 0 CM_0p75_0 0 191.25
 /begin AXIS_DESCR FIX_AXIS NO_INPUT_QUANTITY CM_IDENTITY 8 0 7 FIX_AXIS_PAR_DIST 0 1 8 /end AXIS_DESCR
/end CHARACTERISTIC
/begin CHARACTERISTIC SRL12ESUB "podtverzhdena damos addr 0x1014B | Distribution for the relative air charge rl" CURVE 0x1014B RL_GRID_UBYTE 0 CM_0p75_0 0 191.25
 /begin AXIS_DESCR FIX_AXIS NO_INPUT_QUANTITY CM_IDENTITY 12 0 11 FIX_AXIS_PAR_DIST 0 1 12 /end AXIS_DESCR
/end CHARACTERISTIC
/begin CHARACTERISTIC SRL12ZUUB "podtverzhdena damos addr 0x10158 | datapoint distribution relative air charge, 12 datapoints" CURVE 0x10158 RL_GRID_UBYTE 0 CM_0p75_0 0 191.25
 /begin AXIS_DESCR FIX_AXIS NO_INPUT_QUANTITY CM_IDENTITY 12 0 11 FIX_AXIS_PAR_DIST 0 1 12 /end AXIS_DESCR
/end CHARACTERISTIC
/begin CHARACTERISTIC SRL16ZUUB "podtverzhdena damos addr 0x10165 | datapoint distribution relative charge, 16 datapoints" CURVE 0x10165 RL_GRID_UBYTE 0 CM_0p75_0 0 191.25
 /begin AXIS_DESCR FIX_AXIS NO_INPUT_QUANTITY CM_IDENTITY 16 0 15 FIX_AXIS_PAR_DIST 0 1 16 /end AXIS_DESCR
/end CHARACTERISTIC
/begin CHARACTERISTIC STM12ESUB "podtverzhdena damos addr 0x10176 | Distribution for the engine coolant temperature tmot" CURVE 0x10176 RL_GRID_UBYTE 0 CM_0p75_48_GradC -48 143.25
 /begin AXIS_DESCR FIX_AXIS NO_INPUT_QUANTITY CM_IDENTITY 12 0 11 FIX_AXIS_PAR_DIST 0 1 12 /end AXIS_DESCR
/end CHARACTERISTIC
/begin CHARACTERISTIC NARASTG "adres podtverzhden damos-veroyatno addr 0x101E9 | IMYA NE PODTVERZHDENO, adres: kod: movb RL5, [r4+#0x1e8] @0x83A9C6 | RPM threshold in higher gear for AR active" CURVE 0x101E9 RL_GRID_UBYTE 0 CM_40_0_Upm 0 10200
 /begin AXIS_DESCR FIX_AXIS NO_INPUT_QUANTITY CM_IDENTITY 6 0 5 FIX_AXIS_PAR_DIST 0 1 6 /end AXIS_DESCR
/end CHARACTERISTIC
/begin CHARACTERISTIC KFETAZW "podtverzhdena profil addr 0x101F4 | Karta KPD po uglu operezheniya zazhiganiya. Klassicheskiy format Bosch: zagolovok nx/ny i osi vnutri bloka." MAP 0x101F4 RL_3D_A8_UBYTE 0 CM_0p5_0 0 127.5 /begin AXIS_DESCR STD_AXIS NO_INPUT_QUANTITY CM_IDENTITY 16 0 255 /end AXIS_DESCR /begin AXIS_DESCR STD_AXIS NO_INPUT_QUANTITY CM_IDENTITY 16 0 255 /end AXIS_DESCR /end CHARACTERISTIC
/begin CHARACTERISTIC KFETAZWN "podtverzhdena profil addr 0x10316 | To zhe na holostom hodu." MAP 0x10316 RL_3D_A8_UBYTE 0 CM_0p5_0 0 127.5 /begin AXIS_DESCR STD_AXIS NO_INPUT_QUANTITY CM_IDENTITY 16 0 255 /end AXIS_DESCR /begin AXIS_DESCR STD_AXIS NO_INPUT_QUANTITY CM_IDENTITY 16 0 255 /end AXIS_DESCR /end CHARACTERISTIC
/begin CHARACTERISTIC KFMPED "podtverzhdena damos-tochno addr 0x10452 | MDFAW" MAP 0x10452 RL_GRID_UBYTE 0 CM_0p390625_0 0 99.6094
 /begin AXIS_DESCR FIX_AXIS NO_INPUT_QUANTITY CM_IDENTITY 8 0 7 FIX_AXIS_PAR_DIST 0 1 8 /end AXIS_DESCR
 /begin AXIS_DESCR FIX_AXIS NO_INPUT_QUANTITY CM_IDENTITY 16 0 15 FIX_AXIS_PAR_DIST 0 1 16 /end AXIS_DESCR
/end CHARACTERISTIC
/begin CHARACTERISTIC ETADZW "podtverzhdena damos-veroyatno addr 0x104D3 | ignition efficiency depending on delta ignition angle | smysl podtverzhden CTP7: Effektivnost po smescheniyu UOZ" CURVE 0x104D3 RL_GRID_UBYTE 0 CM_0p5_0 0 127.5
 /begin AXIS_DESCR FIX_AXIS NO_INPUT_QUANTITY CM_IDENTITY 65 0 64 FIX_AXIS_PAR_DIST 0 1 65 /end AXIS_DESCR
/end CHARACTERISTIC
/begin CHARACTERISTIC KFZWOP "podtverzhdena profil addr 0x10529 | Optimalnyy ugol operezheniya zazhiganiya. Stolbcy = nagruzka (11 tochek, os SRL11OPUW), stroki = oboroty (16 tochek, os SNM16OPUB, x40 ob/min). Stok 0.75..45 grad. " MAP 0x10529 RL_GRID_SBYTE 0 CM_0p75_0_gradKW -96 95.25
 /begin AXIS_DESCR COM_AXIS NO_INPUT_QUANTITY CM_0p0234375_0 11 0 1535.98 AXIS_PTS_REF SRL11_OP /end AXIS_DESCR
 /begin AXIS_DESCR COM_AXIS NO_INPUT_QUANTITY CM_40_0_rpm 16 0 10200 AXIS_PTS_REF SNM16_OP /end AXIS_DESCR
/end CHARACTERISTIC
/begin CHARACTERISTIC NMAXPRL "podtverzhdena damos addr 0x105DB | P-element in NMAX control" CURVE 0x105DB RL_GRID_UBYTE 0 CM_0p00390625_0_Umin 0 0.996094
 /begin AXIS_DESCR FIX_AXIS NO_INPUT_QUANTITY CM_IDENTITY 8 0 7 FIX_AXIS_PAR_DIST 0 1 8 /end AXIS_DESCR
/end CHARACTERISTIC
/begin CHARACTERISTIC NMXDAEF "podtverzhdena damos addr 0x105EC | maximum permitted engine speed for throttle actuator substitute function" CURVE 0x105EC RL_GRID_UBYTE 0 CM_40_0_Upm 0 10200
 /begin AXIS_DESCR FIX_AXIS NO_INPUT_QUANTITY CM_IDENTITY 6 0 5 FIX_AXIS_PAR_DIST 0 1 6 /end AXIS_DESCR
/end CHARACTERISTIC
/begin CHARACTERISTIC ZINMAXRL "podtverzhdena damos addr 0x105FA | I-gradient for NMAX control" CURVE 0x105FA RL_GRID_UBYTE 0 CM_IDENTITY 0 255
 /begin AXIS_DESCR FIX_AXIS NO_INPUT_QUANTITY CM_IDENTITY 8 0 7 FIX_AXIS_PAR_DIST 0 1 8 /end AXIS_DESCR
/end CHARACTERISTIC
/begin CHARACTERISTIC RLMNN "adres podtverzhden damos-veroyatno addr 0x1060D | IMYA NE PODTVERZHDENO, adres: kod: add DPP0, #0x60d @0x82DF2A | characteristic minimum charge" CURVE 0x1060D RL_GRID_UBYTE 0 CM_0p75_0 0 191.25
 /begin AXIS_DESCR FIX_AXIS NO_INPUT_QUANTITY CM_IDENTITY 10 0 9 FIX_AXIS_PAR_DIST 0 1 10 /end AXIS_DESCR
/end CHARACTERISTIC
/begin CHARACTERISTIC RLMNSAN "adres podtverzhden damos-veroyatno addr 0x10617 | IMYA NE PODTVERZHDENO, adres: kod: mov r12, #0x617 @0x83C2E0 | characteristic minimum charge in overrun" CURVE 0x10617 RL_GRID_UBYTE 0 CM_0p75_0 0 191.25
 /begin AXIS_DESCR FIX_AXIS NO_INPUT_QUANTITY CM_IDENTITY 10 0 9 FIX_AXIS_PAR_DIST 0 1 10 /end AXIS_DESCR
/end CHARACTERISTIC
/begin CHARACTERISTIC KFMIRED "adres podtverzhden damos-veroyatno addr 0x10622 | IMYA NE PODTVERZHDENO, adres: kod: mov r12, #0x622 @0x83C3D2 | Map of decreasing control torque for VMAX control" MAP 0x10622 RL_GRID_UBYTE 0 CM_0p390625_0 0 99.6094
 /begin AXIS_DESCR FIX_AXIS NO_INPUT_QUANTITY CM_IDENTITY 3 0 2 FIX_AXIS_PAR_DIST 0 1 3 /end AXIS_DESCR
 /begin AXIS_DESCR FIX_AXIS NO_INPUT_QUANTITY CM_IDENTITY 2 0 1 FIX_AXIS_PAR_DIST 0 1 2 /end AXIS_DESCR
/end CHARACTERISTIC
/begin CHARACTERISTIC SBF02MFSB "podtverzhdena damos addr 0x1062A" CURVE 0x1062A RL_GRID_SBYTE 0 CM_0p217_0_ms2 -27.776 27.559
 /begin AXIS_DESCR FIX_AXIS NO_INPUT_QUANTITY CM_IDENTITY 2 0 1 FIX_AXIS_PAR_DIST 0 1 2 /end AXIS_DESCR
/end CHARACTERISTIC
/begin CHARACTERISTIC FSWALUV "adres podtverzhden damos-veroyatno addr 0x10631 | IMYA NE PODTVERZHDENO, adres: kod: mov r12, #0x630 @0x83C672 | rough road detection threshold = f (vehicle speed)" CURVE 0x10631 RL_GRID_UBYTE 0 CM_0p09803921569_0 0 25
 /begin AXIS_DESCR FIX_AXIS NO_INPUT_QUANTITY CM_IDENTITY 4 0 3 FIX_AXIS_PAR_DIST 0 1 4 /end AXIS_DESCR
/end CHARACTERISTIC
/begin CHARACTERISTIC FUGKUE "adres podtverzhden damos-veroyatno addr 0x10639 | IMYA NE PODTVERZHDENO, adres: kod: movb RL5, [r4+#0x639] @0x83C9AA | Gear box ratio detection" CURVE 0x10639 RL_GRID_UBYTE 0 CM_IDENTITY 0 255
 /begin AXIS_DESCR FIX_AXIS NO_INPUT_QUANTITY CM_IDENTITY 255 0 254 FIX_AXIS_PAR_DIST 0 1 255 /end AXIS_DESCR
/end CHARACTERISTIC
/begin CHARACTERISTIC FKODASH "podtverzhdena damos addr 0x1073B | A/C dependent line for correction factor" CURVE 0x1073B RL_GRID_UBYTE 0 CM_0p03125_0 0 7.96875
 /begin AXIS_DESCR FIX_AXIS NO_INPUT_QUANTITY CM_IDENTITY 8 0 7 FIX_AXIS_PAR_DIST 0 1 8 /end AXIS_DESCR
/end CHARACTERISTIC
/begin CHARACTERISTIC FVDASHM "podtverzhdena damos addr 0x1074C | Gain factor for dashpot" CURVE 0x1074C RL_GRID_UBYTE 0 CM_0p03125_0 0 7.96875
 /begin AXIS_DESCR FIX_AXIS NO_INPUT_QUANTITY CM_IDENTITY 8 0 7 FIX_AXIS_PAR_DIST 0 1 8 /end AXIS_DESCR
/end CHARACTERISTIC
/begin CHARACTERISTIC KFMIDSH0 "podtverzhdena damos-tochno addr 0x1076C | torque for dashpot (geardependent)" MAP 0x1076C RL_GRID_UBYTE 0 CM_0p390625_0 0 99.6094
 /begin AXIS_DESCR FIX_AXIS NO_INPUT_QUANTITY CM_IDENTITY 6 0 5 FIX_AXIS_PAR_DIST 0 1 6 /end AXIS_DESCR
 /begin AXIS_DESCR FIX_AXIS NO_INPUT_QUANTITY CM_IDENTITY 8 0 7 FIX_AXIS_PAR_DIST 0 1 8 /end AXIS_DESCR
/end CHARACTERISTIC
/begin CHARACTERISTIC KFMIDSH1 "podtverzhdena damos-tochno addr 0x107AC | torque for dashpot (geardependent)" MAP 0x107AC RL_GRID_UBYTE 0 CM_0p390625_0 0 99.6094
 /begin AXIS_DESCR FIX_AXIS NO_INPUT_QUANTITY CM_IDENTITY 6 0 5 FIX_AXIS_PAR_DIST 0 1 6 /end AXIS_DESCR
 /begin AXIS_DESCR FIX_AXIS NO_INPUT_QUANTITY CM_IDENTITY 8 0 7 FIX_AXIS_PAR_DIST 0 1 8 /end AXIS_DESCR
/end CHARACTERISTIC
/begin CHARACTERISTIC KFMIDSH2 "podtverzhdena damos-tochno addr 0x107EC | torque for dashpot (geardependent)" MAP 0x107EC RL_GRID_UBYTE 0 CM_0p390625_0 0 99.6094
 /begin AXIS_DESCR FIX_AXIS NO_INPUT_QUANTITY CM_IDENTITY 6 0 5 FIX_AXIS_PAR_DIST 0 1 6 /end AXIS_DESCR
 /begin AXIS_DESCR FIX_AXIS NO_INPUT_QUANTITY CM_IDENTITY 8 0 7 FIX_AXIS_PAR_DIST 0 1 8 /end AXIS_DESCR
/end CHARACTERISTIC
/begin CHARACTERISTIC KFMIDSH3 "podtverzhdena damos-tochno addr 0x1082C | torque for dashpot (geardependent)" MAP 0x1082C RL_GRID_UBYTE 0 CM_0p390625_0 0 99.6094
 /begin AXIS_DESCR FIX_AXIS NO_INPUT_QUANTITY CM_IDENTITY 6 0 5 FIX_AXIS_PAR_DIST 0 1 6 /end AXIS_DESCR
 /begin AXIS_DESCR FIX_AXIS NO_INPUT_QUANTITY CM_IDENTITY 8 0 7 FIX_AXIS_PAR_DIST 0 1 8 /end AXIS_DESCR
/end CHARACTERISTIC
/begin CHARACTERISTIC ZDSH1GS "adres podtverzhden damos-veroyatno addr 0x1085C | IMYA NE PODTVERZHDENO, adres: kod: movb RL5, [r4+#0x85c] @0x83CC08 | time constant for dash pot decay speed (geardependent)" CURVE 0x1085C RL_GRID_UBYTE 0 CM_IDENTITY 0 255
 /begin AXIS_DESCR FIX_AXIS NO_INPUT_QUANTITY CM_IDENTITY 6 0 5 FIX_AXIS_PAR_DIST 0 1 6 /end AXIS_DESCR
/end CHARACTERISTIC
/begin CHARACTERISTIC ZDSHGS "adres podtverzhden damos-veroyatno addr 0x10862 | IMYA NE PODTVERZHDENO, adres: kod: movb RL5, [r4+#0x862] @0x83CBC8 | time constant for dash pot decay speed (geardependent)" CURVE 0x10862 RL_GRID_UBYTE 0 CM_IDENTITY 0 255
 /begin AXIS_DESCR FIX_AXIS NO_INPUT_QUANTITY CM_IDENTITY 6 0 5 FIX_AXIS_PAR_DIST 0 1 6 /end AXIS_DESCR
/end CHARACTERISTIC
/begin CHARACTERISTIC DZWETA "adres podtverzhden damos-veroyatno addr 0x1086C | IMYA NE PODTVERZHDENO, adres: kod: movb RL5, [r4+#0x86c] @0x83DA96 | delta ignition angle from efficiency" CURVE 0x1086C RL_GRID_SBYTE 0 CM_0p75_0_gradKW -96 95.25
 /begin AXIS_DESCR FIX_AXIS NO_INPUT_QUANTITY CM_IDENTITY 201 0 200 FIX_AXIS_PAR_DIST 0 1 201 /end AXIS_DESCR
/end CHARACTERISTIC
/begin CHARACTERISTIC KFZWMS "podtverzhdena profil addr 0x10935 | Predelno pozdniy ugol zazhiganiya. V stoke vsya karta ravna -33 (-24.75 grad). Pravitsya tyuningom." MAP 0x10935 RL_GRID_SBYTE 0 CM_0p75_0_gradKW -96 95.25
 /begin AXIS_DESCR COM_AXIS NO_INPUT_QUANTITY CM_0p75_0 12 0 191.25 AXIS_PTS_REF SRL12_ZU /end AXIS_DESCR
 /begin AXIS_DESCR COM_AXIS NO_INPUT_QUANTITY CM_40_0_rpm 16 0 10200 AXIS_PTS_REF SNM16_ZU /end AXIS_DESCR
/end CHARACTERISTIC
/begin CHARACTERISTIC KFZW "podtverzhdena profil addr 0x109F5 | Osnovnaya karta ugla operezheniya zazhiganiya. Stolbcy = nagruzka (12 tochek, os SRL12ZUUB), stroki = oboroty (16 tochek, SNM16ZUUB). Stok -0.75..42.75 grad." MAP 0x109F5 RL_GRID_SBYTE 0 CM_0p75_0_gradKW -96 95.25
 /begin AXIS_DESCR COM_AXIS NO_INPUT_QUANTITY CM_0p75_0 12 0 191.25 AXIS_PTS_REF SRL12_ZU /end AXIS_DESCR
 /begin AXIS_DESCR COM_AXIS NO_INPUT_QUANTITY CM_40_0_rpm 16 0 10200 AXIS_PTS_REF SNM16_ZU /end AXIS_DESCR
/end CHARACTERISTIC
/begin CHARACTERISTIC KFZW2 "podtverzhdena profil addr 0x10AB5 | Karta zazhiganiya, variant 2. Stok 2.25..33.75 grad." MAP 0x10AB5 RL_GRID_SBYTE 0 CM_0p75_0_gradKW -96 95.25
 /begin AXIS_DESCR COM_AXIS NO_INPUT_QUANTITY CM_0p75_0 12 0 191.25 AXIS_PTS_REF SRL12_ZU /end AXIS_DESCR
 /begin AXIS_DESCR COM_AXIS NO_INPUT_QUANTITY CM_40_0_rpm 16 0 10200 AXIS_PTS_REF SNM16_ZU /end AXIS_DESCR
/end CHARACTERISTIC
/begin CHARACTERISTIC FSZTM "podtverzhdena damos addr 0x10B76 | Factor dwell angle correction tmot depending" CURVE 0x10B76 RL_GRID_UBYTE 0 CM_0p0078125_0 0 1.99219
 /begin AXIS_DESCR FIX_AXIS NO_INPUT_QUANTITY CM_IDENTITY 8 0 7 FIX_AXIS_PAR_DIST 0 1 8 /end AXIS_DESCR
/end CHARACTERISTIC
/begin CHARACTERISTIC KFSZT "podtverzhdena damos addr 0x10B98 | Dwell angle characteristic map" MAP 0x10B98 RL_GRID_UBYTE 0 CM_0p1_0_ms 0 25.5
 /begin AXIS_DESCR FIX_AXIS NO_INPUT_QUANTITY CM_IDENTITY 8 0 7 FIX_AXIS_PAR_DIST 0 1 8 /end AXIS_DESCR
 /begin AXIS_DESCR FIX_AXIS NO_INPUT_QUANTITY CM_IDENTITY 8 0 7 FIX_AXIS_PAR_DIST 0 1 8 /end AXIS_DESCR
/end CHARACTERISTIC
/begin CHARACTERISTIC ZNSMST "adres podtverzhden damos-veroyatno addr 0x10F14 | IMYA NE PODTVERZHDENO, adres: kod: mov r12, #0xf14 @0x83ED6C | time constant for decay of reference speed at start" CURVE 0x10F14 RL_GRID_UBYTE 0 CM_IDENTITY 0 255
 /begin AXIS_DESCR FIX_AXIS NO_INPUT_QUANTITY CM_IDENTITY 6 0 5 FIX_AXIS_PAR_DIST 0 1 6 /end AXIS_DESCR
/end CHARACTERISTIC
/begin CHARACTERISTIC DMLLRIMXN "adres podtverzhden damos-veroyatno addr 0x10F1B | IMYA NE PODTVERZHDENO, adres: kod: mov r12, #0xf1b @0x83F85E | Safety concept: upper limit for dmllri" CURVE 0x10F1B RL_GRID_UBYTE 0 CM_0p390625_0 0 99.6094
 /begin AXIS_DESCR FIX_AXIS NO_INPUT_QUANTITY CM_IDENTITY 6 0 5 FIX_AXIS_PAR_DIST 0 1 6 /end AXIS_DESCR
/end CHARACTERISTIC
/begin CHARACTERISTIC DMLLRLMNN "adres podtverzhden damos-veroyatno addr 0x10F21 | IMYA NE PODTVERZHDENO, adres: kod: mov r12, #0xf21 @0x83F9C8 | Lower limit for dmllrl" CURVE 0x10F21 RL_GRID_SBYTE 0 CM_0p3906_0 -49.9968 49.6062
 /begin AXIS_DESCR FIX_AXIS NO_INPUT_QUANTITY CM_IDENTITY 6 0 5 FIX_AXIS_PAR_DIST 0 1 6 /end AXIS_DESCR
/end CHARACTERISTIC
/begin CHARACTERISTIC DMLLRLMXN "adres podtverzhden damos-veroyatno addr 0x10F27 | IMYA NE PODTVERZHDENO, adres: kod: mov r12, #0xf27 @0x83F9AA | Safety concept: upper limit for dmllrl" CURVE 0x10F27 RL_GRID_UBYTE 0 CM_0p390625_0 0 99.6094
 /begin AXIS_DESCR FIX_AXIS NO_INPUT_QUANTITY CM_IDENTITY 6 0 5 FIX_AXIS_PAR_DIST 0 1 6 /end AXIS_DESCR
/end CHARACTERISTIC
/begin CHARACTERISTIC DMLLRMNN "adres podtverzhden damos-veroyatno addr 0x10F2D | IMYA NE PODTVERZHDENO, adres: kod: mov r12, #0xf2d @0x83F368 | Lower limit for dmllr_w" CURVE 0x10F2D RL_GRID_SBYTE 0 CM_0p3906_0 -49.9968 49.6062
 /begin AXIS_DESCR FIX_AXIS NO_INPUT_QUANTITY CM_IDENTITY 6 0 5 FIX_AXIS_PAR_DIST 0 1 6 /end AXIS_DESCR
/end CHARACTERISTIC
/begin CHARACTERISTIC DMLLRMXN "adres podtverzhden damos-veroyatno addr 0x10F33 | IMYA NE PODTVERZHDENO, adres: kod: mov r12, #0xf33 @0x83F356 | Safety concept: upper limit for dmllr" CURVE 0x10F33 RL_GRID_UBYTE 0 CM_0p390625_0 0 99.6094
 /begin AXIS_DESCR FIX_AXIS NO_INPUT_QUANTITY CM_IDENTITY 6 0 5 FIX_AXIS_PAR_DIST 0 1 6 /end AXIS_DESCR
/end CHARACTERISTIC
/begin CHARACTERISTIC DVNG "adres podtverzhden damos-veroyatno addr 0x10F3B | IMYA NE PODTVERZHDENO, adres: kod: mov r12, #0xf3b @0x83F398 | LLR: D-gain depending of ngfil for vehicle at rest" CURVE 0x10F3B RL_GRID_SBYTE 0 CM_n0p00048828125_0_sUmin -0.0620117 0.0625
 /begin AXIS_DESCR FIX_AXIS NO_INPUT_QUANTITY CM_IDENTITY 6 0 5 FIX_AXIS_PAR_DIST 0 1 6 /end AXIS_DESCR
/end CHARACTERISTIC
/begin CHARACTERISTIC DVNGV "adres podtverzhden damos-veroyatno addr 0x10F41 | IMYA NE PODTVERZHDENO, adres: kod: mov r12, #0xf41 @0x83F386 | LLR: D-gain depending of ngfil for vehicle rolling" CURVE 0x10F41 RL_GRID_SBYTE 0 CM_n0p00048828125_0_sUmin -0.0620117 0.0625
 /begin AXIS_DESCR FIX_AXIS NO_INPUT_QUANTITY CM_IDENTITY 6 0 5 FIX_AXIS_PAR_DIST 0 1 6 /end AXIS_DESCR
/end CHARACTERISTIC
/begin CHARACTERISTIC FDDN "adres podtverzhden damos-veroyatno addr 0x10F47 | IMYA NE PODTVERZHDENO, adres: kod: mov r12, #0xf47 @0x83F3A8 | LLR: weightning factor for D-amplification" CURVE 0x10F47 RL_GRID_UBYTE 0 CM_0p00390625_0 0 0.996094
 /begin AXIS_DESCR FIX_AXIS NO_INPUT_QUANTITY CM_IDENTITY 6 0 5 FIX_AXIS_PAR_DIST 0 1 6 /end AXIS_DESCR
/end CHARACTERISTIC
/begin CHARACTERISTIC GFDLDN "adres podtverzhden damos-veroyatno addr 0x10F4E | IMYA NE PODTVERZHDENO, adres: kod: mov r12, #0xf4e @0x83F8B4 | LLR: weightning factor for D-amplification on the air path" CURVE 0x10F4E RL_GRID_UBYTE 0 CM_0p00390625_0 0 0.996094
 /begin AXIS_DESCR FIX_AXIS NO_INPUT_QUANTITY CM_IDENTITY 6 0 5 FIX_AXIS_PAR_DIST 0 1 6 /end AXIS_DESCR
/end CHARACTERISTIC
/begin CHARACTERISTIC IVDN "adres podtverzhden damos-veroyatno addr 0x10F54 | IMYA NE PODTVERZHDENO, adres: kod: mov r12, #0xf54 @0x83F6DA | LLR: I-gain for vehicle at rest" CURVE 0x10F54 RL_GRID_UBYTE 0 CM_0p0023828125_0_sUmin 0 0.607617
 /begin AXIS_DESCR FIX_AXIS NO_INPUT_QUANTITY CM_IDENTITY 6 0 5 FIX_AXIS_PAR_DIST 0 1 6 /end AXIS_DESCR
/end CHARACTERISTIC
/begin CHARACTERISTIC IVDNDTE "adres podtverzhden damos-veroyatno addr 0x10F5A | IMYA NE PODTVERZHDENO, adres: kod: mov r12, #0xf5a @0x83F6AC | LLR: I-gain at DTEV" CURVE 0x10F5A RL_GRID_UBYTE 0 CM_0p0023828125_0_sUmin 0 0.607617
 /begin AXIS_DESCR FIX_AXIS NO_INPUT_QUANTITY CM_IDENTITY 6 0 5 FIX_AXIS_PAR_DIST 0 1 6 /end AXIS_DESCR
/end CHARACTERISTIC
/begin CHARACTERISTIC PVDN "adres podtverzhden damos-veroyatno addr 0x10F71 | IMYA NE PODTVERZHDENO, adres: kod: mov r12, #0xf71 @0x83F296 | LLR: P-gain for vehicle at rest" CURVE 0x10F71 RL_GRID_UBYTE 0 CM_0p001525878906_0 0 0.389099
 /begin AXIS_DESCR FIX_AXIS NO_INPUT_QUANTITY CM_IDENTITY 6 0 5 FIX_AXIS_PAR_DIST 0 1 6 /end AXIS_DESCR
/end CHARACTERISTIC
/begin CHARACTERISTIC PVLDN "adres podtverzhden damos-veroyatno addr 0x10F83 | IMYA NE PODTVERZHDENO, adres: kod: mov r12, #0xf83 @0x83F938 | LLR: P-gain for vehicle at rest (air path)" CURVE 0x10F83 RL_GRID_UBYTE 0 CM_0p001525878906_0 0 0.389099
 /begin AXIS_DESCR FIX_AXIS NO_INPUT_QUANTITY CM_IDENTITY 6 0 5 FIX_AXIS_PAR_DIST 0 1 6 /end AXIS_DESCR
/end CHARACTERISTIC
/begin CHARACTERISTIC PVLDNV "adres podtverzhden damos-veroyatno addr 0x10F89 | IMYA NE PODTVERZHDENO, adres: kod: mov r12, #0xf89 @0x83F90E | LLR: P-gain for vehicle at rest (air path)" CURVE 0x10F89 RL_GRID_UBYTE 0 CM_0p001525878906_0 0 0.389099
 /begin AXIS_DESCR FIX_AXIS NO_INPUT_QUANTITY CM_IDENTITY 6 0 5 FIX_AXIS_PAR_DIST 0 1 6 /end AXIS_DESCR
/end CHARACTERISTIC
/begin CHARACTERISTIC SDN06LLSB "adres podtverzhden damos-veroyatno addr 0x10F90 | IMYA NE PODTVERZHDENO, adres: kod: mov r12, #0xf8f @0x83F266 | 10 Sst." CURVE 0x10F90 RL_GRID_SBYTE 0 CM_10_0_Umin -1280 1270
 /begin AXIS_DESCR FIX_AXIS NO_INPUT_QUANTITY CM_IDENTITY 6 0 5 FIX_AXIS_PAR_DIST 0 1 6 /end AXIS_DESCR
/end CHARACTERISTIC
/begin CHARACTERISTIC SNS206LLSB "adres podtverzhden damos-veroyatno addr 0x10F96 | IMYA NE PODTVERZHDENO, adres: kod: mov r12, #0xf96 @0x83F5BC" CURVE 0x10F96 RL_GRID_UBYTE 0 CM_IDENTITY 0 255
 /begin AXIS_DESCR FIX_AXIS NO_INPUT_QUANTITY CM_IDENTITY 6 0 5 FIX_AXIS_PAR_DIST 0 1 6 /end AXIS_DESCR
/end CHARACTERISTIC
/begin CHARACTERISTIC KLMDLOAD2 "podtverzhdena damos addr 0x10FA3 | charact. line for torque for electrical load 2" CURVE 0x10FA3 RL_GRID_UBYTE 0 CM_0p390625_0 0 99.6094
 /begin AXIS_DESCR FIX_AXIS NO_INPUT_QUANTITY CM_IDENTITY 8 0 7 FIX_AXIS_PAR_DIST 0 1 8 /end AXIS_DESCR
/end CHARACTERISTIC
/begin CHARACTERISTIC FABMDWA "podtverzhdena damos addr 0x10FBB | Factor to decrease the converter torque depending of nturb" CURVE 0x10FBB RL_GRID_UBYTE 0 CM_0p00390625_0 0 0.996094
 /begin AXIS_DESCR FIX_AXIS NO_INPUT_QUANTITY CM_IDENTITY 6 0 5 FIX_AXIS_PAR_DIST 0 1 6 /end AXIS_DESCR
/end CHARACTERISTIC
/begin CHARACTERISTIC TVFSAM "adres podtverzhden damos-veroyatno addr 0x10FC9 | IMYA NE PODTVERZHDENO, adres: kod: mov r12, #0xfc9 @0x8407D8 | Delay time after DRIVE-position switch off" CURVE 0x10FC9 RL_GRID_UBYTE 0 CM_0p02_0_s 0 5.1
 /begin AXIS_DESCR FIX_AXIS NO_INPUT_QUANTITY CM_IDENTITY 6 0 5 FIX_AXIS_PAR_DIST 0 1 6 /end AXIS_DESCR
/end CHARACTERISTIC
/begin CHARACTERISTIC TVFSAMR "adres podtverzhden damos-veroyatno addr 0x10FCF | IMYA NE PODTVERZHDENO, adres: kod: mov r12, #0xfcf @0x8407F8 | delay time after DRIVE-position switch off (Reverse)" CURVE 0x10FCF RL_GRID_UBYTE 0 CM_0p02_0_s 0 5.1
 /begin AXIS_DESCR FIX_AXIS NO_INPUT_QUANTITY CM_IDENTITY 6 0 5 FIX_AXIS_PAR_DIST 0 1 6 /end AXIS_DESCR
/end CHARACTERISTIC
/begin CHARACTERISTIC TVFSEM "adres podtverzhden damos-veroyatno addr 0x10FD5 | IMYA NE PODTVERZHDENO, adres: kod: mov r12, #0xfd5 @0x8407E8 | delay time after DRIVE-position switch on" CURVE 0x10FD5 RL_GRID_UBYTE 0 CM_0p02_0_s 0 5.1
 /begin AXIS_DESCR FIX_AXIS NO_INPUT_QUANTITY CM_IDENTITY 6 0 5 FIX_AXIS_PAR_DIST 0 1 6 /end AXIS_DESCR
/end CHARACTERISTIC
/begin CHARACTERISTIC TVFSEMR "adres podtverzhden damos-veroyatno addr 0x10FDB | IMYA NE PODTVERZHDENO, adres: kod: mov r12, #0xfdb @0x840808 | delay time after DRIVE-position switch on (Reverse)" CURVE 0x10FDB RL_GRID_UBYTE 0 CM_0p02_0_s 0 5.1
 /begin AXIS_DESCR FIX_AXIS NO_INPUT_QUANTITY CM_IDENTITY 6 0 5 FIX_AXIS_PAR_DIST 0 1 6 /end AXIS_DESCR
/end CHARACTERISTIC
/begin CHARACTERISTIC UEVERG "adres podtverzhden damos-veroyatno addr 0x10FE2 | IMYA NE PODTVERZHDENO, adres: kod: movb RL5, [r4+#0xfe2] @0x8404FA | Gear ratio depending of the gear" CURVE 0x10FE2 RL_GRID_UBYTE 0 CM_0p0625_0 0 15.9375
 /begin AXIS_DESCR FIX_AXIS NO_INPUT_QUANTITY CM_IDENTITY 14 0 13 FIX_AXIS_PAR_DIST 0 1 14 /end AXIS_DESCR
/end CHARACTERISTIC
/begin CHARACTERISTIC ZKMDWAM "adres podtverzhden damos-veroyatno addr 0x10FF0 | IMYA NE PODTVERZHDENO, adres: kod: mov r12, #0xff0 @0x840770 | Time constant for converter torque change" CURVE 0x10FF0 RL_GRID_UBYTE 0 CM_IDENTITY 0 255
 /begin AXIS_DESCR FIX_AXIS NO_INPUT_QUANTITY CM_IDENTITY 6 0 5 FIX_AXIS_PAR_DIST 0 1 6 /end AXIS_DESCR
/end CHARACTERISTIC
/begin CHARACTERISTIC FZN0 "adres podtverzhden damos-veroyatno addr 0x10FF8 | IMYA NE PODTVERZHDENO, adres: kod: mov r12, #0xff8 @0x8429F6 | Cylinder individual factor at neutral camshaft position EV 1" CURVE 0x10FF8 RL_GRID_UBYTE 0 CM_0p001953125_n0p75 0.75 1.24805
 /begin AXIS_DESCR FIX_AXIS NO_INPUT_QUANTITY CM_IDENTITY 16 0 15 FIX_AXIS_PAR_DIST 0 1 16 /end AXIS_DESCR
/end CHARACTERISTIC
/begin CHARACTERISTIC FZN1 "adres podtverzhden damos-veroyatno addr 0x11008 | IMYA NE PODTVERZHDENO, adres: kod: mov r12, #0x1008 @0x842A18 | Cylinder individual factor at neutral camshaft position EV 1" CURVE 0x11008 RL_GRID_UBYTE 0 CM_0p001953125_n0p75 0.75 1.24805
 /begin AXIS_DESCR FIX_AXIS NO_INPUT_QUANTITY CM_IDENTITY 16 0 15 FIX_AXIS_PAR_DIST 0 1 16 /end AXIS_DESCR
/end CHARACTERISTIC
/begin CHARACTERISTIC FZN2 "adres podtverzhden damos-veroyatno addr 0x11018 | IMYA NE PODTVERZHDENO, adres: kod: mov r12, #0x1018 @0x842A3A | Cylinder individual factor at neutral camshaft position EV 2" CURVE 0x11018 RL_GRID_UBYTE 0 CM_0p001953125_n0p75 0.75 1.24805
 /begin AXIS_DESCR FIX_AXIS NO_INPUT_QUANTITY CM_IDENTITY 16 0 15 FIX_AXIS_PAR_DIST 0 1 16 /end AXIS_DESCR
/end CHARACTERISTIC
/begin CHARACTERISTIC FZN3 "adres podtverzhden damos-veroyatno addr 0x11028 | IMYA NE PODTVERZHDENO, adres: kod: mov r12, #0x1028 @0x842A5C | Cylinder individual factor at neutral camshaft position EV 3" CURVE 0x11028 RL_GRID_UBYTE 0 CM_0p001953125_n0p75 0.75 1.24805
 /begin AXIS_DESCR FIX_AXIS NO_INPUT_QUANTITY CM_IDENTITY 16 0 15 FIX_AXIS_PAR_DIST 0 1 16 /end AXIS_DESCR
/end CHARACTERISTIC
/begin CHARACTERISTIC FZN4 "adres podtverzhden damos-veroyatno addr 0x11038 | IMYA NE PODTVERZHDENO, adres: kod: mov r12, #0x1038 @0x851692 | Cylinder individual factor at neutral camshaft position EV 4" CURVE 0x11038 RL_GRID_UBYTE 0 CM_0p001953125_n0p75 0.75 1.24805
 /begin AXIS_DESCR FIX_AXIS NO_INPUT_QUANTITY CM_IDENTITY 16 0 15 FIX_AXIS_PAR_DIST 0 1 16 /end AXIS_DESCR
/end CHARACTERISTIC
/begin CHARACTERISTIC FZNWN0 "adres podtverzhden damos-veroyatno addr 0x11078 | IMYA NE PODTVERZHDENO, adres: kod: mov r12, #0x1078 @0x8429E8 | Cylinder individual factor at active camshaft position EV 1" CURVE 0x11078 RL_GRID_UBYTE 0 CM_0p001953125_n0p75 0.75 1.24805
 /begin AXIS_DESCR FIX_AXIS NO_INPUT_QUANTITY CM_IDENTITY 16 0 15 FIX_AXIS_PAR_DIST 0 1 16 /end AXIS_DESCR
/end CHARACTERISTIC
/begin CHARACTERISTIC FZNWN1 "adres podtverzhden damos-veroyatno addr 0x11088 | IMYA NE PODTVERZHDENO, adres: kod: mov r12, #0x1088 @0x842A0A | Cylinder individual factor at active camshaft position EV 1" CURVE 0x11088 RL_GRID_UBYTE 0 CM_0p001953125_n0p75 0.75 1.24805
 /begin AXIS_DESCR FIX_AXIS NO_INPUT_QUANTITY CM_IDENTITY 16 0 15 FIX_AXIS_PAR_DIST 0 1 16 /end AXIS_DESCR
/end CHARACTERISTIC
/begin CHARACTERISTIC FZNWN2 "adres podtverzhden damos-veroyatno addr 0x11098 | IMYA NE PODTVERZHDENO, adres: kod: mov r12, #0x1098 @0x842A2C | Cylinder individual factor at active camshaft position EV 2" CURVE 0x11098 RL_GRID_UBYTE 0 CM_0p001953125_n0p75 0.75 1.24805
 /begin AXIS_DESCR FIX_AXIS NO_INPUT_QUANTITY CM_IDENTITY 16 0 15 FIX_AXIS_PAR_DIST 0 1 16 /end AXIS_DESCR
/end CHARACTERISTIC
/begin CHARACTERISTIC FZNWN3 "adres podtverzhden damos-veroyatno addr 0x110A8 | IMYA NE PODTVERZHDENO, adres: kod: mov r12, #0x10a8 @0x842A4E | Cylinder individual factor at active camshaft position EV 3" CURVE 0x110A8 RL_GRID_UBYTE 0 CM_0p001953125_n0p75 0.75 1.24805
 /begin AXIS_DESCR FIX_AXIS NO_INPUT_QUANTITY CM_IDENTITY 16 0 15 FIX_AXIS_PAR_DIST 0 1 16 /end AXIS_DESCR
/end CHARACTERISTIC
/begin CHARACTERISTIC KFZWMN "podtverzhdena profil addr 0x14DA4 | Karta minimalnogo ugla zazhiganiya. Izmenena kalibrovschikom. ADRES -- ZAGOLOVOK: [16][12][os oborotov][os nagruzki], dannye s 0x14DC2. Razvyazka v profile." MAP 0x14DA4 RL_3D_A8_SBYTE 0 CM_0p75_0_gradKW -96 95.25 /begin AXIS_DESCR STD_AXIS NO_INPUT_QUANTITY CM_0p75_0 16 0 191.25 /end AXIS_DESCR /begin AXIS_DESCR STD_AXIS NO_INPUT_QUANTITY CM_40_0_rpm 12 0 10200 /end AXIS_DESCR /end CHARACTERISTIC
/begin CHARACTERISTIC KFZWMNST "podtverzhdena damos-tochno addr 0x14EA0 | minimal ignition spark advance for engine start and after start" MAP 0x14EA0 RL_GRID_SBYTE 0 CM_0p75_0_gradKW -96 95.25
 /begin AXIS_DESCR FIX_AXIS NO_INPUT_QUANTITY CM_IDENTITY 12 0 11 FIX_AXIS_PAR_DIST 0 1 12 /end AXIS_DESCR
 /begin AXIS_DESCR FIX_AXIS NO_INPUT_QUANTITY CM_IDENTITY 16 0 15 FIX_AXIS_PAR_DIST 0 1 16 /end AXIS_DESCR
/end CHARACTERISTIC
/begin CHARACTERISTIC NNSTA "podtverzhdena damos addr 0x18195 | engine-speed transition normal -> start" CURVE 0x18195 RL_GRID_UBYTE 0 CM_40_0_Upm 0 10200
 /begin AXIS_DESCR FIX_AXIS NO_INPUT_QUANTITY CM_IDENTITY 3 0 2 FIX_AXIS_PAR_DIST 0 1 3 /end AXIS_DESCR
/end CHARACTERISTIC
/begin CHARACTERISTIC NSTNM "podtverzhdena damos addr 0x1819C | transition start -> normal" CURVE 0x1819C RL_GRID_UBYTE 0 CM_40_0_Upm 0 10200
 /begin AXIS_DESCR FIX_AXIS NO_INPUT_QUANTITY CM_IDENTITY 3 0 2 FIX_AXIS_PAR_DIST 0 1 3 /end AXIS_DESCR
/end CHARACTERISTIC
/begin CHARACTERISTIC SDK10TEUB "podtverzhdena damos addr 0x181A3 | wdkba dependet basic point (number 10)" CURVE 0x181A3 RL_GRID_UBYTE 0 CM_0p3921568627_0_DK 0 100
 /begin AXIS_DESCR FIX_AXIS NO_INPUT_QUANTITY CM_IDENTITY 10 0 9 FIX_AXIS_PAR_DIST 0 1 10 /end AXIS_DESCR
/end CHARACTERISTIC
/begin CHARACTERISTIC SEZ06TMUB "podtverzhdena damos addr 0x181AE | Datapoint distribution of ignition timing efficiency" CURVE 0x181AE RL_GRID_UBYTE 0 CM_0p5_0 0 127.5
 /begin AXIS_DESCR FIX_AXIS NO_INPUT_QUANTITY CM_IDENTITY 6 0 5 FIX_AXIS_PAR_DIST 0 1 6 /end AXIS_DESCR
/end CHARACTERISTIC
/begin CHARACTERISTIC SFR05TEUB "podtverzhdena damos addr 0x181B5 | frmit dependet basic point (number 5)" CURVE 0x181B5 RL_GRID_UBYTE 0 CM_0p0078125_0 0 1.99219
 /begin AXIS_DESCR FIX_AXIS NO_INPUT_QUANTITY CM_IDENTITY 5 0 4 FIX_AXIS_PAR_DIST 0 1 5 /end AXIS_DESCR
/end CHARACTERISTIC
/begin CHARACTERISTIC SGA06MFUB "podtverzhdena damos addr 0x181BB" CURVE 0x181BB RL_GRID_UBYTE 0 CM_IDENTITY 0 255
 /begin AXIS_DESCR FIX_AXIS NO_INPUT_QUANTITY CM_IDENTITY 6 0 5 FIX_AXIS_PAR_DIST 0 1 6 /end AXIS_DESCR
/end CHARACTERISTIC
/begin CHARACTERISTIC SKS06ESUB "podtverzhdena damos addr 0x181C2 | Distribution for the start adaption factor kstaa" CURVE 0x181C2 RL_GRID_UBYTE 0 CM_0p0078125_0 0 1.99219
 /begin AXIS_DESCR FIX_AXIS NO_INPUT_QUANTITY CM_IDENTITY 6 0 5 FIX_AXIS_PAR_DIST 0 1 6 /end AXIS_DESCR
/end CHARACTERISTIC
/begin CHARACTERISTIC SML06TEUB "podtverzhdena damos addr 0x181C9 | ml dependet basic point (number 6)" CURVE 0x181C9 RL_GRID_UBYTE 0 CM_4_0_kgh 0 1020
 /begin AXIS_DESCR FIX_AXIS NO_INPUT_QUANTITY CM_IDENTITY 6 0 5 FIX_AXIS_PAR_DIST 0 1 6 /end AXIS_DESCR
/end CHARACTERISTIC
/begin CHARACTERISTIC SML06TMUB "podtverzhdena damos addr 0x181D0 | ml dependet basic point (number 6)" CURVE 0x181D0 RL_GRID_UBYTE 0 CM_4_0_kgh 0 1020
 /begin AXIS_DESCR FIX_AXIS NO_INPUT_QUANTITY CM_IDENTITY 6 0 5 FIX_AXIS_PAR_DIST 0 1 6 /end AXIS_DESCR
/end CHARACTERISTIC
/begin CHARACTERISTIC SNM06LHUB "podtverzhdena damos addr 0x181D7" CURVE 0x181D7 RL_GRID_UBYTE 0 CM_40_0_Upm 0 10200
 /begin AXIS_DESCR FIX_AXIS NO_INPUT_QUANTITY CM_IDENTITY 6 0 5 FIX_AXIS_PAR_DIST 0 1 6 /end AXIS_DESCR
/end CHARACTERISTIC
/begin CHARACTERISTIC SNM06MFUB "podtverzhdena damos addr 0x181DE" CURVE 0x181DE RL_GRID_UBYTE 0 CM_40_0_Upm 0 10200
 /begin AXIS_DESCR FIX_AXIS NO_INPUT_QUANTITY CM_IDENTITY 6 0 5 FIX_AXIS_PAR_DIST 0 1 6 /end AXIS_DESCR
/end CHARACTERISTIC
/begin CHARACTERISTIC SNM07ESUB "podtverzhdena damos addr 0x181E5 | Base point distribution of engine speed, 7 base pts." CURVE 0x181E5 RL_GRID_UBYTE 0 CM_40_0_Upm 0 10200
 /begin AXIS_DESCR FIX_AXIS NO_INPUT_QUANTITY CM_IDENTITY 7 0 6 FIX_AXIS_PAR_DIST 0 1 7 /end AXIS_DESCR
/end CHARACTERISTIC
/begin CHARACTERISTIC SNM10TEUB "podtverzhdena damos addr 0x181ED | nmot dependet basic point (number 10)" CURVE 0x181ED RL_GRID_UBYTE 0 CM_40_0_Upm 0 10200
 /begin AXIS_DESCR FIX_AXIS NO_INPUT_QUANTITY CM_IDENTITY 10 0 9 FIX_AXIS_PAR_DIST 0 1 10 /end AXIS_DESCR
/end CHARACTERISTIC
/begin CHARACTERISTIC SNM16GKUB "podtverzhdena damos addr 0x181F8 | Datapoint distribution mixture control 16 nmot datapoints" CURVE 0x181F8 RL_GRID_UBYTE 0 CM_40_0_Upm 0 10200
 /begin AXIS_DESCR FIX_AXIS NO_INPUT_QUANTITY CM_IDENTITY 16 0 15 FIX_AXIS_PAR_DIST 0 1 16 /end AXIS_DESCR
/end CHARACTERISTIC
/begin CHARACTERISTIC SNM16KRUB "podtverzhdena damos addr 0x18209 | datapoint distribution engine speed, 16 datapoints" CURVE 0x18209 RL_GRID_UBYTE 0 CM_40_0_Upm 0 10200
 /begin AXIS_DESCR FIX_AXIS NO_INPUT_QUANTITY CM_IDENTITY 16 0 15 FIX_AXIS_PAR_DIST 0 1 16 /end AXIS_DESCR
/end CHARACTERISTIC
/begin CHARACTERISTIC SRL04KRUB "podtverzhdena damos addr 0x1821A | datapoint distribution relative charge, 4 datapoints" CURVE 0x1821A RL_GRID_UBYTE 0 CM_0p75_0 0 191.25
 /begin AXIS_DESCR FIX_AXIS NO_INPUT_QUANTITY CM_IDENTITY 4 0 3 FIX_AXIS_PAR_DIST 0 1 4 /end AXIS_DESCR
/end CHARACTERISTIC
/begin CHARACTERISTIC SRL12GKUB "podtverzhdena damos addr 0x1821F" CURVE 0x1821F RL_GRID_UBYTE 0 CM_0p75_0 0 191.25
 /begin AXIS_DESCR FIX_AXIS NO_INPUT_QUANTITY CM_IDENTITY 12 0 11 FIX_AXIS_PAR_DIST 0 1 12 /end AXIS_DESCR
/end CHARACTERISTIC
/begin CHARACTERISTIC ST107TMUB "podtverzhdena damos addr 0x1822C | tabgmst dependet basic point (number 7)" CURVE 0x1822C RL_GRID_UBYTE 0 CM_5_50_GradC -50 1225
 /begin AXIS_DESCR FIX_AXIS NO_INPUT_QUANTITY CM_IDENTITY 7 0 6 FIX_AXIS_PAR_DIST 0 1 7 /end AXIS_DESCR
/end CHARACTERISTIC
/begin CHARACTERISTIC ST307TMUB "podtverzhdena damos addr 0x18234 | tkatmst dependet basic point (number 7)" CURVE 0x18234 RL_GRID_UBYTE 0 CM_5_50_GradC -50 1225
 /begin AXIS_DESCR FIX_AXIS NO_INPUT_QUANTITY CM_IDENTITY 7 0 6 FIX_AXIS_PAR_DIST 0 1 7 /end AXIS_DESCR
/end CHARACTERISTIC
/begin CHARACTERISTIC STA06ESUB "podtverzhdena damos addr 0x1823C | Distribution for the air temperature in the intake manifold" CURVE 0x1823C RL_GRID_UBYTE 0 CM_0p75_48_GradC -48 143.25
 /begin AXIS_DESCR FIX_AXIS NO_INPUT_QUANTITY CM_IDENTITY 6 0 5 FIX_AXIS_PAR_DIST 0 1 6 /end AXIS_DESCR
/end CHARACTERISTIC
/begin CHARACTERISTIC STM04__UB "podtverzhdena damos addr 0x18243" CURVE 0x18243 RL_GRID_UBYTE 0 CM_0p75_48_GradC -48 143.25
 /begin AXIS_DESCR FIX_AXIS NO_INPUT_QUANTITY CM_IDENTITY 4 0 3 FIX_AXIS_PAR_DIST 0 1 4 /end AXIS_DESCR
/end CHARACTERISTIC
/begin CHARACTERISTIC STM05SAUB "podtverzhdena damos addr 0x18248 | base point distribution" CURVE 0x18248 RL_GRID_UBYTE 0 CM_0p75_48_GradC -48 143.25
 /begin AXIS_DESCR FIX_AXIS NO_INPUT_QUANTITY CM_IDENTITY 5 0 4 FIX_AXIS_PAR_DIST 0 1 5 /end AXIS_DESCR
/end CHARACTERISTIC
/begin CHARACTERISTIC STM05TMUB "podtverzhdena damos addr 0x1824E | tmst dependet basic point (number 5)" CURVE 0x1824E RL_GRID_UBYTE 0 CM_0p75_48_GradC -48 143.25
 /begin AXIS_DESCR FIX_AXIS NO_INPUT_QUANTITY CM_IDENTITY 5 0 4 FIX_AXIS_PAR_DIST 0 1 5 /end AXIS_DESCR
/end CHARACTERISTIC
/begin CHARACTERISTIC STM06LLUB "podtverzhdena damos addr 0x18254 | Datapoint distribution, engine temperature, 6 datapoints" CURVE 0x18254 RL_GRID_UBYTE 0 CM_0p75_48_GradC -48 143.25
 /begin AXIS_DESCR FIX_AXIS NO_INPUT_QUANTITY CM_IDENTITY 6 0 5 FIX_AXIS_PAR_DIST 0 1 6 /end AXIS_DESCR
/end CHARACTERISTIC
/begin CHARACTERISTIC STM06__UB "podtverzhdena damos addr 0x1825B | Datapoint distribution, engine temperature, 6 datapoints" CURVE 0x1825B RL_GRID_UBYTE 0 CM_0p75_48_GradC -48 143.25
 /begin AXIS_DESCR FIX_AXIS NO_INPUT_QUANTITY CM_IDENTITY 6 0 5 FIX_AXIS_PAR_DIST 0 1 6 /end AXIS_DESCR
/end CHARACTERISTIC
/begin CHARACTERISTIC STM08DMUB "podtverzhdena damos addr 0x18262" CURVE 0x18262 RL_GRID_UBYTE 0 CM_0p75_48_GradC -48 143.25
 /begin AXIS_DESCR FIX_AXIS NO_INPUT_QUANTITY CM_IDENTITY 8 0 7 FIX_AXIS_PAR_DIST 0 1 8 /end AXIS_DESCR
/end CHARACTERISTIC
/begin CHARACTERISTIC STM08LEUB "podtverzhdena damos addr 0x1826B" CURVE 0x1826B RL_GRID_UBYTE 0 CM_0p75_48_GradC -48 143.25
 /begin AXIS_DESCR FIX_AXIS NO_INPUT_QUANTITY CM_IDENTITY 8 0 7 FIX_AXIS_PAR_DIST 0 1 8 /end AXIS_DESCR
/end CHARACTERISTIC
/begin CHARACTERISTIC STM09ESUB "podtverzhdena damos addr 0x18274 | Base point distribution of engine temperature, 9 base pts." CURVE 0x18274 RL_GRID_UBYTE 0 CM_0p75_48_GradC -48 143.25
 /begin AXIS_DESCR FIX_AXIS NO_INPUT_QUANTITY CM_IDENTITY 9 0 8 FIX_AXIS_PAR_DIST 0 1 9 /end AXIS_DESCR
/end CHARACTERISTIC
/begin CHARACTERISTIC STS12ESUB "podtverzhdena damos addr 0x1827E | Distribution for engine coolant temperature at start" CURVE 0x1827E RL_GRID_UBYTE 0 CM_0p75_48_GradC -48 143.25
 /begin AXIS_DESCR FIX_AXIS NO_INPUT_QUANTITY CM_IDENTITY 12 0 11 FIX_AXIS_PAR_DIST 0 1 12 /end AXIS_DESCR
/end CHARACTERISTIC
/begin CHARACTERISTIC STW06MDUB "podtverzhdena damos addr 0x1828B" CURVE 0x1828B RL_GRID_UBYTE 0 CM_0p75_48_GradC -48 143.25
 /begin AXIS_DESCR FIX_AXIS NO_INPUT_QUANTITY CM_IDENTITY 6 0 5 FIX_AXIS_PAR_DIST 0 1 6 /end AXIS_DESCR
/end CHARACTERISTIC
/begin CHARACTERISTIC FLRAG "adres podtverzhden damos-veroyatno addr 0x18291 | IMYA NE PODTVERZHDENO, adres: kod: movb RL5, [r4+#0x290] @0x83AD0C | amplification of load controller at AT" CURVE 0x18291 RL_GRID_UBYTE 0 CM_0p0625_0 0 15.9375
 /begin AXIS_DESCR FIX_AXIS NO_INPUT_QUANTITY CM_IDENTITY 6 0 5 FIX_AXIS_PAR_DIST 0 1 6 /end AXIS_DESCR
/end CHARACTERISTIC
/begin CHARACTERISTIC FLRAWG "adres podtverzhden damos-veroyatno addr 0x18297 | IMYA NE PODTVERZHDENO, adres: kod: movb RL5, [r4+#0x296] @0x83ADB4 | amplification of load controller" CURVE 0x18297 RL_GRID_UBYTE 0 CM_0p0625_0 0 15.9375
 /begin AXIS_DESCR FIX_AXIS NO_INPUT_QUANTITY CM_IDENTITY 6 0 5 FIX_AXIS_PAR_DIST 0 1 6 /end AXIS_DESCR
/end CHARACTERISTIC
/begin CHARACTERISTIC FLRHG "adres podtverzhden damos-veroyatno addr 0x1829D | IMYA NE PODTVERZHDENO, adres: kod: movb RL5, [r4+#0x29c] @0x83AC60 | amplification of load controller" CURVE 0x1829D RL_GRID_UBYTE 0 CM_0p0625_0 0 15.9375
 /begin AXIS_DESCR FIX_AXIS NO_INPUT_QUANTITY CM_IDENTITY 6 0 5 FIX_AXIS_PAR_DIST 0 1 6 /end AXIS_DESCR
/end CHARACTERISTIC
/begin CHARACTERISTIC FRARAG "adres podtverzhden damos-veroyatno addr 0x182A3 | IMYA NE PODTVERZHDENO, adres: kod: movb RL5, [r4+#0x2a2] @0x83AD42 | amplification factor at AT" CURVE 0x182A3 RL_GRID_UBYTE 0 CM_0p01220703125_0_Upm 0 3.11279
 /begin AXIS_DESCR FIX_AXIS NO_INPUT_QUANTITY CM_IDENTITY 6 0 5 FIX_AXIS_PAR_DIST 0 1 6 /end AXIS_DESCR
/end CHARACTERISTIC
/begin CHARACTERISTIC FRARAWG "adres podtverzhden damos-veroyatno addr 0x182A9 | IMYA NE PODTVERZHDENO, adres: kod: movb RL5, [r4+#0x2a8] @0x83ADEA | amplification factor" CURVE 0x182A9 RL_GRID_UBYTE 0 CM_0p01220703125_0_Upm 0 3.11279
 /begin AXIS_DESCR FIX_AXIS NO_INPUT_QUANTITY CM_IDENTITY 6 0 5 FIX_AXIS_PAR_DIST 0 1 6 /end AXIS_DESCR
/end CHARACTERISTIC
/begin CHARACTERISTIC FRARHG "adres podtverzhden damos-veroyatno addr 0x182AF | IMYA NE PODTVERZHDENO, adres: kod: mov ADCON, #0x2af @0x832662 | amplification factor" CURVE 0x182AF RL_GRID_UBYTE 0 CM_0p01220703125_0_Upm 0 3.11279
 /begin AXIS_DESCR FIX_AXIS NO_INPUT_QUANTITY CM_IDENTITY 6 0 5 FIX_AXIS_PAR_DIST 0 1 6 /end AXIS_DESCR
/end CHARACTERISTIC
/begin CHARACTERISTIC RLVMXN "podtverzhdena damos addr 0x182B7 | maximum volumetric flow with open throttle valve" CURVE 0x182B7 RL_GRID_UBYTE 0 CM_0p75_0 0 191.25
 /begin AXIS_DESCR FIX_AXIS NO_INPUT_QUANTITY CM_IDENTITY 11 0 10 FIX_AXIS_PAR_DIST 0 1 11 /end AXIS_DESCR
/end CHARACTERISTIC
/begin CHARACTERISTIC RLVSMXN "podtverzhdena damos addr 0x182CE | maximum volumetric flow with open throttle valve and SU" CURVE 0x182CE RL_GRID_UBYTE 0 CM_0p75_0 0 191.25
 /begin AXIS_DESCR FIX_AXIS NO_INPUT_QUANTITY CM_IDENTITY 11 0 10 FIX_AXIS_PAR_DIST 0 1 11 /end AXIS_DESCR
/end CHARACTERISTIC
/begin CHARACTERISTIC DFAUWKN "adres podtverzhden damos-veroyatno addr 0x182E6 | IMYA NE PODTVERZHDENO, adres: kod: mov r12, #0x2e6 @0x83BBE8 | Damping ratio for filtering torque on a low clutch torque and op. lockup clutch" CURVE 0x182E6 RL_GRID_UBYTE 0 CM_0p00390625_0 0 0.996094
 /begin AXIS_DESCR FIX_AXIS NO_INPUT_QUANTITY CM_IDENTITY 6 0 5 FIX_AXIS_PAR_DIST 0 1 6 /end AXIS_DESCR
/end CHARACTERISTIC
/begin CHARACTERISTIC DFAWKN "adres podtverzhden damos-veroyatno addr 0x182EC | IMYA NE PODTVERZHDENO, adres: kod: mov r12, #0x2ec @0x83BC1E | Damping ratio for filtering torque on an openned lockup clutch" CURVE 0x182EC RL_GRID_UBYTE 0 CM_0p00390625_0 0 0.996094
 /begin AXIS_DESCR FIX_AXIS NO_INPUT_QUANTITY CM_IDENTITY 6 0 5 FIX_AXIS_PAR_DIST 0 1 6 /end AXIS_DESCR
/end CHARACTERISTIC
/begin CHARACTERISTIC KFDMDFA "podtverzhdena damos-tochno addr 0x182F5 | Map Damping ratio for filtering motors torque" MAP 0x182F5 RL_GRID_UBYTE 0 CM_0p00390625_0 0 0.996094
 /begin AXIS_DESCR COM_AXIS NO_INPUT_QUANTITY CM_40_0_rpm 6 0 10200 AXIS_PTS_REF SNM06_DM /end AXIS_DESCR
 /begin AXIS_DESCR FIX_AXIS NO_INPUT_QUANTITY CM_IDENTITY 6 0 5 FIX_AXIS_PAR_DIST 0 1 6 /end AXIS_DESCR
/end CHARACTERISTIC
/begin CHARACTERISTIC KFDMDFAS "podtverzhdena damos-tochno addr 0x18319 | Map Damping ratio for filtering motor torque on fuel feed restart" MAP 0x18319 RL_GRID_UBYTE 0 CM_0p00390625_0 0 0.996094
 /begin AXIS_DESCR COM_AXIS NO_INPUT_QUANTITY CM_40_0_rpm 6 0 10200 AXIS_PTS_REF SNM06_DM /end AXIS_DESCR
 /begin AXIS_DESCR FIX_AXIS NO_INPUT_QUANTITY CM_IDENTITY 6 0 5 FIX_AXIS_PAR_DIST 0 1 6 /end AXIS_DESCR
/end CHARACTERISTIC
/begin CHARACTERISTIC KFDMDFAU "podtverzhdena damos-tochno addr 0x1833D | Map damping ratio for filtering motor torque on low clutch torque" MAP 0x1833D RL_GRID_UBYTE 0 CM_0p00390625_0 0 0.996094
 /begin AXIS_DESCR COM_AXIS NO_INPUT_QUANTITY CM_40_0_rpm 6 0 10200 AXIS_PTS_REF SNM06_DM /end AXIS_DESCR
 /begin AXIS_DESCR FIX_AXIS NO_INPUT_QUANTITY CM_IDENTITY 6 0 5 FIX_AXIS_PAR_DIST 0 1 6 /end AXIS_DESCR
/end CHARACTERISTIC
/begin CHARACTERISTIC KFZMDFA "podtverzhdena damos-tochno addr 0x18361 | Map time constant values for filtering motor torque" MAP 0x18361 RL_GRID_UBYTE 0 CM_IDENTITY 0 255
 /begin AXIS_DESCR FIX_AXIS NO_INPUT_QUANTITY CM_IDENTITY 6 0 5 FIX_AXIS_PAR_DIST 0 1 6 /end AXIS_DESCR
 /begin AXIS_DESCR FIX_AXIS NO_INPUT_QUANTITY CM_IDENTITY 6 0 5 FIX_AXIS_PAR_DIST 0 1 6 /end AXIS_DESCR
/end CHARACTERISTIC
/begin CHARACTERISTIC KFZMDFAS "podtverzhdena damos-tochno addr 0x18385 | Map time constant values for filtering motor torque on fuel feed restart" MAP 0x18385 RL_GRID_UBYTE 0 CM_IDENTITY 0 255
 /begin AXIS_DESCR FIX_AXIS NO_INPUT_QUANTITY CM_IDENTITY 6 0 5 FIX_AXIS_PAR_DIST 0 1 6 /end AXIS_DESCR
 /begin AXIS_DESCR FIX_AXIS NO_INPUT_QUANTITY CM_IDENTITY 6 0 5 FIX_AXIS_PAR_DIST 0 1 6 /end AXIS_DESCR
/end CHARACTERISTIC
/begin CHARACTERISTIC KFZMDFAU "podtverzhdena damos-tochno addr 0x183A9 | Map time constant values for filtering motor torque on low clutch torque" MAP 0x183A9 RL_GRID_UBYTE 0 CM_IDENTITY 0 255
 /begin AXIS_DESCR FIX_AXIS NO_INPUT_QUANTITY CM_IDENTITY 6 0 5 FIX_AXIS_PAR_DIST 0 1 6 /end AXIS_DESCR
 /begin AXIS_DESCR FIX_AXIS NO_INPUT_QUANTITY CM_IDENTITY 6 0 5 FIX_AXIS_PAR_DIST 0 1 6 /end AXIS_DESCR
/end CHARACTERISTIC
/begin CHARACTERISTIC ZFAUWKN "adres podtverzhden damos-veroyatno addr 0x183D0 | IMYA NE PODTVERZHDENO, adres: kod: mov r12, #0x3d0 @0x83BC5E | lower time constant value for filt. torque on openned lockup clutch" CURVE 0x183D0 RL_GRID_UBYTE 0 CM_IDENTITY 0 255
 /begin AXIS_DESCR FIX_AXIS NO_INPUT_QUANTITY CM_IDENTITY 6 0 5 FIX_AXIS_PAR_DIST 0 1 6 /end AXIS_DESCR
/end CHARACTERISTIC
/begin CHARACTERISTIC ZFAWKN "adres podtverzhden damos-veroyatno addr 0x183D6 | IMYA NE PODTVERZHDENO, adres: kod: mov r12, #0x3d6 @0x83BC94 | time constant for filtering motor torque on openned lockup clutch" CURVE 0x183D6 RL_GRID_UBYTE 0 CM_IDENTITY 0 255
 /begin AXIS_DESCR FIX_AXIS NO_INPUT_QUANTITY CM_IDENTITY 6 0 5 FIX_AXIS_PAR_DIST 0 1 6 /end AXIS_DESCR
/end CHARACTERISTIC
/begin CHARACTERISTIC REDZEM "podtverzhdena damos addr 0x183DF | threshold between ignition intervention and injector disabling" CURVE 0x183DF RL_GRID_UBYTE 0 CM_IDENTITY 0 255
 /begin AXIS_DESCR FIX_AXIS NO_INPUT_QUANTITY CM_IDENTITY 5 0 4 FIX_AXIS_PAR_DIST 0 1 5 /end AXIS_DESCR
/end CHARACTERISTIC
/begin CHARACTERISTIC WPHN "adres podtverzhden damos-veroyatno addr 0x183EB | IMYA NE PODTVERZHDENO, adres: kod: mov r12, #0x3eb @0x83DA00 | phase correction" CURVE 0x183EB RL_GRID_SBYTE 0 CM_0p75_0_gradKW -96 95.25
 /begin AXIS_DESCR FIX_AXIS NO_INPUT_QUANTITY CM_IDENTITY 8 0 7 FIX_AXIS_PAR_DIST 0 1 8 /end AXIS_DESCR
/end CHARACTERISTIC
/begin CHARACTERISTIC DZWSPM "adres podtverzhden damos-veroyatno addr 0x183F3 | IMYA NE PODTVERZHDENO, adres: kod: mov r12, #0x3f3 @0x83E370 | delta latest ignition angle relative to engine temperature" CURVE 0x183F3 RL_GRID_SBYTE 0 CM_0p75_0_gradKW -96 95.25
 /begin AXIS_DESCR FIX_AXIS NO_INPUT_QUANTITY CM_IDENTITY 6 0 5 FIX_AXIS_PAR_DIST 0 1 6 /end AXIS_DESCR
/end CHARACTERISTIC
/begin CHARACTERISTIC KFTVSA "adres podtverzhden damos-somnitelno addr 0x18449 | IMYA NE PODTVERZHDENO, adres: kod: mov r12, #0x449 @0x83E6D0 | Retard time for overrun fuel cut-off" MAP 0x18449 RL_GRID_UBYTE 0 CM_0p01_0_s 0 2.55
 /begin AXIS_DESCR FIX_AXIS NO_INPUT_QUANTITY CM_IDENTITY 8 0 7 FIX_AXIS_PAR_DIST 0 1 8 /end AXIS_DESCR
 /begin AXIS_DESCR FIX_AXIS NO_INPUT_QUANTITY CM_IDENTITY 5 0 4 FIX_AXIS_PAR_DIST 0 1 5 /end AXIS_DESCR
/end CHARACTERISTIC
/begin CHARACTERISTIC NWECVTM "adres podtverzhden damos-veroyatno addr 0x18471 | IMYA NE PODTVERZHDENO, adres: kod: mov r12, #0x471 @0x83E6AE | Fuel restart-speed at CVT" CURVE 0x18471 RL_GRID_UBYTE 0 CM_40_0_Upm 0 10200
 /begin AXIS_DESCR FIX_AXIS NO_INPUT_QUANTITY CM_IDENTITY 5 0 4 FIX_AXIS_PAR_DIST 0 1 5 /end AXIS_DESCR
/end CHARACTERISTIC
/begin CHARACTERISTIC TVSATM "adres podtverzhden damos-veroyatno addr 0x18476 | IMYA NE PODTVERZHDENO, adres: kod: mov r12, #0x476 @0x83E69A | delay time after cranking for fuel cut off" CURVE 0x18476 RL_GRID_UBYTE 0 CM_IDENTITY 0 255
 /begin AXIS_DESCR FIX_AXIS NO_INPUT_QUANTITY CM_IDENTITY 5 0 4 FIX_AXIS_PAR_DIST 0 1 5 /end AXIS_DESCR
/end CHARACTERISTIC
/begin CHARACTERISTIC DNEVTMOD "podtverzhdena damos addr 0x1847D | char.line delta desired engine speed dependent on evtmod" CURVE 0x1847D RL_GRID_UBYTE 0 CM_10_0_Umin 0 2550
 /begin AXIS_DESCR FIX_AXIS NO_INPUT_QUANTITY CM_IDENTITY 8 0 7 FIX_AXIS_PAR_DIST 0 1 8 /end AXIS_DESCR
/end CHARACTERISTIC
/begin CHARACTERISTIC DNLBZ "podtverzhdena damos addr 0x1848E | Idle speed increase for battery charging balance" CURVE 0x1848E RL_GRID_UBYTE 0 CM_10_0_Umin 0 2550
 /begin AXIS_DESCR FIX_AXIS NO_INPUT_QUANTITY CM_IDENTITY 6 0 5 FIX_AXIS_PAR_DIST 0 1 6 /end AXIS_DESCR
/end CHARACTERISTIC
/begin CHARACTERISTIC FNSSTM "podtverzhdena damos addr 0x1849B | Faktor for taget engine speed during start" CURVE 0x1849B RL_GRID_UBYTE 0 CM_0p0078125_0 0 1.99219
 /begin AXIS_DESCR FIX_AXIS NO_INPUT_QUANTITY CM_IDENTITY 6 0 5 FIX_AXIS_PAR_DIST 0 1 6 /end AXIS_DESCR
/end CHARACTERISTIC
/begin CHARACTERISTIC NFSM "podtverzhdena damos-veroyatno addr 0x184AA | desired engine speed DRIVE-position switch on | smysl podtverzhden CTP7: ZHelaemye oboroty HH (AKPP: DRIVE ON)" CURVE 0x184AA RL_GRID_UBYTE 0 CM_10_0_Umin 0 2550
 /begin AXIS_DESCR FIX_AXIS NO_INPUT_QUANTITY CM_IDENTITY 6 0 5 FIX_AXIS_PAR_DIST 0 1 6 /end AXIS_DESCR
/end CHARACTERISTIC
/begin CHARACTERISTIC NLLM "podtverzhdena damos-veroyatno addr 0x184B0 | desired engine speed | smysl podtverzhden CTP7: ZHelaemye oboroty HH" CURVE 0x184B0 RL_GRID_UBYTE 0 CM_10_0_Umin 0 2550
 /begin AXIS_DESCR FIX_AXIS NO_INPUT_QUANTITY CM_IDENTITY 6 0 5 FIX_AXIS_PAR_DIST 0 1 6 /end AXIS_DESCR
/end CHARACTERISTIC
/begin CHARACTERISTIC NSLPP "podtverzhdena damos addr 0x184B7 | Target speed depending on the pump pressure of power steerung" CURVE 0x184B7 RL_GRID_UBYTE 0 CM_10_0_Umin 0 2550
 /begin AXIS_DESCR FIX_AXIS NO_INPUT_QUANTITY CM_IDENTITY 4 0 3 FIX_AXIS_PAR_DIST 0 1 4 /end AXIS_DESCR
/end CHARACTERISTIC
/begin CHARACTERISTIC NSLPPFS "podtverzhdena damos addr 0x184C0 | Target speed depending on the pump pressure of power steering with B_fs=1" CURVE 0x184C0 RL_GRID_UBYTE 0 CM_10_0_Umin 0 2550
 /begin AXIS_DESCR FIX_AXIS NO_INPUT_QUANTITY CM_IDENTITY 4 0 3 FIX_AXIS_PAR_DIST 0 1 4 /end AXIS_DESCR
/end CHARACTERISTIC
/begin CHARACTERISTIC NTANS "podtverzhdena damos addr 0x184C9 | idle speed rpm tans-dependent" CURVE 0x184C9 RL_GRID_UBYTE 0 CM_10_0_Umin 0 2550
 /begin AXIS_DESCR FIX_AXIS NO_INPUT_QUANTITY CM_IDENTITY 8 0 7 FIX_AXIS_PAR_DIST 0 1 8 /end AXIS_DESCR
/end CHARACTERISTIC
/begin CHARACTERISTIC LIMXDNS "adres podtverzhden damos-veroyatno addr 0x184D9 | IMYA NE PODTVERZHDENO, adres: kod: mov r12, #0x4d9 @0x83F5F4 | upper integrator limit for standing car" CURVE 0x184D9 RL_GRID_UBYTE 0 CM_0p09764705882_0 0 24.9
 /begin AXIS_DESCR FIX_AXIS NO_INPUT_QUANTITY CM_IDENTITY 6 0 5 FIX_AXIS_PAR_DIST 0 1 6 /end AXIS_DESCR
/end CHARACTERISTIC
/begin CHARACTERISTIC LIMXVDNS "adres podtverzhden damos-veroyatno addr 0x184DF | IMYA NE PODTVERZHDENO, adres: kod: mov r12, #0x4df @0x83F5DC | upper integrator limit for rolling car" CURVE 0x184DF RL_GRID_UBYTE 0 CM_0p09764705882_0 0 24.9
 /begin AXIS_DESCR FIX_AXIS NO_INPUT_QUANTITY CM_IDENTITY 6 0 5 FIX_AXIS_PAR_DIST 0 1 6 /end AXIS_DESCR
/end CHARACTERISTIC
/begin CHARACTERISTIC LISTM "adres podtverzhden damos-veroyatno addr 0x184E5 | IMYA NE PODTVERZHDENO, adres: kod: mov r12, #0x4e5 @0x83F482 | value of idle speed control integrator during start" CURVE 0x184E5 RL_GRID_UBYTE 0 CM_0p09764705882_0 0 24.9
 /begin AXIS_DESCR FIX_AXIS NO_INPUT_QUANTITY CM_IDENTITY 6 0 5 FIX_AXIS_PAR_DIST 0 1 6 /end AXIS_DESCR
/end CHARACTERISTIC
/begin CHARACTERISTIC DMDKOE "podtverzhdena damos addr 0x184FC | Start value of torque filter when AC is swiched on" CURVE 0x184FC RL_GRID_UBYTE 0 CM_0p1960784314_0 0 50
 /begin AXIS_DESCR FIX_AXIS NO_INPUT_QUANTITY CM_IDENTITY 6 0 5 FIX_AXIS_PAR_DIST 0 1 6 /end AXIS_DESCR
/end CHARACTERISTIC
/begin CHARACTERISTIC KFMDKO "podtverzhdena damos-tochno addr 0x18516 | map for torque needed for air condition" MAP 0x18516 RL_GRID_UBYTE 0 CM_0p1960784314_0 0 50
 /begin AXIS_DESCR FIX_AXIS NO_INPUT_QUANTITY CM_IDENTITY 6 0 5 FIX_AXIS_PAR_DIST 0 1 6 /end AXIS_DESCR
 /begin AXIS_DESCR FIX_AXIS NO_INPUT_QUANTITY CM_IDENTITY 6 0 5 FIX_AXIS_PAR_DIST 0 1 6 /end AXIS_DESCR
/end CHARACTERISTIC
/begin CHARACTERISTIC FDVANS "podtverzhdena damos addr 0x185E6 | Temperature factor for air at throttle valve" CURVE 0x185E6 RL_GRID_UBYTE 0 CM_0p0078125_0 0 1.99219
 /begin AXIS_DESCR FIX_AXIS NO_INPUT_QUANTITY CM_IDENTITY 8 0 7 FIX_AXIS_PAR_DIST 0 1 8 /end AXIS_DESCR
/end CHARACTERISTIC
/begin CHARACTERISTIC FWFTBRTA "podtverzhdena damos addr 0x185F7 | Weighting for ftbr as a function of tans" CURVE 0x185F7 RL_GRID_UBYTE 0 CM_0p0078125_0 0 1.99219
 /begin AXIS_DESCR FIX_AXIS NO_INPUT_QUANTITY CM_IDENTITY 14 0 13 FIX_AXIS_PAR_DIST 0 1 14 /end AXIS_DESCR
/end CHARACTERISTIC
/begin CHARACTERISTIC FZPUSA "podtverzhdena damos addr 0x1867D | correction faktor time constant ambient pressure adaptation during fuel cut-off" CURVE 0x1867D RL_GRID_UBYTE 0 CM_0p0078125_0 0 1.99219
 /begin AXIS_DESCR FIX_AXIS NO_INPUT_QUANTITY CM_IDENTITY 8 0 7 FIX_AXIS_PAR_DIST 0 1 8 /end AXIS_DESCR
/end CHARACTERISTIC
/begin CHARACTERISTIC WDKHKDN "podtverzhdena damos addr 0x18695 | High threshold throttle plate for altitude adaptation" CURVE 0x18695 RL_GRID_UBYTE 0 CM_0p390625_0 0 99.6094
 /begin AXIS_DESCR FIX_AXIS NO_INPUT_QUANTITY CM_IDENTITY 6 0 5 FIX_AXIS_PAR_DIST 0 1 6 /end AXIS_DESCR
/end CHARACTERISTIC
/begin CHARACTERISTIC WDKHKN "adres podtverzhden damos-veroyatno addr 0x186A2 | IMYA NE PODTVERZHDENO, adres: kod: mov r12, #0x6a1 @0x84468A | Low threshold throttle plate for altitude adaptation" CURVE 0x186A2 RL_GRID_UBYTE 0 CM_0p390625_0 0 99.6094
 /begin AXIS_DESCR FIX_AXIS NO_INPUT_QUANTITY CM_IDENTITY 6 0 5 FIX_AXIS_PAR_DIST 0 1 6 /end AXIS_DESCR
/end CHARACTERISTIC
/begin CHARACTERISTIC WPUAVLN "podtverzhdena damos addr 0x186AF | Throttle valve angle as of which VL ambient pressure adaptation is active" CURVE 0x186AF RL_GRID_UBYTE 0 CM_0p3921568627_0_DK 0 100
 /begin AXIS_DESCR FIX_AXIS NO_INPUT_QUANTITY CM_IDENTITY 12 0 11 FIX_AXIS_PAR_DIST 0 1 12 /end AXIS_DESCR
/end CHARACTERISTIC
/begin CHARACTERISTIC WPUAVLSN "podtverzhdena damos addr 0x186C8 | Throttle valve angle as of which VL ambient pressure adaptation is blocked" CURVE 0x186C8 RL_GRID_UBYTE 0 CM_0p3921568627_0_DK 0 100
 /begin AXIS_DESCR FIX_AXIS NO_INPUT_QUANTITY CM_IDENTITY 12 0 11 FIX_AXIS_PAR_DIST 0 1 12 /end AXIS_DESCR
/end CHARACTERISTIC
/begin CHARACTERISTIC KFFTAGRV "podtverzhdena damos addr 0x186F6 | Factor for temperature decrease between EGR line and EGR valve" MAP 0x186F6 RL_GRID_UBYTE 0 CM_0p0078125_0 0 1.99219
 /begin AXIS_DESCR FIX_AXIS NO_INPUT_QUANTITY CM_IDENTITY 6 0 5 FIX_AXIS_PAR_DIST 0 1 6 /end AXIS_DESCR
 /begin AXIS_DESCR FIX_AXIS NO_INPUT_QUANTITY CM_IDENTITY 8 0 7 FIX_AXIS_PAR_DIST 0 1 8 /end AXIS_DESCR
/end CHARACTERISTIC
/begin CHARACTERISTIC KFFTDAG "podtverzhdena damos addr 0x18736 | Factor for temperatur decrease between EGR line and EGR induction" MAP 0x18736 RL_GRID_UBYTE 0 CM_0p0078125_0 0 1.99219
 /begin AXIS_DESCR FIX_AXIS NO_INPUT_QUANTITY CM_IDENTITY 6 0 5 FIX_AXIS_PAR_DIST 0 1 6 /end AXIS_DESCR
 /begin AXIS_DESCR FIX_AXIS NO_INPUT_QUANTITY CM_IDENTITY 8 0 7 FIX_AXIS_PAR_DIST 0 1 8 /end AXIS_DESCR
/end CHARACTERISTIC
/begin CHARACTERISTIC KFSU "podtverzhdena damos addr 0x18775 | Load/speed performance characteristics for suction tube switchover" MAP 0x18775 RL_GRID_UBYTE 0 CM_IDENTITY 0 255
 /begin AXIS_DESCR FIX_AXIS NO_INPUT_QUANTITY CM_IDENTITY 6 0 5 FIX_AXIS_PAR_DIST 0 1 6 /end AXIS_DESCR
 /begin AXIS_DESCR FIX_AXIS NO_INPUT_QUANTITY CM_IDENTITY 6 0 5 FIX_AXIS_PAR_DIST 0 1 6 /end AXIS_DESCR
/end CHARACTERISTIC
/begin CHARACTERISTIC KFSU2 "podtverzhdena damos addr 0x187A7 | map for intake manifold switch over, flap 2" MAP 0x187A7 RL_GRID_UBYTE 0 CM_IDENTITY 0 255
 /begin AXIS_DESCR FIX_AXIS NO_INPUT_QUANTITY CM_IDENTITY 6 0 5 FIX_AXIS_PAR_DIST 0 1 6 /end AXIS_DESCR
 /begin AXIS_DESCR FIX_AXIS NO_INPUT_QUANTITY CM_IDENTITY 6 0 5 FIX_AXIS_PAR_DIST 0 1 6 /end AXIS_DESCR
/end CHARACTERISTIC
/begin CHARACTERISTIC TVSUM "podtverzhdena damos addr 0x187D5 | delay time for intake manifold switch over in dependence of engine temperatur" CURVE 0x187D5 RL_GRID_UBYTE 0 CM_0p1_0_s 0 25.5
 /begin AXIS_DESCR FIX_AXIS NO_INPUT_QUANTITY CM_IDENTITY 6 0 5 FIX_AXIS_PAR_DIST 0 1 6 /end AXIS_DESCR
/end CHARACTERISTIC
/begin CHARACTERISTIC ATMABKA "adres podtverzhden damos-veroyatno addr 0x187E2 | IMYA NE PODTVERZHDENO, adres: kod: mov r12, #0x7e2 @0x845E20 | factor reduction of exhaust gas temperature = f(soak time)" CURVE 0x187E2 RL_GRID_UBYTE 0 CM_0p00390625_0 0 0.996094
 /begin AXIS_DESCR FIX_AXIS NO_INPUT_QUANTITY CM_IDENTITY 6 0 5 FIX_AXIS_PAR_DIST 0 1 6 /end AXIS_DESCR
/end CHARACTERISTIC
/begin CHARACTERISTIC ATMABKK "adres podtverzhden damos-veroyatno addr 0x187E8 | IMYA NE PODTVERZHDENO, adres: kod: mov r12, #0x7e8 @0x845E8C | factor reduction for catalyst temperature = f(soak time)" CURVE 0x187E8 RL_GRID_UBYTE 0 CM_0p00390625_0 0 0.996094
 /begin AXIS_DESCR FIX_AXIS NO_INPUT_QUANTITY CM_IDENTITY 6 0 5 FIX_AXIS_PAR_DIST 0 1 6 /end AXIS_DESCR
/end CHARACTERISTIC
/begin CHARACTERISTIC FATMRML "adres podtverzhden damos-veroyatno addr 0x187EF | IMYA NE PODTVERZHDENO, adres: kod: mov r12, #0x7ef @0x845B92 | divide factor exhaust-/exhaust-pipe temperature" CURVE 0x187EF RL_GRID_UBYTE 0 CM_0p00390625_0 0 0.996094
 /begin AXIS_DESCR FIX_AXIS NO_INPUT_QUANTITY CM_IDENTITY 7 0 6 FIX_AXIS_PAR_DIST 0 1 7 /end AXIS_DESCR
/end CHARACTERISTIC
/begin CHARACTERISTIC KATMEXML "adres podtverzhden damos-veroyatno addr 0x187F9 | IMYA NE PODTVERZHDENO, adres: kod: mov r12, #0x7f9 @0x845CAA | Temperature of the exotherme in the catalyst tkatm" CURVE 0x187F9 RL_GRID_SBYTE 0 CM_5_0_GradC -640 635
 /begin AXIS_DESCR FIX_AXIS NO_INPUT_QUANTITY CM_IDENTITY 7 0 6 FIX_AXIS_PAR_DIST 0 1 7 /end AXIS_DESCR
/end CHARACTERISTIC
/begin CHARACTERISTIC KFATMLA "podtverzhdena damos-tochno addr 0x18800 | map exhaust gas temperature correction = f(lambda)" MAP 0x18800 RL_GRID_SBYTE 0 CM_5_0_GradC -640 635
 /begin AXIS_DESCR FIX_AXIS NO_INPUT_QUANTITY CM_IDENTITY 6 0 5 FIX_AXIS_PAR_DIST 0 1 6 /end AXIS_DESCR
 /begin AXIS_DESCR FIX_AXIS NO_INPUT_QUANTITY CM_IDENTITY 6 0 5 FIX_AXIS_PAR_DIST 0 1 6 /end AXIS_DESCR
/end CHARACTERISTIC
/begin CHARACTERISTIC KFATMZW "podtverzhdena damos-tochno addr 0x18824 | map exhaust gas temperature correktion = f(ignition-variation)" MAP 0x18824 RL_GRID_SBYTE 0 CM_5_0_GradC -640 635
 /begin AXIS_DESCR FIX_AXIS NO_INPUT_QUANTITY CM_IDENTITY 6 0 5 FIX_AXIS_PAR_DIST 0 1 6 /end AXIS_DESCR
 /begin AXIS_DESCR FIX_AXIS NO_INPUT_QUANTITY CM_IDENTITY 6 0 5 FIX_AXIS_PAR_DIST 0 1 6 /end AXIS_DESCR
/end CHARACTERISTIC
/begin CHARACTERISTIC KFTATM "podtverzhdena damos-tochno addr 0x1885A | map exhaust gas temperature f(nmot,rl)" MAP 0x1885A RL_GRID_SBYTE 0 CM_5_50_GradC -690 585
 /begin AXIS_DESCR FIX_AXIS NO_INPUT_QUANTITY CM_IDENTITY 8 0 7 FIX_AXIS_PAR_DIST 0 1 8 /end AXIS_DESCR
 /begin AXIS_DESCR FIX_AXIS NO_INPUT_QUANTITY CM_IDENTITY 8 0 7 FIX_AXIS_PAR_DIST 0 1 8 /end AXIS_DESCR
/end CHARACTERISTIC
/begin CHARACTERISTIC KFTPKOR "podtverzhdena damos-tochno addr 0x18907 | correction map for the measured cycle duration TP (tpsvkof)" MAP 0x18907 RL_GRID_UBYTE 0 CM_0p0078125_0 0 1.99219
 /begin AXIS_DESCR FIX_AXIS NO_INPUT_QUANTITY CM_IDENTITY 7 0 6 FIX_AXIS_PAR_DIST 0 1 7 /end AXIS_DESCR
 /begin AXIS_DESCR FIX_AXIS NO_INPUT_QUANTITY CM_IDENTITY 8 0 7 FIX_AXIS_PAR_DIST 0 1 8 /end AXIS_DESCR
/end CHARACTERISTIC
/begin CHARACTERISTIC FFRITMS "podtverzhdena damos addr 0x1898F | tmst dependent factor to modify I-dynamic of lambda control" CURVE 0x1898F RL_GRID_UBYTE 0 CM_0p00390625_0 0 0.996094
 /begin AXIS_DESCR FIX_AXIS NO_INPUT_QUANTITY CM_IDENTITY 4 0 3 FIX_AXIS_PAR_DIST 0 1 4 /end AXIS_DESCR
/end CHARACTERISTIC
/begin CHARACTERISTIC FTMLAKH "adres podtverzhden damos-veroyatno addr 0x18BB0 | IMYA NE PODTVERZHDENO, adres: kod: mov r12, #0xbaf @0x84D4D8 | tmot-correction of lambda-weighting at catalyst heating" CURVE 0x18BB0 RL_GRID_UBYTE 0 CM_0p00390625_0 0 0.996094
 /begin AXIS_DESCR FIX_AXIS NO_INPUT_QUANTITY CM_IDENTITY 4 0 3 FIX_AXIS_PAR_DIST 0 1 4 /end AXIS_DESCR
/end CHARACTERISTIC
/begin CHARACTERISTIC KFNLLKHM "podtverzhdena damos addr 0x18BC7 | Nominal idling speed during catalyzer heating" MAP 0x18BC7 RL_GRID_UBYTE 0 CM_10_0_Umin 0 2550
 /begin AXIS_DESCR FIX_AXIS NO_INPUT_QUANTITY CM_IDENTITY 4 0 3 FIX_AXIS_PAR_DIST 0 1 4 /end AXIS_DESCR
 /begin AXIS_DESCR FIX_AXIS NO_INPUT_QUANTITY CM_IDENTITY 8 0 7 FIX_AXIS_PAR_DIST 0 1 8 /end AXIS_DESCR
/end CHARACTERISTIC
/begin CHARACTERISTIC MLSUS "podtverzhdena damos addr 0x18BE9 | reference of air mass flow integral" CURVE 0x18BE9 RL_GRID_UBYTE 0 CM_0p02275555556_0_kg 0 5.80267
 /begin AXIS_DESCR FIX_AXIS NO_INPUT_QUANTITY CM_IDENTITY 12 0 11 FIX_AXIS_PAR_DIST 0 1 12 /end AXIS_DESCR
/end CHARACTERISTIC
/begin CHARACTERISTIC NFSKHM "adres podtverzhden damos-veroyatno addr 0x18C01 | IMYA NE PODTVERZHDENO, adres: kod: mov r12, #0xc01 @0x84D3B2 | LL nominal speed with driving graduations and catalyzer heating" CURVE 0x18C01 RL_GRID_UBYTE 0 CM_10_0_Umin 0 2550
 /begin AXIS_DESCR FIX_AXIS NO_INPUT_QUANTITY CM_IDENTITY 4 0 3 FIX_AXIS_PAR_DIST 0 1 4 /end AXIS_DESCR
/end CHARACTERISTIC
/begin CHARACTERISTIC FMDKHFH "adres podtverzhden damos-veroyatno addr 0x18C10 | IMYA NE PODTVERZHDENO, adres: kod: mov r12, #0xc0f @0x84D762 | altitude correction of torque reserve for catalyst heating" CURVE 0x18C10 RL_GRID_UBYTE 0 CM_0p0078125_0 0 1.99219
 /begin AXIS_DESCR FIX_AXIS NO_INPUT_QUANTITY CM_IDENTITY 4 0 3 FIX_AXIS_PAR_DIST 0 1 4 /end AXIS_DESCR
/end CHARACTERISTIC
/begin CHARACTERISTIC FMDKHTM "adres podtverzhden damos-veroyatno addr 0x18C19 | IMYA NE PODTVERZHDENO, adres: kod: mov r12, #0xc18 @0x84D776 | tmot-correction of torque reserve for catalyst heating" CURVE 0x18C19 RL_GRID_UBYTE 0 CM_0p0078125_0 0 1.99219
 /begin AXIS_DESCR FIX_AXIS NO_INPUT_QUANTITY CM_IDENTITY 8 0 7 FIX_AXIS_PAR_DIST 0 1 8 /end AXIS_DESCR
/end CHARACTERISTIC
/begin CHARACTERISTIC KFEKWTMP "podtverzhdena damos-tochno addr 0x18CD7 | characteristic diagram efficiency while keeping catalyst warm" MAP 0x18CD7 RL_GRID_UBYTE 0 CM_0p5_0 0 127.5
 /begin AXIS_DESCR FIX_AXIS NO_INPUT_QUANTITY CM_IDENTITY 4 0 3 FIX_AXIS_PAR_DIST 0 1 4 /end AXIS_DESCR
 /begin AXIS_DESCR FIX_AXIS NO_INPUT_QUANTITY CM_IDENTITY 4 0 3 FIX_AXIS_PAR_DIST 0 1 4 /end AXIS_DESCR
/end CHARACTERISTIC
/begin CHARACTERISTIC DWKRMSN "adres podtverzhden damos-veroyatno addr 0x18E5D | IMYA NE PODTVERZHDENO, adres: kod: mov r12, #0xe5d @0x84E464 | delta ignition angle knock control distance from mean retarding" CURVE 0x18E5D RL_GRID_SBYTE 0 CM_n0p75_0_gradKW -95.25 96
 /begin AXIS_DESCR FIX_AXIS NO_INPUT_QUANTITY CM_IDENTITY 16 0 15 FIX_AXIS_PAR_DIST 0 1 16 /end AXIS_DESCR
/end CHARACTERISTIC
/begin CHARACTERISTIC KRAL1N "adres podtverzhden damos-veroyatno addr 0x18E6D | IMYA NE PODTVERZHDENO, adres: kod: mov r12, #0xe6d @0x84E478 | load range for adaption maps 1" CURVE 0x18E6D RL_GRID_UBYTE 0 CM_0p75_0 0 191.25
 /begin AXIS_DESCR FIX_AXIS NO_INPUT_QUANTITY CM_IDENTITY 16 0 15 FIX_AXIS_PAR_DIST 0 1 16 /end AXIS_DESCR
/end CHARACTERISTIC
/begin CHARACTERISTIC KRAL2N "adres podtverzhden damos-veroyatno addr 0x18E7D | IMYA NE PODTVERZHDENO, adres: kod: mov r12, #0xe7d @0x84E48C | load range dor adaption maps 2" CURVE 0x18E7D RL_GRID_UBYTE 0 CM_0p75_0 0 191.25
 /begin AXIS_DESCR FIX_AXIS NO_INPUT_QUANTITY CM_IDENTITY 16 0 15 FIX_AXIS_PAR_DIST 0 1 16 /end AXIS_DESCR
/end CHARACTERISTIC
/begin CHARACTERISTIC KRFKN "adres podtverzhden damos-veroyatno addr 0x18F05 | IMYA NE PODTVERZHDENO, adres: kod: mov r12, #0xf05 @0x84EE9E | retard step knock occurrence" CURVE 0x18F05 RL_GRID_SBYTE 0 CM_n0p75_0_gradKW -95.25 96
 /begin AXIS_DESCR FIX_AXIS NO_INPUT_QUANTITY CM_IDENTITY 16 0 15 FIX_AXIS_PAR_DIST 0 1 16 /end AXIS_DESCR
/end CHARACTERISTIC
/begin CHARACTERISTIC KRMXN "adres podtverzhden damos-veroyatno addr 0x18F15 | IMYA NE PODTVERZHDENO, adres: kod: mov r12, #0xf15 @0x84EE62 | maximum retard adjustment" CURVE 0x18F15 RL_GRID_SBYTE 0 CM_n0p75_0_gradKW -95.25 96
 /begin AXIS_DESCR FIX_AXIS NO_INPUT_QUANTITY CM_IDENTITY 16 0 15 FIX_AXIS_PAR_DIST 0 1 16 /end AXIS_DESCR
/end CHARACTERISTIC
/begin CHARACTERISTIC KRNLZAR "adres podtverzhden damos-veroyatno addr 0x18F25 | IMYA NE PODTVERZHDENO, adres: kod: movb RL5, [r4+#0xf25] @0x84EA90 | cylinder individual rpm limit for lead by leading cylinder" CURVE 0x18F25 RL_GRID_UBYTE 0 CM_40_0_Upm 0 10200
 /begin AXIS_DESCR FIX_AXIS NO_INPUT_QUANTITY CM_IDENTITY 8 0 7 FIX_AXIS_PAR_DIST 0 1 8 /end AXIS_DESCR
/end CHARACTERISTIC
/begin CHARACTERISTIC KRVFN "adres podtverzhden damos-veroyatno addr 0x18F2D | IMYA NE PODTVERZHDENO, adres: kod: mov r12, #0xf2d @0x83F368 | number of firings/cyl. or time for ignition advancing" CURVE 0x18F2D RL_GRID_UBYTE 0 CM_IDENTITY 0 255
 /begin AXIS_DESCR FIX_AXIS NO_INPUT_QUANTITY CM_IDENTITY 16 0 15 FIX_AXIS_PAR_DIST 0 1 16 /end AXIS_DESCR
/end CHARACTERISTIC
/begin CHARACTERISTIC LKRN "adres podtverzhden damos-veroyatno addr 0x18F4D | IMYA NE PODTVERZHDENO, adres: kod: mov r12, #0xf4d @0x84EE4E | load-signal threshold knock control" CURVE 0x18F4D RL_GRID_UBYTE 0 CM_0p75_0 0 191.25
 /begin AXIS_DESCR FIX_AXIS NO_INPUT_QUANTITY CM_IDENTITY 16 0 15 FIX_AXIS_PAR_DIST 0 1 16 /end AXIS_DESCR
/end CHARACTERISTIC
/begin CHARACTERISTIC KFWEE "podtverzhdena damos-tochno addr 0x18FF8 | characteristic map angle end of injection" MAP 0x18FF8 RL_GRID_UBYTE 0 CM_6_0_GradKW 0 1530
 /begin AXIS_DESCR COM_AXIS NO_INPUT_QUANTITY CM_40_0_rpm 8 0 10200 AXIS_PTS_REF SNM08_WE /end AXIS_DESCR
 /begin AXIS_DESCR COM_AXIS NO_INPUT_QUANTITY CM_0p75_0 8 0 191.25 AXIS_PTS_REF SRL08_WE /end AXIS_DESCR
/end CHARACTERISTIC
/begin CHARACTERISTIC KFWEEK "podtverzhdena damos-tochno addr 0x19038 | map for end of injection angle (cold parameters)" MAP 0x19038 RL_GRID_UBYTE 0 CM_6_0_GradKW 0 1530
 /begin AXIS_DESCR COM_AXIS NO_INPUT_QUANTITY CM_40_0_rpm 8 0 10200 AXIS_PTS_REF SNM08_WE /end AXIS_DESCR
 /begin AXIS_DESCR COM_AXIS NO_INPUT_QUANTITY CM_0p75_0 8 0 191.25 AXIS_PTS_REF SRL08_WE /end AXIS_DESCR
/end CHARACTERISTIC
/begin CHARACTERISTIC SNM08GKUB "adres podtverzhden damos-veroyatno addr 0x19079 | IMYA NE PODTVERZHDENO, adres: kod: mov r12, #0x1078 @0x8429E8 | Datapoint distribution mixture control 8 nmot datapoints" CURVE 0x19079 RL_GRID_UBYTE 0 CM_40_0_Upm 0 10200
 /begin AXIS_DESCR FIX_AXIS NO_INPUT_QUANTITY CM_IDENTITY 8 0 7 FIX_AXIS_PAR_DIST 0 1 8 /end AXIS_DESCR
/end CHARACTERISTIC
/begin CHARACTERISTIC WEAN "adres podtverzhden damos-veroyatno addr 0x19093 | IMYA NE PODTVERZHDENO, adres: kod: mov r12, #0x1093 @0x8516F2 | angle injection break off" CURVE 0x19093 RL_GRID_UBYTE 0 CM_6_0_GradKW 0 1530
 /begin AXIS_DESCR FIX_AXIS NO_INPUT_QUANTITY CM_IDENTITY 8 0 7 FIX_AXIS_PAR_DIST 0 1 8 /end AXIS_DESCR
/end CHARACTERISTIC
/begin CHARACTERISTIC WEEM "podtverzhdena damos-veroyatno addr 0x1909B | correction of prestorage angle | smysl podtverzhden CTP7: Korrekciya fazy vpryska (pravka 0 -> 102)" CURVE 0x1909B RL_GRID_UBYTE 0 CM_6_0_GradKW 0 1530
 /begin AXIS_DESCR FIX_AXIS NO_INPUT_QUANTITY CM_IDENTITY 8 0 7 FIX_AXIS_PAR_DIST 0 1 8 /end AXIS_DESCR
/end CHARACTERISTIC
/begin CHARACTERISTIC WEEMRFAN "adres podtverzhden damos-veroyatno addr 0x190A3 | IMYA NE PODTVERZHDENO, adres: kod: mov r12, #0x10a3 @0x851640 | end of injection angle at max relative driver request" CURVE 0x190A3 RL_GRID_UBYTE 0 CM_6_0_GradKW 0 1530
 /begin AXIS_DESCR FIX_AXIS NO_INPUT_QUANTITY CM_IDENTITY 8 0 7 FIX_AXIS_PAR_DIST 0 1 8 /end AXIS_DESCR
/end CHARACTERISTIC
/begin CHARACTERISTIC WEESTM "adres podtverzhden damos-veroyatno addr 0x190AB | IMYA NE PODTVERZHDENO, adres: kod: mov r12, #0x10ab @0x8516D8 | correction of pretiming of injection during start" CURVE 0x190AB RL_GRID_UBYTE 0 CM_6_0_GradKW 0 1530
 /begin AXIS_DESCR FIX_AXIS NO_INPUT_QUANTITY CM_IDENTITY 8 0 7 FIX_AXIS_PAR_DIST 0 1 8 /end AXIS_DESCR
/end CHARACTERISTIC
/begin CHARACTERISTIC WEESTN "podtverzhdena damos addr 0x190B4 | end of injection angle during start" CURVE 0x190B4 RL_GRID_UBYTE 0 CM_6_0_GradKW 0 1530
 /begin AXIS_DESCR FIX_AXIS NO_INPUT_QUANTITY CM_IDENTITY 4 0 3 FIX_AXIS_PAR_DIST 0 1 4 /end AXIS_DESCR
/end CHARACTERISTIC
/begin CHARACTERISTIC ZZWEETM "adres podtverzhden damos-veroyatno addr 0x190BD | IMYA NE PODTVERZHDENO, adres: kod: mov r12, #0x10bc @0x8515F6 | Switchover threshold pattern angle" CURVE 0x190BD RL_GRID_UBYTE 0 CM_IDENTITY 0 255
 /begin AXIS_DESCR FIX_AXIS NO_INPUT_QUANTITY CM_IDENTITY 8 0 7 FIX_AXIS_PAR_DIST 0 1 8 /end AXIS_DESCR
/end CHARACTERISTIC
/begin CHARACTERISTIC KFLF "podtverzhdena damos addr 0x190EC | lambda characteristic map at part load" MAP 0x190EC RL_GRID_UBYTE 0 CM_0p0078125_0 0 1.99219
 /begin AXIS_DESCR FIX_AXIS NO_INPUT_QUANTITY CM_IDENTITY 16 0 15 FIX_AXIS_PAR_DIST 0 1 16 /end AXIS_DESCR
 /begin AXIS_DESCR FIX_AXIS NO_INPUT_QUANTITY CM_IDENTITY 12 0 11 FIX_AXIS_PAR_DIST 0 1 12 /end AXIS_DESCR
/end CHARACTERISTIC
/begin CHARACTERISTIC FSTHO "adres podtverzhden damos-veroyatno addr 0x191AD | IMYA NE PODTVERZHDENO, adres: kod: mov r12, #0x11ac @0x851A5A | weighting of factor start" CURVE 0x191AD RL_GRID_UBYTE 0 CM_0p0078125_0 0 1.99219
 /begin AXIS_DESCR FIX_AXIS NO_INPUT_QUANTITY CM_IDENTITY 4 0 3 FIX_AXIS_PAR_DIST 0 1 4 /end AXIS_DESCR
/end CHARACTERISTIC
/begin CHARACTERISTIC FNSA "adres podtverzhden damos-veroyatno addr 0x191B5 | IMYA NE PODTVERZHDENO, adres: kod: mov r12, #0x11b5 @0x851CFC | after start increase" CURVE 0x191B5 RL_GRID_UBYTE 0 CM_0p0078125_0 0 1.99219
 /begin AXIS_DESCR FIX_AXIS NO_INPUT_QUANTITY CM_IDENTITY 6 0 5 FIX_AXIS_PAR_DIST 0 1 6 /end AXIS_DESCR
/end CHARACTERISTIC
/begin CHARACTERISTIC FNSHO "adres podtverzhden damos-veroyatno addr 0x191BC | IMYA NE PODTVERZHDENO, adres: kod: mov r12, #0x11bb @0x851D9C | weighting of afterstart enrichment" CURVE 0x191BC RL_GRID_UBYTE 0 CM_0p0078125_0 0 1.99219
 /begin AXIS_DESCR FIX_AXIS NO_INPUT_QUANTITY CM_IDENTITY 4 0 3 FIX_AXIS_PAR_DIST 0 1 4 /end AXIS_DESCR
/end CHARACTERISTIC
/begin CHARACTERISTIC KFLBTS "podtverzhdena profil addr 0x19636 | Celevaya lyambda zaschity komponentov. Stok obogaschaet do 0.789 na vysokoy nagruzke, csok do 0.844, MPower -- 1.000 vo vseh 192 yacheykah, to est obogaschenie zasc" MAP 0x19636 RL_GRID_UBYTE 0 CM_0p0078125_0 0 1.99219
 /begin AXIS_DESCR COM_AXIS NO_INPUT_QUANTITY CM_40_0_rpm 16 0 10200 AXIS_PTS_REF SNM16_GK /end AXIS_DESCR
 /begin AXIS_DESCR COM_AXIS NO_INPUT_QUANTITY CM_0p75_0 12 0 191.25 AXIS_PTS_REF SRL12_GK /end AXIS_DESCR
/end CHARACTERISTIC
/begin CHARACTERISTIC KFTKONS "podtverzhdena damos-tochno addr 0x1972A | A/C switch-on delay time (morning brake sharpness)" MAP 0x1972A RL_GRID_UBYTE 0 CM_IDENTITY 0 255
 /begin AXIS_DESCR FIX_AXIS NO_INPUT_QUANTITY CM_IDENTITY 8 0 7 FIX_AXIS_PAR_DIST 0 1 8 /end AXIS_DESCR
 /begin AXIS_DESCR FIX_AXIS NO_INPUT_QUANTITY CM_IDENTITY 8 0 7 FIX_AXIS_PAR_DIST 0 1 8 /end AXIS_DESCR
/end CHARACTERISTIC
/begin CHARACTERISTIC KFFTEAX "podtverzhdena damos addr 0x1982B | Characteristic map for limitation of the purge rate" MAP 0x1982B RL_GRID_UBYTE 0 CM_0p001953125_0 0 0.498047
 /begin AXIS_DESCR FIX_AXIS NO_INPUT_QUANTITY CM_IDENTITY 4 0 3 FIX_AXIS_PAR_DIST 0 1 4 /end AXIS_DESCR
 /begin AXIS_DESCR FIX_AXIS NO_INPUT_QUANTITY CM_IDENTITY 5 0 4 FIX_AXIS_PAR_DIST 0 1 5 /end AXIS_DESCR
/end CHARACTERISTIC
/begin CHARACTERISTIC KFQTE "podtverzhdena damos-tochno addr 0x1983F | Map for purge rate increase / decrease" MAP 0x1983F RL_GRID_UBYTE 0 CM_4p768359375En05_0_1s 0 0.0121593
 /begin AXIS_DESCR FIX_AXIS NO_INPUT_QUANTITY CM_IDENTITY 5 0 4 FIX_AXIS_PAR_DIST 0 1 5 /end AXIS_DESCR
 /begin AXIS_DESCR FIX_AXIS NO_INPUT_QUANTITY CM_IDENTITY 6 0 5 FIX_AXIS_PAR_DIST 0 1 6 /end AXIS_DESCR
/end CHARACTERISTIC
/begin CHARACTERISTIC KFTATX "podtverzhdena damos addr 0x1986F | map for max. duty cycle" MAP 0x1986F RL_GRID_UBYTE 0 CM_0p390625_0 0 99.6094
 /begin AXIS_DESCR FIX_AXIS NO_INPUT_QUANTITY CM_IDENTITY 6 0 5 FIX_AXIS_PAR_DIST 0 1 6 /end AXIS_DESCR
 /begin AXIS_DESCR FIX_AXIS NO_INPUT_QUANTITY CM_IDENTITY 10 0 9 FIX_AXIS_PAR_DIST 0 1 10 /end AXIS_DESCR
/end CHARACTERISTIC
/begin CHARACTERISTIC KFTEVP "podtverzhdena damos-tochno addr 0x198C4 | Characteristic map for period time of the PCV" MAP 0x198C4 RL_GRID_UBYTE 0 CM_0p5_0_ms 0 127.5
 /begin AXIS_DESCR FIX_AXIS NO_INPUT_QUANTITY CM_IDENTITY 9 0 8 FIX_AXIS_PAR_DIST 0 1 9 /end AXIS_DESCR
 /begin AXIS_DESCR FIX_AXIS NO_INPUT_QUANTITY CM_IDENTITY 5 0 4 FIX_AXIS_PAR_DIST 0 1 5 /end AXIS_DESCR
/end CHARACTERISTIC
/begin CHARACTERISTIC KFTVTEV "podtverzhdena damos addr 0x198FC | characteristic map for CVP delay time" MAP 0x198FC RL_GRID_UBYTE 0 CM_0p5_0_ms 0 127.5
 /begin AXIS_DESCR FIX_AXIS NO_INPUT_QUANTITY CM_IDENTITY 3 0 2 FIX_AXIS_PAR_DIST 0 1 3 /end AXIS_DESCR
 /begin AXIS_DESCR FIX_AXIS NO_INPUT_QUANTITY CM_IDENTITY 6 0 5 FIX_AXIS_PAR_DIST 0 1 6 /end AXIS_DESCR
/end CHARACTERISTIC
/begin CHARACTERISTIC KFMDDAGR "podtverzhdena damos-tochno addr 0x199A7 | Map torque reserve at tester demand of EGR-short test" MAP 0x199A7 RL_GRID_UBYTE 0 CM_0p390625_0 0 99.6094
 /begin AXIS_DESCR FIX_AXIS NO_INPUT_QUANTITY CM_IDENTITY 8 0 7 FIX_AXIS_PAR_DIST 0 1 8 /end AXIS_DESCR
 /begin AXIS_DESCR FIX_AXIS NO_INPUT_QUANTITY CM_IDENTITY 8 0 7 FIX_AXIS_PAR_DIST 0 1 8 /end AXIS_DESCR
/end CHARACTERISTIC
/begin CHARACTERISTIC TMLRTMS "adres podtverzhden damos-veroyatno addr 0x19A26 | IMYA NE PODTVERZHDENO, adres: kod: mov r12, #0x1a25 @0x8604D6 | engine temp. threshold for lambda control depending on cranking temp. tmst" CURVE 0x19A26 RL_GRID_SBYTE 0 CM_0p75_48_GradC -144 47.25
 /begin AXIS_DESCR FIX_AXIS NO_INPUT_QUANTITY CM_IDENTITY 4 0 3 FIX_AXIS_PAR_DIST 0 1 4 /end AXIS_DESCR
/end CHARACTERISTIC
/begin CHARACTERISTIC TWLRTMS "adres podtverzhden damos-veroyatno addr 0x19A5A | IMYA NE PODTVERZHDENO, adres: kod: mov r12, #0x1a59 @0x860534 | waiting time up to check engine temp. signal exceeding threshold for closed loop" CURVE 0x19A5A RL_GRID_UBYTE 0 CM_20_0_s 0 5100
 /begin AXIS_DESCR FIX_AXIS NO_INPUT_QUANTITY CM_IDENTITY 4 0 3 FIX_AXIS_PAR_DIST 0 1 4 /end AXIS_DESCR
/end CHARACTERISTIC
/begin CHARACTERISTIC KFIDTHM "podtverzhdena damos-tochno addr 0x19AB5 | Map value for threshold of integrated air mass for thermostat error detection" MAP 0x19AB5 RL_GRID_UBYTE 0 CM_0p09103840683_0_kg 0 23.2148
 /begin AXIS_DESCR FIX_AXIS NO_INPUT_QUANTITY CM_IDENTITY 4 0 3 FIX_AXIS_PAR_DIST 0 1 4 /end AXIS_DESCR
 /begin AXIS_DESCR FIX_AXIS NO_INPUT_QUANTITY CM_IDENTITY 4 0 3 FIX_AXIS_PAR_DIST 0 1 4 /end AXIS_DESCR
/end CHARACTERISTIC
/begin CHARACTERISTIC LURKH "adres podtverzhden damos-veroyatno addr 0x19AD3 | IMYA NE PODTVERZHDENO, adres: kod: mov r12, #0x1ad2 @0x8666FA | dmrkh-depen. engine roughness reference correction value, during cat heating" CURVE 0x19AD3 RL_GRID_UBYTE 0 CM_0p0078125_0 0 1.99219
 /begin AXIS_DESCR FIX_AXIS NO_INPUT_QUANTITY CM_IDENTITY 4 0 3 FIX_AXIS_PAR_DIST 0 1 4 /end AXIS_DESCR
/end CHARACTERISTIC
/begin CHARACTERISTIC AINTKAN "adres podtverzhden damos-veroyatno addr 0x19ADB | IMYA NE PODTVERZHDENO, adres: kod: mov r12, #0x1adb @0x868828 | number of interval misfire frequency at which ti- cutoff" CURVE 0x19ADB RL_GRID_UBYTE 0 CM_IDENTITY 0 255
 /begin AXIS_DESCR FIX_AXIS NO_INPUT_QUANTITY CM_IDENTITY 8 0 7 FIX_AXIS_PAR_DIST 0 1 8 /end AXIS_DESCR
/end CHARACTERISTIC
/begin CHARACTERISTIC SLX06TMUW "adres podtverzhden damos-veroyatno addr 0x19BE8 | IMYA NE PODTVERZHDENO, adres: kod: mov r12, #0x1be6 @0x834F66 | lamsbg dependet basic point (number 6)" CURVE 0x19BE8 RL_GRID_UBYTE 0 CM_0p000244140625_0 0 0.0622559
 /begin AXIS_DESCR FIX_AXIS NO_INPUT_QUANTITY CM_IDENTITY 6 0 5 FIX_AXIS_PAR_DIST 0 1 6 /end AXIS_DESCR
/end CHARACTERISTIC
/begin CHARACTERISTIC SML07TMUW "adres podtverzhden damos-veroyatno addr 0x19BF6 | IMYA NE PODTVERZHDENO, adres: kod: mov r12, #0x1bf4 @0x834F4E | ml dependet basic point (number 7)" CURVE 0x19BF6 RL_GRID_UBYTE 0 CM_0p1_0_kgh 0 25.5
 /begin AXIS_DESCR FIX_AXIS NO_INPUT_QUANTITY CM_IDENTITY 7 0 6 FIX_AXIS_PAR_DIST 0 1 7 /end AXIS_DESCR
/end CHARACTERISTIC
/begin CHARACTERISTIC SRL04DYUB "adres podtverzhden damos-veroyatno addr 0x19C04 | IMYA NE PODTVERZHDENO, adres: kod: mov r12, #0x1c04 @0x834B2C | basepoint distribution of rl, 4 basepoints" CURVE 0x19C04 RL_GRID_UBYTE 0 CM_IDENTITY 0 255
 /begin AXIS_DESCR FIX_AXIS NO_INPUT_QUANTITY CM_IDENTITY 4 0 3 FIX_AXIS_PAR_DIST 0 1 4 /end AXIS_DESCR
/end CHARACTERISTIC
/begin CHARACTERISTIC KFDMDARO "podtverzhdena damos-tochno addr 0x1A54E | Upper threshold for torque intervension" MAP 0x1A54E RL_GRID_SBYTE 0 CM_0p003051757812_0 -0.390625 0.387573
 /begin AXIS_DESCR FIX_AXIS NO_INPUT_QUANTITY CM_IDENTITY 6 0 5 FIX_AXIS_PAR_DIST 0 1 6 /end AXIS_DESCR
 /begin AXIS_DESCR FIX_AXIS NO_INPUT_QUANTITY CM_IDENTITY 8 0 7 FIX_AXIS_PAR_DIST 0 1 8 /end AXIS_DESCR
/end CHARACTERISTIC
/begin CHARACTERISTIC KFDMDARU "podtverzhdena damos-tochno addr 0x1A5C6 | Lower threshold for torque intervension" MAP 0x1A5C6 RL_GRID_SBYTE 0 CM_0p003051757812_0 -0.390625 0.387573
 /begin AXIS_DESCR FIX_AXIS NO_INPUT_QUANTITY CM_IDENTITY 6 0 5 FIX_AXIS_PAR_DIST 0 1 6 /end AXIS_DESCR
 /begin AXIS_DESCR FIX_AXIS NO_INPUT_QUANTITY CM_IDENTITY 8 0 7 FIX_AXIS_PAR_DIST 0 1 8 /end AXIS_DESCR
/end CHARACTERISTIC
/begin CHARACTERISTIC MKLWON "adres podtverzhden damos-veroyatno addr 0x1A652 | IMYA NE PODTVERZHDENO, adres: kod: mov r12, #0x2652 @0x83BB30 | upper clutch torque threshold for antijerking function" CURVE 0x1A652 RL_GRID_SBYTE 0 CM_0p003051757812_0 -0.390625 0.387573
 /begin AXIS_DESCR FIX_AXIS NO_INPUT_QUANTITY CM_IDENTITY 6 0 5 FIX_AXIS_PAR_DIST 0 1 6 /end AXIS_DESCR
/end CHARACTERISTIC
/begin CHARACTERISTIC MKLWOWKN "adres podtverzhden damos-veroyatno addr 0x1A65E | IMYA NE PODTVERZHDENO, adres: kod: mov r12, #0x265e @0x83BB12 | upper clutch torque threshold for antijerking on an openned lockup clutch" CURVE 0x1A65E RL_GRID_SBYTE 0 CM_0p003051757812_0 -0.390625 0.387573
 /begin AXIS_DESCR FIX_AXIS NO_INPUT_QUANTITY CM_IDENTITY 6 0 5 FIX_AXIS_PAR_DIST 0 1 6 /end AXIS_DESCR
/end CHARACTERISTIC
/begin CHARACTERISTIC MKLWSAN "adres podtverzhden damos-veroyatno addr 0x1A66A | IMYA NE PODTVERZHDENO, adres: kod: mov r12, #0x266a @0x83BB80 | lower clutch torque threshold for antijerking on fuell cutoff restart" CURVE 0x1A66A RL_GRID_SBYTE 0 CM_0p003051757812_0 -0.390625 0.387573
 /begin AXIS_DESCR FIX_AXIS NO_INPUT_QUANTITY CM_IDENTITY 6 0 5 FIX_AXIS_PAR_DIST 0 1 6 /end AXIS_DESCR
/end CHARACTERISTIC
/begin CHARACTERISTIC MKLWUN "adres podtverzhden damos-veroyatno addr 0x1A676 | IMYA NE PODTVERZHDENO, adres: kod: mov r12, #0x2676 @0x83BB9E | lower clutch torque threshold for antijerking" CURVE 0x1A676 RL_GRID_SBYTE 0 CM_0p003051757812_0 -0.390625 0.387573
 /begin AXIS_DESCR FIX_AXIS NO_INPUT_QUANTITY CM_IDENTITY 6 0 5 FIX_AXIS_PAR_DIST 0 1 6 /end AXIS_DESCR
/end CHARACTERISTIC
/begin CHARACTERISTIC MKLWUWKN "adres podtverzhden damos-veroyatno addr 0x1A682 | IMYA NE PODTVERZHDENO, adres: kod: mov r12, #0x2682 @0x83BB5A | lower clutch torque threshold for antijerking on an openned lockup clutch" CURVE 0x1A682 RL_GRID_SBYTE 0 CM_0p003051757812_0 -0.390625 0.387573
 /begin AXIS_DESCR FIX_AXIS NO_INPUT_QUANTITY CM_IDENTITY 6 0 5 FIX_AXIS_PAR_DIST 0 1 6 /end AXIS_DESCR
/end CHARACTERISTIC
/begin CHARACTERISTIC DNMAXH "podtverzhdena | Zapas zhestkogo ogranicheniya: zhestkaya vetv srabatyvaet vyshe predela na DNMAXH (NMAX + 120). Odinakov vo vseh vosmi proshivkah. POPRAVKA (docs/40): 0x0067d8 pribavlyaet, a ne vychitaet." VALUE 0x14BB2 RL_GRID_UWORD 0 CM_0p25_0_obmin -0 16383.8 /end CHARACTERISTIC
/begin CHARACTERISTIC NMAX "podtverzhdena | Otsechka. Znacheniya sovpali s tem, chto nazyval kalibrovschik (6800 protiv 7700)." VALUE 0x14BB4 RL_GRID_UWORD 0 CM_0p25_0_obmin -0 16383.8 /end CHARACTERISTIC
/begin CHARACTERISTIC NMAXDV "podtverzhdena | Ogranichenie oborotov pri neispravnom signale skorosti, a ne vtoroy porog obychnoy otsechki. Kosvennoe podtverzhdenie: L podnyal NMAX do 7084 i ostavil zdes 6000 -- bud eto rabochiy pr" VALUE 0x14BB6 RL_GRID_UWORD 0 CM_0p25_0_obmin -0 16383.8 /end CHARACTERISTIC
/begin CHARACTERISTIC NMXDKPU "podtverzhdena | Predel pri neizvestnom ili oshibochnom polozhenii drosselya, limp-houm. 1200 vo vseh proshivkah." VALUE 0x14BB8 RL_GRID_UWORD 0 CM_0p25_0_obmin -0 16383.8 /end CHARACTERISTIC
/begin CHARACTERISTIC TNMAXDV "podtverzhdena | Zaderzhka vklyucheniya ogranicheniya po NMAXDV. 3 s vo vseh proshivkah." VALUE 0x14BBA RL_GRID_UWORD 0 CM_0p01_0_s -0 655.35 /end CHARACTERISTIC
/begin CHARACTERISTIC DTC_CODES "adres podtverzhden | fault code table, 144 words, four entries per code" CURVE 0x1653A RL_GRID_UWORD 0 CM_IDENTITY -0 65535
 /begin AXIS_DESCR FIX_AXIS NO_INPUT_QUANTITY CM_IDENTITY 144 0 143 FIX_AXIS_PAR_DIST 0 1 144 /end AXIS_DESCR
/end CHARACTERISTIC
/begin CHARACTERISTIC WDKSLN "podtverzhdena | Throttle valve angle threshold for idle detection" CURVE 0x18FD1 RL_GRID_UBYTE 0 CM_0p392157_0 -0 100
 /begin AXIS_DESCR COM_AXIS NO_INPUT_QUANTITY CM_40_0_rpm 6 0 10200 AXIS_PTS_REF AX_18FCB_Y /end AXIS_DESCR
/end CHARACTERISTIC
/begin CHARACTERISTIC WDKVLN_0 "podtverzhdena | Throttle valve angle threshold for full load detection, variant 0" CURVE 0x18FDE RL_GRID_UBYTE 0 CM_0p392157_0 -0 100
 /begin AXIS_DESCR COM_AXIS NO_INPUT_QUANTITY CM_40_0_rpm 6 0 10200 AXIS_PTS_REF AX_18FD8_Y /end AXIS_DESCR
/end CHARACTERISTIC
/begin CHARACTERISTIC WDKVLN_1 "podtverzhdena | Throttle valve angle threshold for full load detection, variant 1" CURVE 0x18FEB RL_GRID_UBYTE 0 CM_0p392157_0 -0 100
 /begin AXIS_DESCR COM_AXIS NO_INPUT_QUANTITY CM_40_0_rpm 6 0 10200 AXIS_PTS_REF AX_18FE5_Y /end AXIS_DESCR
/end CHARACTERISTIC
/begin CHARACTERISTIC KLLAMFA_0 "podtverzhdena | full load enrichment, variant 0" CURVE 0x19562 RL_GRID_UBYTE 0 CM_0p0078125_0 -0 1.99219
 /begin AXIS_DESCR COM_AXIS NO_INPUT_QUANTITY CM_40_0_rpm 6 0 10200 AXIS_PTS_REF AX_1955C_Y /end AXIS_DESCR
/end CHARACTERISTIC
/begin CHARACTERISTIC KLLAMFA_1 "podtverzhdena | full load enrichment, variant 1" CURVE 0x1956F RL_GRID_UBYTE 0 CM_0p0078125_0 -0 1.99219
 /begin AXIS_DESCR COM_AXIS NO_INPUT_QUANTITY CM_40_0_rpm 6 0 10200 AXIS_PTS_REF AX_19569_Y /end AXIS_DESCR
/end CHARACTERISTIC
/begin CHARACTERISTIC TV_LAMFA "adres podtverzhden | delay before full load enrichment, per variant (imya nashe: damos etu paru ne nazyvaet)" CURVE 0x1B894 RL_GRID_UBYTE 0 CM_IDENTITY -0 255
 /begin AXIS_DESCR FIX_AXIS NO_INPUT_QUANTITY CM_IDENTITY 2 0 1 FIX_AXIS_PAR_DIST 0 1 2 /end AXIS_DESCR
/end CHARACTERISTIC
/begin CHARACTERISTIC RLLRTMO "podtverzhdena | char. line on tmot, upper rl control threshold for upstream lambda" CURVE 0x18AC9 RL_GRID_UBYTE 0 CM_0p75_0 -0 191.25
 /begin AXIS_DESCR COM_AXIS NO_INPUT_QUANTITY CM_0p75_48_GradC 8 0 143.25 AXIS_PTS_REF AX_18AC1_Y /end AXIS_DESCR
/end CHARACTERISTIC
/begin CHARACTERISTIC RLLRUN "podtverzhdena | char.line above nmot, lower rL control limit" CURVE 0x18ADA RL_GRID_UBYTE 0 CM_0p75_0 -0 191.25
 /begin AXIS_DESCR COM_AXIS NO_INPUT_QUANTITY CM_40_0_rpm 8 0 10200 AXIS_PTS_REF AX_18AD2_Y /end AXIS_DESCR
/end CHARACTERISTIC
/begin CHARACTERISTIC TARAU "podtverzhdena | air temperature threshold for closed loop lambda switch" VALUE 0x18AE2 RL_GRID_UBYTE 0 CM_0p75_48_GradC -48 143.25 /end CHARACTERISTIC
/begin CHARACTERISTIC TASHS "podtverzhdena | intake air temp threshold triggering TLRHS blocking time" VALUE 0x18AE3 RL_GRID_UBYTE 0 CM_0p75_48_GradC -48 143.25 /end CHARACTERISTIC
/begin CHARACTERISTIC TLRHS "podtverzhdena | blocking time of lambda control during hot start" VALUE 0x18AE4 RL_GRID_UBYTE 0 CM_0p1_0_s -0 25.5 /end CHARACTERISTIC
/begin CHARACTERISTIC TMRA1 "podtverzhdena | cut-out condition, idle-speed switch = 0" VALUE 0x18AE5 RL_GRID_UBYTE 0 CM_0p75_48_GradC -48 143.25 /end CHARACTERISTIC
/begin CHARACTERISTIC TMRA2 "adres podtverzhden | cut-out condition, idle-speed switch = 1" VALUE 0x18AE6 RL_GRID_UBYTE 0 CM_0p75_48_GradC -48 143.25 /end CHARACTERISTIC
/begin CHARACTERISTIC TATELL "podtverzhdena | tans-threshold for canister purge control with B_ll = 1" VALUE 0x19535 RL_GRID_UBYTE 0 CM_0p75_48_GradC -48 143.25 /end CHARACTERISTIC
/begin CHARACTERISTIC TMSKLH "podtverzhdena | engine temperature threshold for short initial phase LRA when engin hot" VALUE 0x19536 RL_GRID_UBYTE 0 CM_0p75_48_GradC -48 143.25 /end CHARACTERISTIC
/begin CHARACTERISTIC TMSNOGA "podtverzhdena | threshold tms for endless purge control, if mixture adaptation without error" VALUE 0x19537 RL_GRID_UBYTE 0 CM_0p75_48_GradC -48 143.25 /end CHARACTERISTIC
/begin CHARACTERISTIC FRAOMN "podtverzhdena | lower limit of correction factor frao" VALUE 0x19543 RL_GRID_UBYTE 0 CM_0p0078125_0 -0 1.99219 /end CHARACTERISTIC
/begin CHARACTERISTIC FRAOMX "podtverzhdena | upper limit of correction factor frao" VALUE 0x19544 RL_GRID_UBYTE 0 CM_0p0078125_0 -0 1.99219 /end CHARACTERISTIC
/begin CHARACTERISTIC FRAORN "podtverzhdena | reduced lower threshold for frao correction" VALUE 0x19545 RL_GRID_UBYTE 0 CM_0p0078125_0 -0 1.99219 /end CHARACTERISTIC
/begin CHARACTERISTIC FRAORX "podtverzhdena | reduced upper threshold for trao correction" VALUE 0x19546 RL_GRID_UBYTE 0 CM_0p0078125_0 -0 1.99219 /end CHARACTERISTIC
/begin CHARACTERISTIC FRATMN "podtverzhdena | lower limit of correction factor frat" VALUE 0x19547 RL_GRID_UBYTE 0 CM_0p0078125_0 -0 1.99219 /end CHARACTERISTIC
/begin CHARACTERISTIC FRATMX "podtverzhdena | upper limit of correction factor frat" VALUE 0x19548 RL_GRID_UBYTE 0 CM_0p0078125_0 -0 1.99219 /end CHARACTERISTIC
/begin CHARACTERISTIC FRAUMN "podtverzhdena | lower limit of correction factor frau" VALUE 0x19549 RL_GRID_UBYTE 0 CM_0p0078125_0 -0 1.99219 /end CHARACTERISTIC
/begin CHARACTERISTIC FRAUMX "podtverzhdena | upper limit of correction factor frau" VALUE 0x1954A RL_GRID_UBYTE 0 CM_0p0078125_0 -0 1.99219 /end CHARACTERISTIC
/begin CHARACTERISTIC FRAURN "podtverzhdena | reduced lower threshold for frau correction" VALUE 0x1954B RL_GRID_UBYTE 0 CM_0p0078125_0 -0 1.99219 /end CHARACTERISTIC
/begin CHARACTERISTIC FRAURX "podtverzhdena | reduced upper threshold fpr frau correction" VALUE 0x1954C RL_GRID_UBYTE 0 CM_0p0078125_0 -0 1.99219 /end CHARACTERISTIC
/begin CHARACTERISTIC NO1 "podtverzhdena | upper engine-speed threshold range 1" VALUE 0x1954D RL_GRID_UBYTE 0 CM_40_0_Upm -0 10200 /end CHARACTERISTIC
/begin CHARACTERISTIC NOLRA "podtverzhdena | codeword for release of adaptation" VALUE 0x1954E RL_GRID_UBYTE 0 CM_IDENTITY -0 255 /end CHARACTERISTIC
/begin CHARACTERISTIC NU3 "podtverzhdena | lower engine-speed threshold range 3" VALUE 0x1954F RL_GRID_UBYTE 0 CM_40_0_Upm -0 10200 /end CHARACTERISTIC
/begin CHARACTERISTIC RLO2 "podtverzhdena | upper load threshold of range 2" VALUE 0x19550 RL_GRID_UBYTE 0 CM_0p75_0 -0 191.25 /end CHARACTERISTIC
/begin CHARACTERISTIC RLO3 "podtverzhdena | upper load-signal threshold range 3" VALUE 0x19551 RL_GRID_UBYTE 0 CM_0p75_0 -0 191.25 /end CHARACTERISTIC
/begin CHARACTERISTIC RLO3AC "podtverzhdena | upper load-signal threshold range 3 with compressor" VALUE 0x19552 RL_GRID_UBYTE 0 CM_0p75_0 -0 191.25 /end CHARACTERISTIC
/begin CHARACTERISTIC RLU2 "podtverzhdena | lower load-signal threshold range 2" VALUE 0x19553 RL_GRID_UBYTE 0 CM_0p75_0 -0 191.25 /end CHARACTERISTIC
/begin CHARACTERISTIC RLU2AC "podtverzhdena | lower load-signal threshold range 2 with compressor" VALUE 0x19554 RL_GRID_UBYTE 0 CM_0p75_0 -0 191.25 /end CHARACTERISTIC
/begin CHARACTERISTIC RLU3 "podtverzhdena | lower load-signal threshold range 3" VALUE 0x19555 RL_GRID_UBYTE 0 CM_0p75_0 -0 191.25 /end CHARACTERISTIC
/begin CHARACTERISTIC RLU4 "podtverzhdena | lower load threshold of the upper multiplicative section" VALUE 0x19556 RL_GRID_UBYTE 0 CM_0p75_0 -0 191.25 /end CHARACTERISTIC
/begin CHARACTERISTIC TMFRATMN "podtverzhdena | minimum temperature at it ftklra_w is one" VALUE 0x19557 RL_GRID_UBYTE 0 CM_0p75_48_GradC -48 143.25 /end CHARACTERISTIC
/begin CHARACTERISTIC KRKTE "podtverzhdena | conversion from relative fuel mass rk into effective injection time te" VALUE 0x1955A RL_GRID_UBYTE 0 CM_0p001779359431_0_ms -0 0.453737 /end CHARACTERISTIC
/begin CHARACTERISTIC CWLAMBTS "podtverzhdena | code word: lambda component protection" VALUE 0x19575 RL_GRID_UBYTE 0 CM_IDENTITY -0 255 /end CHARACTERISTIC
/begin CHARACTERISTIC KFFDLBTS "podtverzhdena |" MAP 0x19576 RL_GRID_UBYTE 0 CM_0p0078125_0 -0 1.99219
 /begin AXIS_DESCR COM_AXIS NO_INPUT_QUANTITY CM_40_0_rpm 16 0 10200 AXIS_PTS_REF SNM16_GK /end AXIS_DESCR
 /begin AXIS_DESCR COM_AXIS NO_INPUT_QUANTITY CM_0p75_0 12 0 191.25 AXIS_PTS_REF SRL12_GK /end AXIS_DESCR
/end CHARACTERISTIC
/begin CHARACTERISTIC TMDYNA "podtverzhdena | engine temperature threshold to enable load dynamic adaptation" VALUE 0x11668 RL_GRID_UBYTE 0 CM_0p75_48_GradC -48 143.25 /end CHARACTERISTIC
/begin CHARACTERISTIC CWDKRNT "podtverzhdena | code word: kc-diagnosis integrator gradient" VALUE 0x11669 RL_GRID_UBYTE 0 CM_IDENTITY -0 255 /end CHARACTERISTIC
/begin CHARACTERISTIC CWDKROF "podtverzhdena | code word: kc-diagnosis reset value" VALUE 0x1166A RL_GRID_UBYTE 0 CM_IDENTITY -0 255 /end CHARACTERISTIC
/begin CHARACTERISTIC DKROKU "podtverzhdena | lower rpm-limit for determination of offset-compensation-value" VALUE 0x1166B RL_GRID_UBYTE 0 CM_40_0_Upm -0 10200 /end CHARACTERISTIC
/begin CHARACTERISTIC KRFHT "podtverzhdena | error frequency, test pulse" VALUE 0x1166C RL_GRID_UBYTE 0 CM_IDENTITY -0 255 /end CHARACTERISTIC
/begin CHARACTERISTIC UDKRGOFS "podtverzhdena | voltage threshold for DIA/KR basic offset amplifier" VALUE 0x1166D RL_GRID_UBYTE 0 CM_0p01953125_0_V -0 4.98047 /end CHARACTERISTIC
/begin CHARACTERISTIC CWDKRTP "podtverzhdena | code word: kc-diagnosis testpulse" VALUE 0x1166E RL_GRID_UBYTE 0 CM_IDENTITY -0 255 /end CHARACTERISTIC
/begin CHARACTERISTIC UDKRTP "podtverzhdena | integr.volt.thresh. f.diagn. knock eval.circ. test pulse" VALUE 0x1166F RL_GRID_UBYTE 0 CM_0p01953125_0_V -0 4.98047 /end CHARACTERISTIC
/begin CHARACTERISTIC NDSVL "podtverzhdena | full-load switch error detection / n threshold minimum" VALUE 0x11670 RL_GRID_UBYTE 0 CM_40_0_Upm -0 10200 /end CHARACTERISTIC
/begin CHARACTERISTIC QDPSLL "podtverzhdena | maximum rate of air flow for plausibility test of idle-speed switch" VALUE 0x11671 RL_GRID_UBYTE 0 CM_4_0_kgh -0 1020 /end CHARACTERISTIC
/begin CHARACTERISTIC RLDSVL "podtverzhdena | full-load switch error detection / load-signal threshold maximal" VALUE 0x11672 RL_GRID_UBYTE 0 CM_0p75_0 -0 191.25 /end CHARACTERISTIC
/begin CHARACTERISTIC KFABAK "podtverzhdena | dolya plenki dlya obogascheniya na razgone" MAP 0x193F3 RL_GRID_UBYTE 0 CM_0p00390625_0 -0 0.996094
 /begin AXIS_DESCR COM_AXIS NO_INPUT_QUANTITY CM_40_0_rpm 7 0 10200 AXIS_PTS_REF SNM07_WF /end AXIS_DESCR
 /begin AXIS_DESCR COM_AXIS NO_INPUT_QUANTITY CM_0p75_48_GradC 9 0 191.25 AXIS_PTS_REF STM09_WF /end AXIS_DESCR
/end CHARACTERISTIC
/begin CHARACTERISTIC KFAVAK "podtverzhdena | dolya plenki dlya obedneniya na sbrose" MAP 0x19432 RL_GRID_UBYTE 0 CM_0p00390625_0 -0 0.996094
 /begin AXIS_DESCR COM_AXIS NO_INPUT_QUANTITY CM_40_0_rpm 7 0 10200 AXIS_PTS_REF SNM07_WF /end AXIS_DESCR
 /begin AXIS_DESCR COM_AXIS NO_INPUT_QUANTITY CM_0p75_48_GradC 9 0 191.25 AXIS_PTS_REF STM09_WF /end AXIS_DESCR
/end CHARACTERISTIC
/begin CHARACTERISTIC KFBAKL "podtverzhdena | faktor obogascheniya na razgone, korotkaya i dlinnaya sostavlyayuschie" MAP 0x19471 RL_GRID_UBYTE 0 CM_0p0625_0 -0 15.9375
 /begin AXIS_DESCR COM_AXIS NO_INPUT_QUANTITY CM_40_0_rpm 7 0 10200 AXIS_PTS_REF SNM07_WF /end AXIS_DESCR
 /begin AXIS_DESCR COM_AXIS NO_INPUT_QUANTITY CM_0p75_48_GradC 9 0 191.25 AXIS_PTS_REF STM09_WF /end AXIS_DESCR
/end CHARACTERISTIC
/begin CHARACTERISTIC KFVAKL "podtverzhdena | faktor obedneniya na sbrose" MAP 0x194B0 RL_GRID_UBYTE 0 CM_0p0625_0 -0 15.9375
 /begin AXIS_DESCR COM_AXIS NO_INPUT_QUANTITY CM_40_0_rpm 7 0 10200 AXIS_PTS_REF SNM07_WF /end AXIS_DESCR
 /begin AXIS_DESCR COM_AXIS NO_INPUT_QUANTITY CM_0p75_48_GradC 9 0 191.25 AXIS_PTS_REF STM09_WF /end AXIS_DESCR
/end CHARACTERISTIC
/begin CHARACTERISTIC KABAKL_L "podtverzhdena | koefficient ubyvaniya obogascheniya na razgone, dlinnaya sostavlyayuschaya" CURVE 0x194EF RL_GRID_UBYTE 0 CM_0p00048828125_0 -0 0.124512
 /begin AXIS_DESCR COM_AXIS NO_INPUT_QUANTITY CM_0p75_48_GradC 9 0 191.25 AXIS_PTS_REF STM09_WF /end AXIS_DESCR
/end CHARACTERISTIC
/begin CHARACTERISTIC KVAKL_L "podtverzhdena | koefficient ubyvaniya obedneniya na sbrose, dlinnaya sostavlyayuschaya" CURVE 0x194F8 RL_GRID_UBYTE 0 CM_0p00048828125_0 -0 0.124512
 /begin AXIS_DESCR COM_AXIS NO_INPUT_QUANTITY CM_0p75_48_GradC 9 0 191.25 AXIS_PTS_REF STM09_WF /end AXIS_DESCR
/end CHARACTERISTIC
/begin CHARACTERISTIC KFMIOP "podtverzhdena |" MAP 0x14A10 RL_GRID_UWORD 0 CM_0p00152588_0_otopornogomoment -0 99.9985
 /begin AXIS_DESCR COM_AXIS NO_INPUT_QUANTITY CM_0p0234375_0 11 0 1535.98 AXIS_PTS_REF SRL11_OP /end AXIS_DESCR
 /begin AXIS_DESCR COM_AXIS NO_INPUT_QUANTITY CM_40_0_rpm 16 0 10200 AXIS_PTS_REF SNM16_OP /end AXIS_DESCR
/end CHARACTERISTIC
/begin CHARACTERISTIC SRL11OPUW "podtverzhdena | ta zhe os, chto u KFZWOP" CURVE 0x14B70 RL_GRID_UWORD 0 CM_0p0234375_0 -0 1535.98
 /begin AXIS_DESCR FIX_AXIS NO_INPUT_QUANTITY CM_IDENTITY 11 0 10 FIX_AXIS_PAR_DIST 0 1 11 /end AXIS_DESCR
/end CHARACTERISTIC
/begin CHARACTERISTIC KFMIRL "podtverzhdena | trebuemoe napolnenie iz trebuemogo momenta: oboroty x moment v % daet napolnenie v %" MAP 0x14BF8 RL_GRID_UWORD 0 CM_0p0234375_0_napolneniya -0 1535.98
 /begin AXIS_DESCR COM_AXIS NO_INPUT_QUANTITY CM_0p001525878906_0_momenta 12 0 99.9985 AXIS_PTS_REF AX_14BE0_X /end AXIS_DESCR
 /begin AXIS_DESCR COM_AXIS NO_INPUT_QUANTITY CM_0p25_0_obmin 16 0 16383.8 AXIS_PTS_REF AX_14BC0_Y /end AXIS_DESCR
/end CHARACTERISTIC
/begin CHARACTERISTIC KFMDS "podtverzhdena | moment mehanicheskih poter: oboroty x napolnenie" MAP 0x15142 RL_GRID_UWORD 0 CM_0p001525878906_0_otopornogomo -0 99.9985
 /begin AXIS_DESCR COM_AXIS NO_INPUT_QUANTITY CM_0p0234375_0_napolneniya 12 0 1535.98 AXIS_PTS_REF AX_1512A_X /end AXIS_DESCR
 /begin AXIS_DESCR COM_AXIS NO_INPUT_QUANTITY CM_0p25_0_obmin 10 0 16383.8 AXIS_PTS_REF AX_15116_Y /end AXIS_DESCR
/end CHARACTERISTIC
/begin CHARACTERISTIC MDIMX "podtverzhdena | verhniy predel indicirovannogo momenta" VALUE 0x105D9 RL_GRID_UBYTE 0 CM_0p390625_0 -0 99.6094 /end CHARACTERISTIC
/begin CHARACTERISTIC ETALAM "podtverzhdena | KPD po sostavu smesi: moment v zavisimosti ot lyambdy" CURVE 0x1051F RL_GRID_UBYTE 0 CM_0p5_0 -0 127.5
 /begin AXIS_DESCR COM_AXIS NO_INPUT_QUANTITY CM_0p0078125_0_lambda 10 0 1.99219 AXIS_PTS_REF AX_10515_Y /end AXIS_DESCR
/end CHARACTERISTIC
/begin CHARACTERISTIC MDLF1 "podtverzhdena | moment na privod ventilyatora ohlazhdeniya 1" VALUE 0x10FB3 RL_GRID_UBYTE 0 CM_0p1960784314_0 -0 50 /end CHARACTERISTIC
/begin CHARACTERISTIC MDLF2 "podtverzhdena | to zhe, ventilyator 2" VALUE 0x10FB4 RL_GRID_UBYTE 0 CM_0p1960784314_0 -0 50 /end CHARACTERISTIC
/begin CHARACTERISTIC MDLFE1 "podtverzhdena | dobavka momenta pri vklyuchenii ventilyatora 1" VALUE 0x10FB5 RL_GRID_UBYTE 0 CM_0p1960784314_0 -0 50 /end CHARACTERISTIC
/begin CHARACTERISTIC MDLFE2 "podtverzhdena | dobavka momenta pri vklyuchenii ventilyatora 2" VALUE 0x10FB6 RL_GRID_UBYTE 0 CM_0p1960784314_0 -0 50 /end CHARACTERISTIC
/begin CHARACTERISTIC KSZWE "podtverzhdena | ugol zaschity ot detonacii" VALUE 0x10ED8 RL_GRID_UBYTE 0 CM_n0p75_0_KV -191.25 -0 /end CHARACTERISTIC
/begin CHARACTERISTIC CWSAWE "podtverzhdena | kodovoe slovo: otsechka topliva -- vozvrat" VALUE 0x10ED9 RL_GRID_UBYTE 0 CM_IDENTITY -0 255 /end CHARACTERISTIC
/begin CHARACTERISTIC DNSAH "podtverzhdena | delta oborotov otsechki, verhnyaya, otnositelno oborotov vozvrata" VALUE 0x10EDA RL_GRID_UBYTE 0 CM_40_0_obmin -0 10200 /end CHARACTERISTIC
/begin CHARACTERISTIC DNSAL "podtverzhdena | delta oborotov otsechki, nizhnyaya, otnositelno oborotov vozvrata" VALUE 0x10EDB RL_GRID_UBYTE 0 CM_40_0_obmin -0 10200 /end CHARACTERISTIC
/begin CHARACTERISTIC DNSATIP "podtverzhdena | podem oborotov otsechki pri tychke gazom" VALUE 0x10EDC RL_GRID_UBYTE 0 CM_40_0_obmin -0 10200 /end CHARACTERISTIC
/begin CHARACTERISTIC DNSLL "podtverzhdena | gisterezis vozvrata topliva na holostom" VALUE 0x10EDD RL_GRID_UBYTE 0 CM_40_0_obmin -0 10200 /end CHARACTERISTIC
/begin CHARACTERISTIC DNVSA "podtverzhdena | podem oborotov otsechki na maloy skorosti" VALUE 0x10EDE RL_GRID_UBYTE 0 CM_40_0_obmin -0 10200 /end CHARACTERISTIC
/begin CHARACTERISTIC DNWEELLS "podtverzhdena | delta vozvrata pri otkaze klapana HH" VALUE 0x10EDF RL_GRID_UBYTE 0 CM_40_0_obmin -0 10200 /end CHARACTERISTIC
/begin CHARACTERISTIC DNWEK "podtverzhdena | delta vozvrata pri vklyuchennom kondicionere" VALUE 0x10EE0 RL_GRID_UBYTE 0 CM_40_0_obmin -0 10200 /end CHARACTERISTIC
/begin CHARACTERISTIC DVSA "podtverzhdena | delta skorosti dlya podema oborotov otsechki" VALUE 0x10EE1 RL_GRID_UBYTE 0 CM_IDENTITY -0 255 /end CHARACTERISTIC
/begin CHARACTERISTIC ENSAKHG "podtverzhdena | razreshenie otsechki po peredache pri progreve katalizatora" VALUE 0x10EE2 RL_GRID_UBYTE 0 CM_IDENTITY -0 255 /end CHARACTERISTIC
/begin CHARACTERISTIC TKATSA "podtverzhdena | porog temperatury katalizatora dlya otsechki" VALUE 0x10EE3 RL_GRID_UBYTE 0 CM_5_n50_C 50 1325 /end CHARACTERISTIC
/begin CHARACTERISTIC VSAA "podtverzhdena | porog skorosti dlya podema oborotov otsechki" VALUE 0x10EE4 RL_GRID_UBYTE 0 CM_IDENTITY -0 255 /end CHARACTERISTIC
/begin CHARACTERISTIC FRKAP "podtverzhdena | globalnyy mnozhitel otnositelnoy massy topliva" VALUE 0x190CD RL_GRID_UBYTE 0 CM_0p0078125_0 -0 1.99219 /end CHARACTERISTIC
/begin CHARACTERISTIC TSTEAA "podtverzhdena | inhibit time after condition B_te (canister purge active)" VALUE 0x1893F RL_GRID_UBYTE 0 CM_0p1_0_s -0 25.5 /end CHARACTERISTIC
/begin CHARACTERISTIC TVLRHMN "podtverzhdena | lower limit for tv-correction" VALUE 0x18940 RL_GRID_UBYTE 0 CM_0p01_0_s -0 2.55 /end CHARACTERISTIC
/begin CHARACTERISTIC TVLRHMX "podtverzhdena | upper limit for tv-correction" VALUE 0x18941 RL_GRID_UBYTE 0 CM_0p01_0_s -0 2.55 /end CHARACTERISTIC
/begin CHARACTERISTIC ANZDYNSH "podtverzhdena | Amount of dynamic measurement for swinging check of sensor post cat" VALUE 0x18942 RL_GRID_UBYTE 0 CM_IDENTITY -0 255 /end CHARACTERISTIC
/begin CHARACTERISTIC CWDLSAHK "podtverzhdena | code word for test aging of O2-sensor post cat" VALUE 0x18943 RL_GRID_UBYTE 0 CM_IDENTITY -0 255 /end CHARACTERISTIC
/begin CHARACTERISTIC TABGSTG "podtverzhdena | threshold for exhaust temperature dynamic-measuring" VALUE 0x18944 RL_GRID_UBYTE 0 CM_5_50_GradC -50 1225 /end CHARACTERISTIC
/begin CHARACTERISTIC TFRMB "podtverzhdena | time delay for detect. the mean value of lamda control factor within thresholds" VALUE 0x18945 RL_GRID_UBYTE 0 CM_0p1_0_s -0 25.5 /end CHARACTERISTIC
/begin CHARACTERISTIC TLLASH "podtverzhdena | time delay for reset lamlash_w if lamsons_w is not lamlash_w" VALUE 0x18946 RL_GRID_UBYTE 0 CM_0p1_0_s -0 25.5 /end CHARACTERISTIC
/begin CHARACTERISTIC TSALASH "podtverzhdena | Time after fuel cut-off for the checking of the sensor downstream catalyst" VALUE 0x18947 RL_GRID_UBYTE 0 CM_0p1_0_s -0 25.5 /end CHARACTERISTIC
/begin CHARACTERISTIC TUSCHUB "podtverzhdena | Delay time for interference peaks at thrust detection of the rear oxygen sensor" VALUE 0x18948 RL_GRID_UBYTE 0 CM_0p1_0_s -0 25.5 /end CHARACTERISTIC
/begin CHARACTERISTIC TUSHSMIN "podtverzhdena | Minimum time for measuring the gradient for enable filter" VALUE 0x18949 RL_GRID_UBYTE 0 CM_0p1_0_s -0 25.5 /end CHARACTERISTIC
/begin CHARACTERISTIC TUSSA "podtverzhdena | delay time after crossing the control threshold downstream cat" VALUE 0x1894A RL_GRID_UBYTE 0 CM_0p1_0_s -0 25.5 /end CHARACTERISTIC
/begin CHARACTERISTIC USHLEAN "podtverzhdena | Threshold for lean volt. for reset dynamic measurement of sensor downstream cat." VALUE 0x1894B RL_GRID_UBYTE 0 CM_0p005215686275_0p2_V -0.2 1.13 /end CHARACTERISTIC
/begin CHARACTERISTIC USHRICH "podtverzhdena | Threshold for rich volt. for valid dyn. measurement of sensor downstream cat." VALUE 0x1894C RL_GRID_UBYTE 0 CM_0p005215686275_0p2_V -0.2 1.13 /end CHARACTERISTIC
/begin CHARACTERISTIC USHSTGMX "podtverzhdena | Value for maximum gradient for initial value of filter" VALUE 0x1894D RL_GRID_UBYTE 0 CM_0p52_0_mVms -0 132.6 /end CHARACTERISTIC
/begin CHARACTERISTIC USHSTSOLL "podtverzhdena | Threshold for permitted gradient of the sensor voltage downstream catalyst" VALUE 0x1894E RL_GRID_UBYTE 0 CM_0p52_0_mVms -0 132.6 /end CHARACTERISTIC
/begin CHARACTERISTIC USSCHUB "podtverzhdena | Threshold for sensor voltage downstream catalyst after fuel cut-off" VALUE 0x1894F RL_GRID_UBYTE 0 CM_0p005215686275_0p2_V -0.2 1.13 /end CHARACTERISTIC
/begin CHARACTERISTIC CWGGLSV "podtverzhdena | Code word for Ri-measurement for O2sensor pre cat (not fully heated)" VALUE 0x18950 RL_GRID_UBYTE 0 CM_IDENTITY -0 255 /end CHARACTERISTIC
/begin CHARACTERISTIC ADKATNF "podtverzhdena | scaling factor for signal amplitude of the sensor resp. of the catalyst stress" VALUE 0x18951 RL_GRID_UBYTE 0 CM_0p09362_0_1V -0 23.8731 /end CHARACTERISTIC
/begin CHARACTERISTIC AHKATMN "podtverzhdena | threshold value catalyst good, AHKAT < AHKATMN" VALUE 0x18952 RL_GRID_UBYTE 0 CM_0p00390625_0 -0 0.996094 /end CHARACTERISTIC
/begin CHARACTERISTIC AHKATS "podtverzhdena | threshold value for sum AHKAT,AHKAT2 (stereo)" VALUE 0x18953 RL_GRID_UBYTE 0 CM_0p0078125_0 -0 1.99219 /end CHARACTERISTIC
/begin CHARACTERISTIC AHKATSB "podtverzhdena | threshold value for error of adding range (stereo)" VALUE 0x18954 RL_GRID_UBYTE 0 CM_0p00390625_0 -0 0.996094 /end CHARACTERISTIC
/begin CHARACTERISTIC AHKTMXT "podtverzhdena | threshold value catalyst defect at tester's request" VALUE 0x18955 RL_GRID_UBYTE 0 CM_0p00390625_0 -0 0.996094 /end CHARACTERISTIC
/begin CHARACTERISTIC APEKTDX "podtverzhdena | max. number of tests with error result" VALUE 0x18956 RL_GRID_UBYTE 0 CM_IDENTITY -0 255 /end CHARACTERISTIC
/begin CHARACTERISTIC AVKATFS "podtverzhdena | setting value for AVKATF in case of powerfail" VALUE 0x18957 RL_GRID_UBYTE 0 CM_0p00390625_0 -0 0.996094 /end CHARACTERISTIC
/begin CHARACTERISTIC CDKATLK "podtverzhdena | code word for B_lrka active" VALUE 0x18958 RL_GRID_UBYTE 0 CM_IDENTITY -0 255 /end CHARACTERISTIC
/begin CHARACTERISTIC DKATCW "podtverzhdena | single run resp. initialization of the DKAT function" VALUE 0x18959 RL_GRID_UBYTE 0 CM_IDENTITY -0 255 /end CHARACTERISTIC
/begin CHARACTERISTIC DRLKTDP "podtverzhdena | Threshold for engine load change" VALUE 0x1895A RL_GRID_UBYTE 0 CM_0p75_0 -0 191.25 /end CHARACTERISTIC
/begin CHARACTERISTIC DRLKTDPT "podtverzhdena | Threshold for engine load change at tester's request" VALUE 0x1895B RL_GRID_UBYTE 0 CM_0p75_0 -0 191.25 /end CHARACTERISTIC
/begin CHARACTERISTIC FALRKTD "podtverzhdena | amplification factor for amplitude of lambda controller" VALUE 0x1895C RL_GRID_UBYTE 0 CM_0p03125_0 -0 7.96875 /end CHARACTERISTIC
/begin CHARACTERISTIC FALRKTT "podtverzhdena | amplification factor for amplitude of lambda controller at tester mode" VALUE 0x1895D RL_GRID_UBYTE 0 CM_0p03125_0 -0 7.96875 /end CHARACTERISTIC
/begin CHARACTERISTIC KATBFMNT "podtverzhdena | threshold value for small catalyst stress at tester's request" VALUE 0x1895E RL_GRID_UBYTE 0 CM_0p00390625_0 -0 0.996094 /end CHARACTERISTIC
/begin CHARACTERISTIC KATBFN "podtverzhdena | standardized mean value of the sensor amplitude" VALUE 0x1895F RL_GRID_UBYTE 0 CM_0p00390625_0 -0 0.996094 /end CHARACTERISTIC
/begin CHARACTERISTIC KATBFNM "podtverzhdena | scaling factor multiplicative for catalyst stress" VALUE 0x18960 RL_GRID_UBYTE 0 CM_0p005215686275_0_V -0 1.33 /end CHARACTERISTIC
/begin CHARACTERISTIC KATBFNP "podtverzhdena | scaling factor additive for catalyst stress" VALUE 0x18961 RL_GRID_UBYTE 0 CM_0p005215686275_0_V -0 1.33 /end CHARACTERISTIC
/begin CHARACTERISTIC KATBFSX "podtverzhdena | maximum integrator value for stop condition" VALUE 0x18962 RL_GRID_UBYTE 0 CM_0p0078125_0 -0 1.99219 /end CHARACTERISTIC
/begin CHARACTERISTIC KATBSG "podtverzhdena | catalyst storage value for catalyst stress" VALUE 0x18963 RL_GRID_UBYTE 0 CM_0p8695652174_0_mg -0 221.739 /end CHARACTERISTIC
/begin CHARACTERISTIC KATBSH "podtverzhdena | offset for lambda control slightly in the rich area" VALUE 0x18964 RL_GRID_UBYTE 0 CM_0p8695652174_0_mgs -0 221.739 /end CHARACTERISTIC
/begin CHARACTERISTIC KATBSHG "podtverzhdena | limitation factor of model lambda-offset due to sensor mean values" VALUE 0x18965 RL_GRID_UBYTE 0 CM_0p00390625_0 -0 0.996094 /end CHARACTERISTIC
/begin CHARACTERISTIC NDKTSOT "podtverzhdena | upper engine speed limit for function request" VALUE 0x18966 RL_GRID_UBYTE 0 CM_40_0_Upm -0 10200 /end CHARACTERISTIC
/begin CHARACTERISTIC NDKTSUT "podtverzhdena | lower engine speed limit for function request" VALUE 0x18967 RL_GRID_UBYTE 0 CM_40_0_Upm -0 10200 /end CHARACTERISTIC
/begin CHARACTERISTIC NKTDX "podtverzhdena | Maximum speed for DKAT calculation" VALUE 0x18968 RL_GRID_UBYTE 0 CM_40_0_Upm -0 10200 /end CHARACTERISTIC
/begin CHARACTERISTIC RLDKTOT "podtverzhdena | upper load limit for function request" VALUE 0x18969 RL_GRID_UBYTE 0 CM_0p75_0 -0 191.25 /end CHARACTERISTIC
/begin CHARACTERISTIC RLDKTUT "podtverzhdena | lower load limit for function request" VALUE 0x1896A RL_GRID_UBYTE 0 CM_0p75_0 -0 191.25 /end CHARACTERISTIC
/begin CHARACTERISTIC TMAXKAT "podtverzhdena | maximum catalyst temp. for active diagnosis" VALUE 0x1896B RL_GRID_UBYTE 0 CM_5_50_GradC -50 1225 /end CHARACTERISTIC
/begin CHARACTERISTIC TMINKAT "podtverzhdena | minimum catalyst temperature for monitoring" VALUE 0x1896C RL_GRID_UBYTE 0 CM_5_50_GradC -50 1225 /end CHARACTERISTIC
/begin CHARACTERISTIC TMNKATT "podtverzhdena | minimum catalyst temperature for monitoring during tester mode" VALUE 0x1896D RL_GRID_UBYTE 0 CM_5_50_GradC -50 1225 /end CHARACTERISTIC
/begin CHARACTERISTIC TMSUKTD "podtverzhdena | minimum engine start temp. for monitoring" VALUE 0x1896E RL_GRID_UBYTE 0 CM_0p75_48_GradC -48 143.25 /end CHARACTERISTIC
/begin CHARACTERISTIC TWDKATST "podtverzhdena | waiting time after stop condition for filter and integrator" VALUE 0x1896F RL_GRID_UBYTE 0 CM_0p05_0_s -0 12.75 /end CHARACTERISTIC
/begin CHARACTERISTIC TWKTDLP "podtverzhdena | delay time after parameter switch over in lambda control" VALUE 0x18970 RL_GRID_UBYTE 0 CM_0p05_0_s -0 12.75 /end CHARACTERISTIC
/begin CHARACTERISTIC ZDKATAD "podtverzhdena | filter time constant of the differentiator for signal amplitude" VALUE 0x18971 RL_GRID_UBYTE 0 CM_IDENTITY -0 255 /end CHARACTERISTIC
/begin CHARACTERISTIC ZDKATAF "podtverzhdena | time constant 'absolute value filter' for signal amplitude" VALUE 0x18972 RL_GRID_UBYTE 0 CM_IDENTITY -0 255 /end CHARACTERISTIC
/begin CHARACTERISTIC ZDKATSH "podtverzhdena | time constant low pass filter, mean sensor values" VALUE 0x18973 RL_GRID_UBYTE 0 CM_IDENTITY -0 255 /end CHARACTERISTIC
/begin CHARACTERISTIC ZDKTBD "podtverzhdena | time constant of the differentiator for RF-alternating component" VALUE 0x18974 RL_GRID_UBYTE 0 CM_IDENTITY -0 255 /end CHARACTERISTIC
/begin CHARACTERISTIC ZDKTBF "podtverzhdena | time constant for gas mixing procedure in front of catalyst" VALUE 0x18975 RL_GRID_UBYTE 0 CM_IDENTITY -0 255 /end CHARACTERISTIC
/begin CHARACTERISTIC ZKTDRL "podtverzhdena | time constant low pass filter, engine load" VALUE 0x18976 RL_GRID_UBYTE 0 CM_IDENTITY -0 255 /end CHARACTERISTIC
/begin CHARACTERISTIC PHLSNVMN "podtverzhdena | minimal normalised heating-power-diagnosis sensor pre catalyst" VALUE 0x18977 RL_GRID_UBYTE 0 CM_0p01_0 -0 2.55 /end CHARACTERISTIC
/begin CHARACTERISTIC TABGMSVU "podtverzhdena | temp. threshold from exhaust temp. modell for diagn. sensor upstream" VALUE 0x18978 RL_GRID_UBYTE 0 CM_5_50_GradC -50 1225 /end CHARACTERISTIC
/begin CHARACTERISTIC TMASO "podtverzhdena | time after fuel cut off for commen open sensor ground" VALUE 0x18979 RL_GRID_UBYTE 0 CM_0p1_0_s -0 25.5 /end CHARACTERISTIC
/begin CHARACTERISTIC TMNEB "podtverzhdena | Engine temprerature threshold for measurement of sensor shunt pre cat" VALUE 0x1897A RL_GRID_UBYTE 0 CM_0p75_48_GradC -48 143.25 /end CHARACTERISTIC
/begin CHARACTERISTIC TMSV "podtverzhdena | engine temp. threshold for recognition cold start for measuring sensor upstream" VALUE 0x1897B RL_GRID_UBYTE 0 CM_0p75_48_GradC -48 143.25 /end CHARACTERISTIC
/begin CHARACTERISTIC TMSVA "podtverzhdena | threshold for engine switch-off temp. for measuring cooling sensor upstream cat" VALUE 0x1897C RL_GRID_UBYTE 0 CM_0p75_48_GradC -48 143.25 /end CHARACTERISTIC
/begin CHARACTERISTIC TRSA "podtverzhdena | monitoring time closed-loop control (upstream CAT) -> sensor off" VALUE 0x1897D RL_GRID_UBYTE 0 CM_0p1_0_s -0 25.5 /end CHARACTERISTIC
/begin CHARACTERISTIC TUSEINV "podtverzhdena | Delay time for condition Lambda sensor ready bit" VALUE 0x1897E RL_GRID_UBYTE 0 CM_IDENTITY -0 255 /end CHARACTERISTIC
/begin CHARACTERISTIC PHLSNHMN "podtverzhdena | Heating power for adequate sensor heating" VALUE 0x1897F RL_GRID_UBYTE 0 CM_0p01_0 -0 2.55 /end CHARACTERISTIC
/begin CHARACTERISTIC THHA "podtverzhdena | off time to reduce heater power of oxygen sensor downstream cat at 13Volt" VALUE 0x18980 RL_GRID_UBYTE 0 CM_0p01_0p05_s -0.05 2.5 /end CHARACTERISTIC
/begin CHARACTERISTIC THHA2 "podtverzhdena | off time to reduce heater power of oxygen sensor2 downstream cat at 13Volt" VALUE 0x18981 RL_GRID_UBYTE 0 CM_0p01_0p05_s -0.05 2.5 /end CHARACTERISTIC
/begin CHARACTERISTIC THHAWU "podtverzhdena | Switch OFF time during power reduction of sensor heating post cat" VALUE 0x18982 RL_GRID_UBYTE 0 CM_0p01_0_s -0 2.55 /end CHARACTERISTIC
/begin CHARACTERISTIC THSHA "podtverzhdena | Verz gerungszeit f r Sonde ausreichend beheizt" VALUE 0x18983 RL_GRID_UBYTE 0 CM_0p1_0_s -0 25.5 /end CHARACTERISTIC
/begin CHARACTERISTIC THVA "podtverzhdena | off time to reduce heater power of oxygen sensor upstream cat at 13 Volt" VALUE 0x18984 RL_GRID_UBYTE 0 CM_0p01_0p05_s -0.05 2.5 /end CHARACTERISTIC
/begin CHARACTERISTIC THVA2 "podtverzhdena | off time to reduce heater power of oxygen sensor2 upstream cat at 13 Volt" VALUE 0x18985 RL_GRID_UBYTE 0 CM_0p01_0p05_s -0.05 2.5 /end CHARACTERISTIC
/begin CHARACTERISTIC THVAWU "podtverzhdena | Switch OFF time during power reduction of sensor heating pre cat" VALUE 0x18986 RL_GRID_UBYTE 0 CM_0p01_0_s -0 2.55 /end CHARACTERISTIC
/begin CHARACTERISTIC TMOHSMN "podtverzhdena | Minimum engine temperature for lambda sensor heating" VALUE 0x18987 RL_GRID_UBYTE 0 CM_0p75_48_GradC -48 143.25 /end CHARACTERISTIC
/begin CHARACTERISTIC TREHS "podtverzhdena | time for restart sensor heating" VALUE 0x18988 RL_GRID_UBYTE 0 CM_0p1_0_s -0 25.5 /end CHARACTERISTIC
/begin CHARACTERISTIC TVHSH "podtverzhdena | delay time for sensor heater downstream cut" VALUE 0x18989 RL_GRID_UBYTE 0 CM_0p1_0_s -0 25.5 /end CHARACTERISTIC
/begin CHARACTERISTIC TVHSV "podtverzhdena | delay time for sensor heater upstream cut" VALUE 0x1898A RL_GRID_UBYTE 0 CM_0p1_0_s -0 25.5 /end CHARACTERISTIC
/begin CHARACTERISTIC TVHSVMX "podtverzhdena | delay time for maximum sensor heater upstream cut" VALUE 0x1898B RL_GRID_UBYTE 0 CM_0p1_0_s -0 25.5 /end CHARACTERISTIC
/begin CHARACTERISTIC UBHS "podtverzhdena | battery voltage threshold for switching off oxygen sensor heater" VALUE 0x1898C RL_GRID_UBYTE 0 CM_0p0704_0_V -0 17.952 /end CHARACTERISTIC
/begin CHARACTERISTIC UHSN "podtverzhdena | Nominal battery voltage for lambda sensor heating" VALUE 0x1898D RL_GRID_UBYTE 0 CM_0p0704_0_V -0 17.952 /end CHARACTERISTIC
/begin CHARACTERISTIC KHCTEMN "podtverzhdena | minimum value of HC concentration in purge flow" VALUE 0x198AB RL_GRID_UBYTE 0 CM_0p015625_0 -0 3.98438 /end CHARACTERISTIC
/begin CHARACTERISTIC KHCTEMX "podtverzhdena | maximum value of HC concentration in purge flow" VALUE 0x198AC RL_GRID_UBYTE 0 CM_0p015625_0 -0 3.98438 /end CHARACTERISTIC
/begin CHARACTERISTIC ZBTEML "podtverzhdena | integration speed for canister charge adaptation" VALUE 0x198AD RL_GRID_UBYTE 0 CM_0p02392578125_0_1s -0 6.10107 /end CHARACTERISTIC
/begin CHARACTERISTIC TTEVAZ "podtverzhdena | duration of stay for CPV opening with not successful frm" VALUE 0x19978 RL_GRID_UBYTE 0 CM_0p1_0_s -0 25.5 /end CHARACTERISTIC
/begin CHARACTERISTIC TVDTEB "podtverzhdena | delay time for statement TEV o.k./defect in diagnosis DTEV" VALUE 0x1997A RL_GRID_UBYTE 0 CM_0p1_0_s -0 25.5 /end CHARACTERISTIC
/begin CHARACTERISTIC TVDTEE "podtverzhdena | Duration as of PCV open for checking of DTEV" VALUE 0x1997B RL_GRID_UBYTE 0 CM_0p1_0_s -0 25.5 /end CHARACTERISTIC
/begin CHARACTERISTIC CURVE_19515 "adres podtverzhden | porog ugla drosselya dlya vklyucheniya adaptacii, po oborotam (CTP7: 'Porog po drosselyu dlya vkl. adaptacii', 50.8..60.2 %). CHitaetsya v toy zhe procedure, chto i porog temperat" CURVE 0x19520 RL_GRID_UBYTE 0 CM_0p390625_0 -0 99.6094
 /begin AXIS_DESCR COM_AXIS NO_INPUT_QUANTITY CM_40_0_rpm 10 0 10200 AXIS_PTS_REF AX_19516_Y /end AXIS_DESCR
/end CHARACTERISTIC
/begin CHARACTERISTIC LIMTKOA "podtverzhdena | Time threshold to switch off the AC-compressor indefinitly" VALUE 0x119D8 RL_GRID_UBYTE 0 CM_0p2_0_s -0 51 /end CHARACTERISTIC
/begin CHARACTERISTIC TKOAMNN "podtverzhdena | minimum shutdown time for air-conditioning compressor" CURVE 0x119E2 RL_GRID_UBYTE 0 CM_0p2_0_s -0 51
 /begin AXIS_DESCR COM_AXIS NO_INPUT_QUANTITY CM_40_0_rpm 8 0 10200 AXIS_PTS_REF SNM08_KO /end AXIS_DESCR
/end CHARACTERISTIC
/begin CHARACTERISTIC TKOAMXN "podtverzhdena | maximum shutdown time for air-conditioning compressor" CURVE 0x119EA RL_GRID_UBYTE 0 CM_0p2_0_s -0 51
 /begin AXIS_DESCR COM_AXIS NO_INPUT_QUANTITY CM_40_0_rpm 8 0 10200 AXIS_PTS_REF SNM08_KO /end AXIS_DESCR
/end CHARACTERISTIC
/begin CHARACTERISTIC TKOEMNN "podtverzhdena | minimal time of air-condition compressor beeing swiched on" CURVE 0x119F2 RL_GRID_UBYTE 0 CM_0p2_0_s -0 51
 /begin AXIS_DESCR COM_AXIS NO_INPUT_QUANTITY CM_40_0_rpm 8 0 10200 AXIS_PTS_REF SNM08_KO /end AXIS_DESCR
/end CHARACTERISTIC
/begin CHARACTERISTIC TMKOAO "podtverzhdena | Upper coolant temperature for swichting off the AC-compressor" VALUE 0x119FA RL_GRID_UBYTE 0 CM_0p75_48_GradC -48 143.25 /end CHARACTERISTIC
/begin CHARACTERISTIC TMKOAU "podtverzhdena | Lower coolant temperature for swichting off the AC-compressor" VALUE 0x119FB RL_GRID_UBYTE 0 CM_0p75_48_GradC -48 143.25 /end CHARACTERISTIC
/begin CHARACTERISTIC TNACMX "podtverzhdena | maximal time for engine speed nac after S_ko = 0" VALUE 0x119FC RL_GRID_UBYTE 0 CM_0p2_0_s -0 51 /end CHARACTERISTIC
/begin CHARACTERISTIC TVKOA "podtverzhdena | delay time for compressor OFF" VALUE 0x119FD RL_GRID_UBYTE 0 CM_0p02_0_s -0 5.1 /end CHARACTERISTIC
/begin CHARACTERISTIC TVKOE "podtverzhdena | delay time for compressor ON" VALUE 0x119FE RL_GRID_UBYTE 0 CM_0p02_0_s -0 5.1 /end CHARACTERISTIC
/begin CHARACTERISTIC VKOAO "podtverzhdena | Upper vehicle speed threshold to inhibit the AC-compressor" VALUE 0x119FF RL_GRID_UBYTE 0 CM_1p25_0_kmh -0 318.75 /end CHARACTERISTIC
/begin CHARACTERISTIC VKOAU "podtverzhdena | low vehicle speed threshold to inhibit the AC-compressor" VALUE 0x11A00 RL_GRID_UBYTE 0 CM_1p25_0_kmh -0 318.75 /end CHARACTERISTIC
/begin CHARACTERISTIC WDKKOAN_0 "podtverzhdena | wdk threshold for A/C compressor cut off, variant 0" CURVE 0x11A01 RL_GRID_UBYTE 0 CM_0p390625_0 -0 99.6094
 /begin AXIS_DESCR COM_AXIS NO_INPUT_QUANTITY CM_40_0_rpm 8 0 10200 AXIS_PTS_REF SNM08_KO /end AXIS_DESCR
/end CHARACTERISTIC
/begin CHARACTERISTIC WDKKOAN_1 "podtverzhdena | wdk threshold for A/C compressor cut off, variant 1" CURVE 0x11A09 RL_GRID_UBYTE 0 CM_0p390625_0 -0 99.6094
 /begin AXIS_DESCR COM_AXIS NO_INPUT_QUANTITY CM_40_0_rpm 8 0 10200 AXIS_PTS_REF SNM08_KO /end AXIS_DESCR
/end CHARACTERISTIC
/begin CHARACTERISTIC WDKKOEN "podtverzhdena | wdk threshold for air-condition compressor authorisation" CURVE 0x11A11 RL_GRID_UBYTE 0 CM_0p390625_0 -0 99.6094
 /begin AXIS_DESCR COM_AXIS NO_INPUT_QUANTITY CM_40_0_rpm 8 0 10200 AXIS_PTS_REF SNM08_KO /end AXIS_DESCR
/end CHARACTERISTIC
/begin CHARACTERISTIC KUMSRL "podtverzhdena | konstanta perescheta rashoda vozduha v otnositelnoe napolnenie" VALUE 0x1157C RL_GRID_UBYTE 0 CM_7p8125En06_0_kgh1min -0 0.00199219 /end CHARACTERISTIC
/begin CHARACTERISTIC CWFKMSDKA "podtverzhdena | kodovoe slovo: adaptaciya rashoda vklyuchena" VALUE 0x1157A RL_GRID_UBYTE 0 CM_IDENTITY -0 255 /end CHARACTERISTIC
/begin CHARACTERISTIC KIMSALL "podtverzhdena | popravka integratora vozduha holostogo hoda" VALUE 0x1157B RL_GRID_UBYTE 0 CM_0p00078125_0 -0 0.199219 /end CHARACTERISTIC
/begin CHARACTERISTIC MSALLMN "podtverzhdena | nizhniy predel adaptacii vozduha HH" VALUE 0x1157D RL_GRID_UBYTE 0 CM_0p1_0_kgh -0 25.5 /end CHARACTERISTIC
/begin CHARACTERISTIC MSALLMX "podtverzhdena | verhniy predel adaptacii vozduha HH" VALUE 0x1157E RL_GRID_UBYTE 0 CM_0p1_0_kgh -0 25.5 /end CHARACTERISTIC
/begin CHARACTERISTIC MSLG "podtverzhdena | rashod summarnogo podsosa (utechki) vozduha" VALUE 0x1157F RL_GRID_UBYTE 0 CM_0p1_0_kgh -0 25.5 /end CHARACTERISTIC
/begin CHARACTERISTIC RLNOT "podtverzhdena | Podmena napolneniya pri otkaze. Imenno etot mehanizm sposoben derzhat nevernoe napolnenie skolko ugodno dolgo, v otlichie ot oshibki prognoza, zhivuschey 2-5 ciklov." CURVE 0x11587 RL_GRID_UBYTE 0 CM_0p75_0 -0 191.25
 /begin AXIS_DESCR COM_AXIS NO_INPUT_QUANTITY CM_40_0_rpm 6 0 10200 AXIS_PTS_REF AX_11581_Y /end AXIS_DESCR
/end CHARACTERISTIC
/begin CHARACTERISTIC KLAF "podtverzhdena | funkciya istecheniya Sen-Venana dlya drosselya" CURVE 0x15754 RL_GRID_UWORD 0 CM_IDENTITY -0 65535
 /begin AXIS_DESCR FIX_AXIS NO_INPUT_QUANTITY CM_IDENTITY 501 0 500 FIX_AXIS_PAR_DIST 0 1 501 /end AXIS_DESCR
/end CHARACTERISTIC
/begin CHARACTERISTIC KFMSNWDK "podtverzhdena | bazovyy rashod cherez drossel, vhod wdkba (ugol) i pspvdk (otnoshenie davleniy)" MAP 0x15694 RL_GRID_UWORD 0 CM_0p1_0_kgh -0 6553.5
 /begin AXIS_DESCR COM_AXIS NO_INPUT_QUANTITY CM_IDENTITY 6 0 65535 AXIS_PTS_REF AX_15688_X /end AXIS_DESCR
 /begin AXIS_DESCR COM_AXIS NO_INPUT_QUANTITY CM_IDENTITY 16 0 65535 AXIS_PTS_REF AX_15668_Y /end AXIS_DESCR
/end CHARACTERISTIC
/begin CHARACTERISTIC WDKUGDN "podtverzhdena | ugol drosselya, pri kotorom dostigaetsya 95 % maksimalno vozmozhnogo napolneniya" CURVE 0x15B40 RL_GRID_UWORD 0 CM_0p001525878906_0_ugladrossely -0 99.9985
 /begin AXIS_DESCR FIX_AXIS NO_INPUT_QUANTITY CM_IDENTITY 12 0 11 FIX_AXIS_PAR_DIST 0 1 12 /end AXIS_DESCR
/end CHARACTERISTIC
/begin CHARACTERISTIC KFRLW "podtverzhdena | rezervnyy signal napolneniya ot ugla drosselya i oborotov (auxiliary load signal). Imenno na nego EBU pereklyuchaetsya, kogda osnovnoy signal po DMRV priznan negodnym -- tot samyy seco" MAP 0x1ACAA RL_GRID_UWORD 0 CM_0p0234375_0_napolneniya -0 1535.98
 /begin AXIS_DESCR COM_AXIS NO_INPUT_QUANTITY CM_0p25_0_obmin 12 0 16383.8 AXIS_PTS_REF AX_1AC92_X /end AXIS_DESCR
 /begin AXIS_DESCR COM_AXIS NO_INPUT_QUANTITY CM_0p01219512195_0_ugoldrosselya 12 0 799.207 AXIS_PTS_REF AX_1AC7A_Y /end AXIS_DESCR
/end CHARACTERISTIC
/begin CHARACTERISTIC KFPU "podtverzhdena | korrekciya pulsaciy potoka, oboroty x ugol drosselya" MAP 0x114A3 RL_GRID_UBYTE 0 CM_0p0078125_0 -0 1.99219
 /begin AXIS_DESCR FIX_AXIS NO_INPUT_QUANTITY CM_IDENTITY 14 0 13 FIX_AXIS_PAR_DIST 0 1 14 /end AXIS_DESCR
 /begin AXIS_DESCR FIX_AXIS NO_INPUT_QUANTITY CM_IDENTITY 14 0 13 FIX_AXIS_PAR_DIST 0 1 14 /end AXIS_DESCR
/end CHARACTERISTIC
/begin CHARACTERISTIC KFPUSU "podtverzhdena | to zhe pri izmenyaemoy geometrii vpuska (rezhim 1)" MAP 0x111FD RL_GRID_UBYTE 0 CM_0p0078125_0 -0 1.99219
 /begin AXIS_DESCR FIX_AXIS NO_INPUT_QUANTITY CM_IDENTITY 14 0 13 FIX_AXIS_PAR_DIST 0 1 14 /end AXIS_DESCR
 /begin AXIS_DESCR FIX_AXIS NO_INPUT_QUANTITY CM_IDENTITY 14 0 13 FIX_AXIS_PAR_DIST 0 1 14 /end AXIS_DESCR
/end CHARACTERISTIC
/begin CHARACTERISTIC KFPUSUNW "podtverzhdena | to zhe pri oboih (rezhim 3) -- vsya v edinicah" MAP 0x113C1 RL_GRID_UBYTE 0 CM_0p0078125_0 -0 1.99219
 /begin AXIS_DESCR FIX_AXIS NO_INPUT_QUANTITY CM_IDENTITY 14 0 13 FIX_AXIS_PAR_DIST 0 1 14 /end AXIS_DESCR
 /begin AXIS_DESCR FIX_AXIS NO_INPUT_QUANTITY CM_IDENTITY 14 0 13 FIX_AXIS_PAR_DIST 0 1 14 /end AXIS_DESCR
/end CHARACTERISTIC
/begin CHARACTERISTIC KFKHFM "podtverzhdena | korrekciya harakteristiki DMRV, oboroty x napolnenie" MAP 0x1111B RL_GRID_UBYTE 0 CM_0p0078125_0 -0 1.99219
 /begin AXIS_DESCR FIX_AXIS NO_INPUT_QUANTITY CM_IDENTITY 14 0 13 FIX_AXIS_PAR_DIST 0 1 14 /end AXIS_DESCR
 /begin AXIS_DESCR FIX_AXIS NO_INPUT_QUANTITY CM_IDENTITY 14 0 13 FIX_AXIS_PAR_DIST 0 1 14 /end AXIS_DESCR
/end CHARACTERISTIC
/begin CHARACTERISTIC PUKANS "podtverzhdena | popravka korrekcii pulsaciy po temperature vozduha na vpuske" CURVE 0x11568 RL_GRID_UBYTE 0 CM_0p0078125_0_mnozhitel -0 1.99219
 /begin AXIS_DESCR FIX_AXIS NO_INPUT_QUANTITY CM_IDENTITY 8 0 7 FIX_AXIS_PAR_DIST 0 1 8 /end AXIS_DESCR
/end CHARACTERISTIC
/begin CHARACTERISTIC KST_COLD "podtverzhdena | koefficient holodnogo puska po temperature OZH" CURVE 0x116A5 RL_GRID_UBYTE 0 CM_0p0009765625_0 -0 0.249023
 /begin AXIS_DESCR COM_AXIS NO_INPUT_QUANTITY CM_0p75_48_GradC 12 0 143.25 AXIS_PTS_REF AX_11699_Y /end AXIS_DESCR
/end CHARACTERISTIC
/begin CHARACTERISTIC KST_HOT "podtverzhdena | koefficient goryachego puska po temperature vozduha na vpuske (vhod 0x8AB9)" CURVE 0x11692 RL_GRID_UBYTE 0 CM_0p25_0 -0 63.75
 /begin AXIS_DESCR COM_AXIS NO_INPUT_QUANTITY CM_0p75_48_GradC 6 0 143.25 AXIS_PTS_REF AX_1168C_Y /end AXIS_DESCR
/end CHARACTERISTIC
/begin CHARACTERISTIC KST_HOT_MUL "podtverzhdena | mnozhitel koefficienta goryachego puska: stroki -- temperatura vozduha, podryad -- velichina 0x8A00 (0..30)" MAP 0x116C0 RL_GRID_UBYTE 0 CM_0p0078125_0 -0 1.99219
 /begin AXIS_DESCR COM_AXIS NO_INPUT_QUANTITY CM_IDENTITY 6 0 255 AXIS_PTS_REF AX_116BA_X /end AXIS_DESCR
 /begin AXIS_DESCR COM_AXIS NO_INPUT_QUANTITY CM_0p75_48_GradC 6 0 143.25 AXIS_PTS_REF AX_116B4_Y /end AXIS_DESCR
/end CHARACTERISTIC
/begin CHARACTERISTIC KST_COLD_MUL "podtverzhdena | mnozhitel koefficienta holodnogo puska: stroki -- temperatura OZH, podryad -- velichina 0x8A00 (0..64)" MAP 0x11712 RL_GRID_UBYTE 0 CM_0p0078125_0 -0 1.99219
 /begin AXIS_DESCR COM_AXIS NO_INPUT_QUANTITY CM_IDENTITY 6 0 255 AXIS_PTS_REF AX_1170C_X /end AXIS_DESCR
 /begin AXIS_DESCR COM_AXIS NO_INPUT_QUANTITY CM_0p75_48_GradC 12 0 143.25 AXIS_PTS_REF AX_11700_Y /end AXIS_DESCR
/end CHARACTERISTIC
/begin CHARACTERISTIC KST_COLD_NMUL "podtverzhdena | mnozhitel koefficienta holodnogo puska po oborotam: stroki -- temperatura OZH, podryad -- oboroty" MAP 0x116EE RL_GRID_UBYTE 0 CM_0p00390625_0 -0 0.996094
 /begin AXIS_DESCR COM_AXIS NO_INPUT_QUANTITY CM_40_0_rpm 4 0 10200 AXIS_PTS_REF AX_116EA_X /end AXIS_DESCR
 /begin AXIS_DESCR COM_AXIS NO_INPUT_QUANTITY CM_0p75_48_GradC 4 0 143.25 AXIS_PTS_REF AX_116E6_Y /end AXIS_DESCR
/end CHARACTERISTIC
/begin CHARACTERISTIC KST_RESTART "podtverzhdena | obednyayuschiy koefficient povtornogo puska: stroki -- velichina 10..1800 (slovnaya os), podryad -- temperatura OZH" MAP 0x15F78 RL_GRID_UBYTE 0 CM_0p0078125_0 -0 1.99219
 /begin AXIS_DESCR COM_AXIS NO_INPUT_QUANTITY CM_0p75_48_GradC 4 0 143.25 AXIS_PTS_REF AX_15F74_X /end AXIS_DESCR
 /begin AXIS_DESCR COM_AXIS NO_INPUT_QUANTITY CM_IDENTITY 4 0 65535 AXIS_PTS_REF AX_15F6C_Y /end AXIS_DESCR
/end CHARACTERISTIC
/begin CHARACTERISTIC KF_TI_NONLIN "podtverzhdena | korrekciya nelineynosti podachi topliva: stroki -- oboroty, podryad -- vremya vpryska (os 1..20, x1/375)" MAP 0x1B694 RL_GRID_UWORD 0 CM_3p051757812En05_0 -0 1.99997
 /begin AXIS_DESCR COM_AXIS NO_INPUT_QUANTITY CM_0p0026666667_0_ms 16 0 174.76 AXIS_PTS_REF AX_1B674_X /end AXIS_DESCR
 /begin AXIS_DESCR COM_AXIS NO_INPUT_QUANTITY CM_40_0_rpm 16 0 10200 AXIS_PTS_REF AX_1B664_Y /end AXIS_DESCR
/end CHARACTERISTIC
/begin CHARACTERISTIC TMOT_ADAPT "podtverzhdena | temperatura OZH, vyshe kotoroy vklyuchaetsya adaptaciya smesi" VALUE 0x11911 RL_GRID_UBYTE 0 CM_0p75_48_GradC -48 143.25 /end CHARACTERISTIC
/begin CHARACTERISTIC NMIN_MISF "podtverzhdena | nizhnyaya granica oborotov diagnostiki propuskov vosplameneniya" VALUE 0x121C9 RL_GRID_UBYTE 0 CM_40_0_rpm -0 10200 /end CHARACTERISTIC
/begin CHARACTERISTIC NMAX_MISF "podtverzhdena | verhnyaya granica oborotov diagnostiki propuskov vosplameneniya" VALUE 0x121CA RL_GRID_UBYTE 0 CM_40_0_rpm -0 10200 /end CHARACTERISTIC
/begin CHARACTERISTIC TMOT_FAN_HYS "podtverzhdena | gisterezis temperatury OZH dlya ventilyatora" VALUE 0x199FF RL_GRID_UBYTE 0 CM_0p75_0_K -0 191.25 /end CHARACTERISTIC
/begin CHARACTERISTIC TAN_FAN "podtverzhdena | porog temperatury vozduha na vpuske dlya vklyucheniya ventilyatora" VALUE 0x19A01 RL_GRID_UBYTE 0 CM_0p75_48_GradC -48 143.25 /end CHARACTERISTIC
/begin CHARACTERISTIC TMOT_FAN1 "podtverzhdena | porog temperatury OZH dlya vklyucheniya ventilyatora, rezhim 1" VALUE 0x19A02 RL_GRID_UBYTE 0 CM_0p75_48_GradC -48 143.25 /end CHARACTERISTIC
/begin CHARACTERISTIC TMOT_FAN2 "podtverzhdena | porog temperatury OZH dlya vklyucheniya ventilyatora, rezhim 2" VALUE 0x19A03 RL_GRID_UBYTE 0 CM_0p75_48_GradC -48 143.25 /end CHARACTERISTIC
/begin CHARACTERISTIC TMOT_FAN3 "podtverzhdena | porog temperatury OZH dlya vklyucheniya ventilyatora, rezhim 3" VALUE 0x19A04 RL_GRID_UBYTE 0 CM_0p75_48_GradC -48 143.25 /end CHARACTERISTIC
/begin CHARACTERISTIC TMOT_FAN4 "podtverzhdena | porog temperatury OZH dlya vklyucheniya ventilyatora, rezhim 4" VALUE 0x19A05 RL_GRID_UBYTE 0 CM_0p75_48_GradC -48 143.25 /end CHARACTERISTIC
/begin CHARACTERISTIC TMOT_FAN5 "podtverzhdena | porog temperatury OZH dlya vklyucheniya ventilyatora, rezhim 5" VALUE 0x19A06 RL_GRID_UBYTE 0 CM_0p75_48_GradC -48 143.25 /end CHARACTERISTIC
/begin CHARACTERISTIC HFM_LIN "podtverzhdena | tarirovka DMRV: rashod po 512 tochkam napryazheniya" CURVE 0x15260 RL_GRID_UWORD 0 CM_0p1_0_kgh -0 6553.5
 /begin AXIS_DESCR FIX_AXIS NO_INPUT_QUANTITY CM_IDENTITY 512 0 511 FIX_AXIS_PAR_DIST 0 1 512 /end AXIS_DESCR
/end CHARACTERISTIC
/begin CHARACTERISTIC HFM_LIN_OFS "podtverzhdena | smeschenie tarirovki DMRV" VALUE 0x15660 RL_GRID_UWORD 0 CM_0p1_0_kgh -0 6553.5 /end CHARACTERISTIC
/begin CHARACTERISTIC LS_CONFIG "podtverzhdena | konfiguraciya lyambda-zondov, bitovoe pole: bit 1 -- zond posle neytralizatora, bank 1" VALUE 0x10022 RL_GRID_UBYTE 0 CM_IDENTITY -0 255 /end CHARACTERISTIC
/begin CHARACTERISTIC KF_LAM_WARM "podtverzhdena | sostav smesi pri progreve, lyambda-regulirovanie aktivno: stroki -- TOZH (0x8AB4), podryad -- TOZH pri puske (0x8AB3)" MAP 0x19344 RL_GRID_UBYTE 0 CM_0p0078125_0 -0 1.99219
 /begin AXIS_DESCR COM_AXIS NO_INPUT_QUANTITY CM_0p75_48_GradC 12 0 143.25 AXIS_PTS_REF AX_1827E_X /end AXIS_DESCR
 /begin AXIS_DESCR COM_AXIS NO_INPUT_QUANTITY CM_0p75_48_GradC 12 0 143.25 AXIS_PTS_REF AX_10176_Y /end AXIS_DESCR
/end CHARACTERISTIC
/begin CHARACTERISTIC KL_LAM_OPEN "podtverzhdena | korrekciya sostava smesi pri neaktivnom lyambda-regulirovanii, po TOZH" CURVE 0x193D4 RL_GRID_SBYTE 0 CM_0p0078125_0 -1 1
 /begin AXIS_DESCR COM_AXIS NO_INPUT_QUANTITY CM_0p75_48_GradC 12 0 143.25 AXIS_PTS_REF AX_10176_Y /end AXIS_DESCR
/end CHARACTERISTIC
/begin CHARACTERISTIC LAM_RICH_MAX "podtverzhdena | predel bogatoy smesi. Vtoroy variant lezhit ryadom, 0x1190E, vybor po bitu 0xFD0C.13" VALUE 0x1190D RL_GRID_UBYTE 0 CM_0p0078125_0 -0 1.99219 /end CHARACTERISTIC
/begin CHARACTERISTIC KABAKL_S "podtverzhdena | koefficient ubyvaniya obogascheniya na razgone, korotkaya sostavlyayuschaya" VALUE 0x118F9 RL_GRID_UBYTE 0 CM_0p00390625_0 -0 0.996094 /end CHARACTERISTIC
/begin CHARACTERISTIC DTH_ACC_ENR "podtverzhdena | porog vklyucheniya obogascheniya pri razgone, po TOZH" CURVE 0x1B4F0 RL_GRID_SWORD 0 CM_0p046875_0 -1536 1536
 /begin AXIS_DESCR COM_AXIS NO_INPUT_QUANTITY CM_0p75_48_GradC 9 0 191.25 AXIS_PTS_REF STM09_WF /end AXIS_DESCR
/end CHARACTERISTIC
/begin CHARACTERISTIC DTH_DEC_LEAN "podtverzhdena | porog vklyucheniya obedneniya pri zamedlenii, po TOZH" CURVE 0x1B502 RL_GRID_SWORD 0 CM_0p046875_0 -1536 1536
 /begin AXIS_DESCR COM_AXIS NO_INPUT_QUANTITY CM_0p75_48_GradC 9 0 191.25 AXIS_PTS_REF STM09_WF /end AXIS_DESCR
/end CHARACTERISTIC
/begin CHARACTERISTIC KFPRG "podtverzhdena | davlenie ostatochnyh gazov vo vpuske: vychitaetsya iz davleniya v kollektore pered pereschetom v napolnenie" MAP 0x1AA54 RL_GRID_UWORD 0 CM_0p0390625_0_hPa -0 2559.96
 /begin AXIS_DESCR COM_AXIS NO_INPUT_QUANTITY CM_0p25_0_rpm 10 0 16383.8 AXIS_PTS_REF AX_1AA40_X /end AXIS_DESCR
 /begin AXIS_DESCR COM_AXIS NO_INPUT_QUANTITY CM_0p5_0_GradKW 10 0 127.5 AXIS_PTS_REF AX_1AA36_Y /end AXIS_DESCR
/end CHARACTERISTIC
/begin CHARACTERISTIC KFURL "podtverzhdena | koefficient perescheta davleniya vo vpuske v napolnenie cilindra (po suti napolnyaemost po oborotam)" MAP 0x1AB3C RL_GRID_UWORD 0 CM_4p577636719En06_0_hPa -0 0.299995
 /begin AXIS_DESCR COM_AXIS NO_INPUT_QUANTITY CM_0p25_0_rpm 10 0 16383.8 AXIS_PTS_REF AX_1AB28_X /end AXIS_DESCR
 /begin AXIS_DESCR COM_AXIS NO_INPUT_QUANTITY CM_0p5_0_GradKW 10 0 127.5 AXIS_PTS_REF AX_1AB1E_Y /end AXIS_DESCR
/end CHARACTERISTIC
/begin CHARACTERISTIC SRM_VOL "podtverzhdena | konstanta modeli kollektora: delitel skorosti integratora davleniya (chem bolshe, tem medlennee davlenie dogonyaet DMRV)" VALUE 0x15662 RL_GRID_UWORD 0 CM_IDENTITY -0 65535 /end CHARACTERISTIC
/begin CHARACTERISTIC FLT_SRM "podtverzhdena | koefficient filtra dlya davleniya ostatochnyh gazov i koefficienta perescheta" VALUE 0x11579 RL_GRID_UBYTE 0 CM_IDENTITY -0 255 /end CHARACTERISTIC
/begin CHARACTERISTIC FLT_HFM "podtverzhdena | koefficient filtra sglazhennogo rashoda DMRV 0x930C (dlya proverki pravdopodobiya, ne dlya napolneniya)" VALUE 0x11578 RL_GRID_UBYTE 0 CM_IDENTITY -0 255 /end CHARACTERISTIC
/begin GROUP G_ALL "??? ?????" ROOT
 /begin SUB_GROUP G_Zazhiganie G_Detonaciya G_Vozduh_i_napolnenie__DMRV G_Sostav_smesi_i_polnaya_nagruzk G_Vprysk_i_toplivopodacha G_Perehodnye_rezhimy__plenka G_Pusk_i_progrev G_Momentnaya_model G_Filtr_momenta__antiryvok G_Holostoy_hod G_Otsechka_i_ogranichenie_oborot G_Lyambda_regulirovanie_i_adapta G_Katalizator_i_zadniy_zond G_Adsorber G_Kondicioner G_Ohlazhdenie__ventilyator G_Propuski_vosplameneniya G_Datchiki_i_prochie_vhody G_Diagnostika_i_OBD G_Konfiguraciya__kodovye_slova G_Recirkulyaciya_OG__na_motore_n G_Osi /end SUB_GROUP
/end GROUP
/begin GROUP G_Zazhiganie "Zazhiganie"
 /begin REF_CHARACTERISTIC DZWSPM FSZTM KFETAZW KFETAZWN KFSZT KFZW KFZW2 KFZWMN KFZWMNST KFZWMS WPHN /end REF_CHARACTERISTIC
/end GROUP
/begin GROUP G_Detonaciya "Detonaciya"
 /begin REF_CHARACTERISTIC CWDKRNT CWDKROF CWDKRTP DKROKU DWKRMSN KRAL1N KRAL2N KRFHT KRFKN KRMXN KRNLZAR KRVFN KSZWE LKRN TMDYNA UDKRGOFS UDKRTP /end REF_CHARACTERISTIC
/end GROUP
/begin GROUP G_Vozduh_i_napolnenie__DMRV "Vozduh i napolnenie (DMRV)"
 /begin REF_CHARACTERISTIC CWFKMSDKA FDVANS FLT_HFM FLT_SRM FWFTBRTA FZPUSA HFM_LIN HFM_LIN_OFS KFKHFM KFMSNWDK KFPRG KFPU KFPUSU KFPUSUNW KFRLW KFSU KFSU2 KFURL KIMSALL KLAF KUMSRL MSALLMN MSALLMX MSLG NDSVL PUKANS QDPSLL RLDSVL RLNOT RLVMXN RLVSMXN SRM_VOL TVSUM WDKHKDN WDKHKN WDKUGDN WPUAVLN WPUAVLSN /end REF_CHARACTERISTIC
/end GROUP
/begin GROUP G_Sostav_smesi_i_polnaya_nagruzk "Sostav smesi i polnaya nagruzka"
 /begin REF_CHARACTERISTIC CWLAMBTS ETADZW KFFDLBTS KFLBTS KFLF KLLAMFA_0 KLLAMFA_1 KL_LAM_OPEN LAM_RICH_MAX TV_LAMFA WDKVLN_0 WDKVLN_1 /end REF_CHARACTERISTIC
/end GROUP
/begin GROUP G_Vprysk_i_toplivopodacha "Vprysk i toplivopodacha"
 /begin REF_CHARACTERISTIC FRKAP FZN0 FZN1 FZN2 FZN3 FZN4 FZNWN0 FZNWN1 FZNWN2 FZNWN3 KFWEE KFWEEK KF_TI_NONLIN KRKTE WEAN WEEM WEEMRFAN WEESTM WEESTN ZZWEETM /end REF_CHARACTERISTIC
/end GROUP
/begin GROUP G_Perehodnye_rezhimy__plenka "Perehodnye rezhimy, plenka"
 /begin REF_CHARACTERISTIC DTH_ACC_ENR DTH_DEC_LEAN KABAKL_L KABAKL_S KFABAK KFAVAK KFBAKL KFVAKL KVAKL_L /end REF_CHARACTERISTIC
/end GROUP
/begin GROUP G_Pusk_i_progrev "Pusk i progrev"
 /begin REF_CHARACTERISTIC FNSA FNSHO FSTHO KF_LAM_WARM KST_COLD KST_COLD_MUL KST_COLD_NMUL KST_HOT KST_HOT_MUL KST_RESTART NNSTA NSTNM /end REF_CHARACTERISTIC
/end GROUP
/begin GROUP G_Momentnaya_model "Momentnaya model"
 /begin REF_CHARACTERISTIC DMDKOE DZWETA ETALAM FABMDWA FMDKHFH FMDKHTM KFEKWTMP KFMDKO KFMDS KFMIOP KFMIRL KFMPED KFZWOP KLMDLOAD2 MDIMX MDLF1 MDLF2 MDLFE1 MDLFE2 REDZEM RLMNN RLMNSAN TVFSAM TVFSAMR TVFSEM TVFSEMR UEVERG ZKMDWAM /end REF_CHARACTERISTIC
/end GROUP
/begin GROUP G_Filtr_momenta__antiryvok "Filtr momenta, antiryvok"
 /begin REF_CHARACTERISTIC DFAUWKN DFAWKN FLRAG FLRAWG FLRHG FRARAG FRARAWG FRARHG KFDMDARO KFDMDARU KFDMDFA KFDMDFAS KFDMDFAU KFZMDFA KFZMDFAS KFZMDFAU MKLWON MKLWOWKN MKLWSAN MKLWUN MKLWUWKN NARASTG ZFAUWKN ZFAWKN /end REF_CHARACTERISTIC
/end GROUP
/begin GROUP G_Holostoy_hod "Holostoy hod"
 /begin REF_CHARACTERISTIC DMLLRIMXN DMLLRLMNN DMLLRLMXN DMLLRMNN DMLLRMXN DNEVTMOD DNLBZ DVNG DVNGV FDDN FKODASH FNSSTM FVDASHM GFDLDN IVDN IVDNDTE KFMIDSH0 KFMIDSH1 KFMIDSH2 KFMIDSH3 LIMXDNS LIMXVDNS LISTM NFSM NLLM NSLPP NSLPPFS NTANS PVDN PVLDN PVLDNV SNS206LLSB WDKSLN ZDSH1GS ZDSHGS ZNSMST /end REF_CHARACTERISTIC
/end GROUP
/begin GROUP G_Otsechka_i_ogranichenie_oborot "Otsechka i ogranichenie oborotov"
 /begin REF_CHARACTERISTIC CWSAWE DNMAXH DNSAH DNSAL DNSATIP DNSLL DNVSA DNWEELLS DNWEK DVSA ENSAKHG KFMIRED KFTVSA NMAX NMAXDV NMAXPRL NMXDAEF NMXDKPU NWECVTM TKATSA TNMAXDV TVSATM VSAA ZINMAXRL /end REF_CHARACTERISTIC
/end GROUP
/begin GROUP G_Lyambda_regulirovanie_i_adapta "Lyambda-regulirovanie i adaptaciya"
 /begin REF_CHARACTERISTIC CURVE_19515 CWGGLSV FFRITMS FRAOMN FRAOMX FRAORN FRAORX FRATMN FRATMX FRAUMN FRAUMX FRAURN FRAURX KFTPKOR NO1 NOLRA NU3 PHLSNHMN PHLSNVMN RLLRTMO RLLRUN RLO2 RLO3 RLO3AC RLU2 RLU2AC RLU3 RLU4 TABGMSVU TARAU TASHS THHA THHA2 THHAWU THSHA THVA THVA2 THVAWU TLRHS TMASO TMFRATMN TMNEB TMOHSMN TMOT_ADAPT TMRA1 TMRA2 TMSV TMSVA TREHS TRSA TSTEAA TUSEINV TVHSH TVHSV TVHSVMX TVLRHMN TVLRHMX UBHS UHSN /end REF_CHARACTERISTIC
/end GROUP
/begin GROUP G_Katalizator_i_zadniy_zond "Katalizator i zadniy zond"
 /begin REF_CHARACTERISTIC ADKATNF AHKATMN AHKATS AHKATSB AHKTMXT ANZDYNSH APEKTDX ATMABKA ATMABKK AVKATFS CDKATLK CWDLSAHK DKATCW DRLKTDP DRLKTDPT FALRKTD FALRKTT FATMRML FTMLAKH KATBFMNT KATBFN KATBFNM KATBFNP KATBFSX KATBSG KATBSH KATBSHG KATMEXML KFATMLA KFATMZW KFNLLKHM KFTATM MLSUS NDKTSOT NDKTSUT NFSKHM NKTDX RLDKTOT RLDKTUT TABGSTG TFRMB TLLASH TMAXKAT TMINKAT TMNKATT TMSUKTD TSALASH TUSCHUB TUSHSMIN TUSSA TWDKATST TWKTDLP USHLEAN USHRICH USHSTGMX USHSTSOLL USSCHUB ZDKATAD ZDKATAF ZDKATSH ZDKTBD ZDKTBF ZKTDRL /end REF_CHARACTERISTIC
/end GROUP
/begin GROUP G_Adsorber "Adsorber"
 /begin REF_CHARACTERISTIC KFFTEAX KFQTE KFTATX KFTEVP KFTVTEV KHCTEMN KHCTEMX TATELL TMSKLH TMSNOGA TTEVAZ TVDTEB TVDTEE ZBTEML /end REF_CHARACTERISTIC
/end GROUP
/begin GROUP G_Kondicioner "Kondicioner"
 /begin REF_CHARACTERISTIC KFTKONS LIMTKOA TKOAMNN TKOAMXN TKOEMNN TMKOAO TMKOAU TNACMX TVKOA TVKOE VKOAO VKOAU WDKKOAN_0 WDKKOAN_1 WDKKOEN /end REF_CHARACTERISTIC
/end GROUP
/begin GROUP G_Ohlazhdenie__ventilyator "Ohlazhdenie, ventilyator"
 /begin REF_CHARACTERISTIC KFIDTHM TAN_FAN TMLRTMS TMOT_FAN1 TMOT_FAN2 TMOT_FAN3 TMOT_FAN4 TMOT_FAN5 TMOT_FAN_HYS TWLRTMS /end REF_CHARACTERISTIC
/end GROUP
/begin GROUP G_Propuski_vosplameneniya "Propuski vosplameneniya" /begin REF_CHARACTERISTIC AINTKAN FSWALUV LURKH NMAX_MISF NMIN_MISF /end REF_CHARACTERISTIC /end GROUP
/begin GROUP G_Datchiki_i_prochie_vhody "Datchiki i prochie vhody" /begin REF_CHARACTERISTIC FUGKUE /end REF_CHARACTERISTIC /end GROUP
/begin GROUP G_Diagnostika_i_OBD "Diagnostika i OBD" /begin REF_CHARACTERISTIC DTC_CODES /end REF_CHARACTERISTIC /end GROUP
/begin GROUP G_Konfiguraciya__kodovye_slova "Konfiguraciya, kodovye slova" /begin REF_CHARACTERISTIC LS_CONFIG /end REF_CHARACTERISTIC /end GROUP
/begin GROUP G_Recirkulyaciya_OG__na_motore_n "Recirkulyaciya OG (na motore net)" /begin REF_CHARACTERISTIC KFFTAGRV KFFTDAG KFMDDAGR /end REF_CHARACTERISTIC /end GROUP
/begin GROUP G_Osi "Osi"
 /begin REF_CHARACTERISTIC SBF02MFSB SDK10TEUB SDN06LLSB SEZ06TMUB SFR05TEUB SGA06MFUB SKS06ESUB SLX06TMUW SML06TEUB SML06TMUB SML07TMUW SNM05DKUB SNM06LHUB SNM06LLUB SNM06MFUB SNM07ESUB SNM07LRUB SNM08DMUB SNM08GKUB SNM08LHUB SNM08__UB SNM10FEUB SNM10TEUB SNM12ESUB SNM12FEUB SNM16CIUB SNM16GKUB SNM16KRUB SNM16OPUB SNM16ZUUB SNM24ZUUB SQM05TEUB SRL04DYUB SRL04KRUB SRL06LHUB SRL06LRUB SRL08DMUB SRL11OPUW SRL12ESUB SRL12GKUB SRL12ZUUB SRL16ZUUB ST107TMUB ST307TMUB STA06ESUB STM04__UB STM05SAUB STM05TMUB STM06LLUB STM06__UB STM08DMUB STM08LEUB STM09ESUB STM12ESUB STS12ESUB STW06MDUB /end REF_CHARACTERISTIC
/end GROUP
/end MODULE
/end PROJECT
