ASAP2_VERSION 1 51
/begin PROJECT FBH3ID60 "Bosch M7.9.7 C167"
/begin HEADER "Kia Spectra 1.6 FBH3ID60" VERSION "1.0" /end HEADER
/begin MODULE FBH3ID60_MOD "Bosch M7.9.7"
/begin MOD_COMMON "little endian, alignment 1" BYTE_ORDER MSB_LAST ALIGNMENT_BYTE 1 ALIGNMENT_WORD 1 ALIGNMENT_LONG 1 /end MOD_COMMON
/begin COMPU_METHOD CM_IDENTITY "raw values" RAT_FUNC "%.3f" "" COEFFS 0 1 0 0 0 1 /end COMPU_METHOD
/begin COMPU_METHOD CM_40_0_rpm "scale 40" RAT_FUNC "%.1f" "rpm" COEFFS 0 1 0 0 0 40 /end COMPU_METHOD
/begin COMPU_METHOD CM_0p75_0 "scale 0.75" RAT_FUNC "%.3f" "%" COEFFS 0 1 0 0 0 0.75 /end COMPU_METHOD
/begin COMPU_METHOD CM_0p0234375_0 "scale 0.0234375" RAT_FUNC "%.3f" "%" COEFFS 0 1 0 0 0 0.0234375 /end COMPU_METHOD
/begin COMPU_METHOD CM_4_0_kgh "scale 4" RAT_FUNC "%.1f" "kg/h" COEFFS 0 1 0 0 0 4 /end COMPU_METHOD
/begin COMPU_METHOD CM_100_0_Umins "scale 100" RAT_FUNC "%.1f" "U/min/s" COEFFS 0 1 0 0 0 100 /end COMPU_METHOD
/begin COMPU_METHOD CM_40_0_Upm "scale 40" RAT_FUNC "%.1f" "Upm" COEFFS 0 1 0 0 0 40 /end COMPU_METHOD
/begin COMPU_METHOD CM_0p0625_0 "scale 0.0625" RAT_FUNC "%.3f" "-" COEFFS 0 1 0 0 0 0.0625 /end COMPU_METHOD
/begin COMPU_METHOD CM_0p75_48_GradC "scale 0.75" RAT_FUNC "%.3f" "Grad C" COEFFS 0 1 48 0 0 0.75 /end COMPU_METHOD
/begin COMPU_METHOD CM_0p5_0 "scale 0.5" RAT_FUNC "%.3f" "%" COEFFS 0 1 0 0 0 0.5 /end COMPU_METHOD
/begin COMPU_METHOD CM_0p390625_0 "scale 0.390625" RAT_FUNC "%.3f" "%" COEFFS 0 1 0 0 0 0.390625 /end COMPU_METHOD
/begin COMPU_METHOD CM_0p75_0_gradKW "scale 0.75" RAT_FUNC "%.3f" "grad KW" COEFFS 0 1 0 0 0 0.75 /end COMPU_METHOD
/begin COMPU_METHOD CM_0p00390625_0_Umin "scale 0.00390625" RAT_FUNC "%.3f" "%/(U/min)" COEFFS 0 1 0 0 0 0.00390625 /end COMPU_METHOD
/begin COMPU_METHOD CM_0p217_0_ms2 "scale 0.217" RAT_FUNC "%.3f" "m/s^2" COEFFS 0 1 0 0 0 0.217 /end COMPU_METHOD
/begin COMPU_METHOD CM_0p09803921569_0 "scale 0.0980392" RAT_FUNC "%.3f" "" COEFFS 0 1 0 0 0 0.09803921569 /end COMPU_METHOD
/begin COMPU_METHOD CM_0p03125_0 "scale 0.03125" RAT_FUNC "%.3f" "-" COEFFS 0 1 0 0 0 0.03125 /end COMPU_METHOD
/begin COMPU_METHOD CM_0p0078125_0 "scale 0.0078125" RAT_FUNC "%.3f" "-" COEFFS 0 1 0 0 0 0.0078125 /end COMPU_METHOD
/begin COMPU_METHOD CM_0p1_0_ms "scale 0.1" RAT_FUNC "%.3f" "ms" COEFFS 0 1 0 0 0 0.1 /end COMPU_METHOD
/begin COMPU_METHOD CM_10_0_Umin "scale 10" RAT_FUNC "%.1f" "U/min" COEFFS 0 1 0 0 0 10 /end COMPU_METHOD
/begin COMPU_METHOD CM_0p3906_0 "scale 0.3906" RAT_FUNC "%.3f" "%" COEFFS 0 1 0 0 0 0.3906 /end COMPU_METHOD
/begin COMPU_METHOD CM_n0p00048828125_0_sUmin "scale -0.000488281" RAT_FUNC "%.3f" "(%*s)/(U/min)" COEFFS 0 1 0 0 0 -0.00048828125 /end COMPU_METHOD
/begin COMPU_METHOD CM_0p00390625_0 "scale 0.00390625" RAT_FUNC "%.3f" "-" COEFFS 0 1 0 0 0 0.00390625 /end COMPU_METHOD
/begin COMPU_METHOD CM_0p0023828125_0_sUmin "scale 0.00238281" RAT_FUNC "%.3f" "%/(s*U/min)" COEFFS 0 1 0 0 0 0.0023828125 /end COMPU_METHOD
/begin COMPU_METHOD CM_0p001525878906_0 "scale 0.00152588" RAT_FUNC "%.3f" "-" COEFFS 0 1 0 0 0 0.001525878906 /end COMPU_METHOD
/begin COMPU_METHOD CM_0p02_0_s "scale 0.02" RAT_FUNC "%.3f" "s" COEFFS 0 1 0 0 0 0.02 /end COMPU_METHOD
/begin COMPU_METHOD CM_0p001953125_n0p75 "scale 0.00195312" RAT_FUNC "%.3f" "" COEFFS 0 1 -0.75 0 0 0.001953125 /end COMPU_METHOD
/begin COMPU_METHOD CM_0p01953125_0_V "scale 0.0195312" RAT_FUNC "%.3f" "V" COEFFS 0 1 0 0 0 0.01953125 /end COMPU_METHOD
/begin COMPU_METHOD CM_0p25_0_Umin "scale 0.25" RAT_FUNC "%.3f" "U/min" COEFFS 0 1 0 0 0 0.25 /end COMPU_METHOD
/begin COMPU_METHOD CM_0p78_0 "scale 0.78" RAT_FUNC "%.3f" "%" COEFFS 0 1 0 0 0 0.78 /end COMPU_METHOD
/begin COMPU_METHOD CM_0p0001220703125_0 "scale 0.00012207" RAT_FUNC "%.3f" "-" COEFFS 0 1 0 0 0 0.0001220703125 /end COMPU_METHOD
/begin COMPU_METHOD CM_0p09375_0 "scale 0.09375" RAT_FUNC "%.3f" "%" COEFFS 0 1 0 0 0 0.09375 /end COMPU_METHOD
/begin COMPU_METHOD CM_0p002666666667_0_ms "scale 0.00266667" RAT_FUNC "%.3f" "ms" COEFFS 0 1 0 0 0 0.002666666667 /end COMPU_METHOD
/begin COMPU_METHOD CM_0p046875_0 "scale 0.046875" RAT_FUNC "%.3f" "%" COEFFS 0 1 0 0 0 0.046875 /end COMPU_METHOD
/begin COMPU_METHOD CM_3p2_0_kgh "scale 3.2" RAT_FUNC "%.1f" "kg/h" COEFFS 0 1 0 0 0 3.2 /end COMPU_METHOD
/begin COMPU_METHOD CM_1p525878906En05_0 "scale 1.52588e-05" RAT_FUNC "%.3f" "-" COEFFS 0 1 0 0 0 1.525878906e-05 /end COMPU_METHOD
/begin COMPU_METHOD CM_3p051757812En05_0 "scale 3.05176e-05" RAT_FUNC "%.3f" "-" COEFFS 0 1 0 0 0 3.051757812e-05 /end COMPU_METHOD
/begin COMPU_METHOD CM_0p000390625_0_kgh "scale 0.000390625" RAT_FUNC "%.3f" "kg/h" COEFFS 0 1 0 0 0 0.000390625 /end COMPU_METHOD
/begin COMPU_METHOD CM_0p3921568627_0_DK "scale 0.392157" RAT_FUNC "%.3f" "% DK" COEFFS 0 1 0 0 0 0.3921568627 /end COMPU_METHOD
/begin COMPU_METHOD CM_5_50_GradC "scale 5" RAT_FUNC "%.1f" "Grad C" COEFFS 0 1 50 0 0 5 /end COMPU_METHOD
/begin COMPU_METHOD CM_0p01220703125_0_Upm "scale 0.012207" RAT_FUNC "%.3f" "%/Upm" COEFFS 0 1 0 0 0 0.01220703125 /end COMPU_METHOD
/begin COMPU_METHOD CM_0p01_0_s "scale 0.01" RAT_FUNC "%.3f" "s" COEFFS 0 1 0 0 0 0.01 /end COMPU_METHOD
/begin COMPU_METHOD CM_0p09764705882_0 "scale 0.0976471" RAT_FUNC "%.3f" "%" COEFFS 0 1 0 0 0 0.09764705882 /end COMPU_METHOD
/begin COMPU_METHOD CM_0p1960784314_0 "scale 0.196078" RAT_FUNC "%.3f" "%" COEFFS 0 1 0 0 0 0.1960784314 /end COMPU_METHOD
/begin COMPU_METHOD CM_0p1_0_s "scale 0.1" RAT_FUNC "%.3f" "s" COEFFS 0 1 0 0 0 0.1 /end COMPU_METHOD
/begin COMPU_METHOD CM_5_0_GradC "scale 5" RAT_FUNC "%.1f" "Grad C" COEFFS 0 1 0 0 0 5 /end COMPU_METHOD
/begin COMPU_METHOD CM_0p25_0 "scale 0.25" RAT_FUNC "%.3f" "-" COEFFS 0 1 0 0 0 0.25 /end COMPU_METHOD
/begin COMPU_METHOD CM_0p3058103976_0_s "scale 0.30581" RAT_FUNC "%.3f" "%/s" COEFFS 0 1 0 0 0 0.3058103976 /end COMPU_METHOD
/begin COMPU_METHOD CM_0p048828125_0 "scale 0.0488281" RAT_FUNC "%.3f" "%" COEFFS 0 1 0 0 0 0.048828125 /end COMPU_METHOD
/begin COMPU_METHOD CM_0p02275555556_0_kg "scale 0.0227556" RAT_FUNC "%.3f" "kg" COEFFS 0 1 0 0 0 0.02275555556 /end COMPU_METHOD
/begin COMPU_METHOD CM_1_n1 "scale 1" RAT_FUNC "%.1f" "-" COEFFS 0 1 -1 0 0 1 /end COMPU_METHOD
/begin COMPU_METHOD CM_n0p75_0_gradKW "scale -0.75" RAT_FUNC "%.3f" "grad KW" COEFFS 0 1 0 0 0 -0.75 /end COMPU_METHOD
/begin COMPU_METHOD CM_6_0_GradKW "scale 6" RAT_FUNC "%.1f" "Grad KW" COEFFS 0 1 0 0 0 6 /end COMPU_METHOD
/begin COMPU_METHOD CM_0p015625_0 "scale 0.015625" RAT_FUNC "%.3f" "-" COEFFS 0 1 0 0 0 0.015625 /end COMPU_METHOD
/begin COMPU_METHOD CM_0p001953125_0 "scale 0.00195312" RAT_FUNC "%.3f" "-" COEFFS 0 1 0 0 0 0.001953125 /end COMPU_METHOD
/begin COMPU_METHOD CM_4p768359375En05_0_1s "scale 4.76836e-05" RAT_FUNC "%.3f" "1/s" COEFFS 0 1 0 0 0 4.768359375e-05 /end COMPU_METHOD
/begin COMPU_METHOD CM_0p5_0_ms "scale 0.5" RAT_FUNC "%.3f" "ms" COEFFS 0 1 0 0 0 0.5 /end COMPU_METHOD
/begin COMPU_METHOD CM_20_0_s "scale 20" RAT_FUNC "%.1f" "s" COEFFS 0 1 0 0 0 20 /end COMPU_METHOD
/begin COMPU_METHOD CM_0p09103840683_0_kg "scale 0.0910384" RAT_FUNC "%.3f" "kg" COEFFS 0 1 0 0 0 0.09103840683 /end COMPU_METHOD
/begin COMPU_METHOD CM_0p000244140625_0 "scale 0.000244141" RAT_FUNC "%.3f" "-" COEFFS 0 1 0 0 0 0.000244140625 /end COMPU_METHOD
/begin COMPU_METHOD CM_0p1_0_kgh "scale 0.1" RAT_FUNC "%.3f" "kg/h" COEFFS 0 1 0 0 0 0.1 /end COMPU_METHOD
/begin COMPU_METHOD CM_0p003051757812_0 "scale 0.00305176" RAT_FUNC "%.3f" "%" COEFFS 0 1 0 0 0 0.003051757812 /end COMPU_METHOD
/begin COMPU_METHOD CM_0p0390625_0_hPa "scale 0.0390625" RAT_FUNC "%.3f" "hPa" COEFFS 0 1 0 0 0 0.0390625 /end COMPU_METHOD
/begin COMPU_METHOD CM_0p125_0 "scale 0.125" RAT_FUNC "%.3f" "-" COEFFS 0 1 0 0 0 0.125 /end COMPU_METHOD
/begin COMPU_METHOD CM_0p25_0_obmin "scale 0.25" RAT_FUNC "%.3f" "ob/min" COEFFS 0 1 0 0 0 0.25 /end COMPU_METHOD
/begin COMPU_METHOD CM_0p392157_0 "scale 0.392157" RAT_FUNC "%.3f" "%" COEFFS 0 1 0 0 0 0.392157 /end COMPU_METHOD
/begin COMPU_METHOD CM_0p001779359431_0_ms "scale 0.00177936" RAT_FUNC "%.3f" "ms/%" COEFFS 0 1 0 0 0 0.001779359431 /end COMPU_METHOD
/begin COMPU_METHOD CM_0p75_0_GradKW "scale 0.75" RAT_FUNC "%.3f" "Grad KW" COEFFS 0 1 0 0 0 0.75 /end COMPU_METHOD
/begin COMPU_METHOD CM_0p00152588_0_otopornogomoment "scale 0.00152588" RAT_FUNC "%.3f" "% ot opornogo momenta" COEFFS 0 1 0 0 0 0.00152588 /end COMPU_METHOD
/begin COMPU_METHOD CM_0p0234375_0_napolneniya "scale 0.0234375" RAT_FUNC "%.3f" "% napolneniya" COEFFS 0 1 0 0 0 0.0234375 /end COMPU_METHOD
/begin COMPU_METHOD CM_0p001525878906_0_momenta "scale 0.00152588" RAT_FUNC "%.3f" "% momenta" COEFFS 0 1 0 0 0 0.001525878906 /end COMPU_METHOD
/begin COMPU_METHOD CM_0p001525878906_0_otopornogomo "scale 0.00152588" RAT_FUNC "%.3f" "% ot opornogo momenta" COEFFS 0 1 0 0 0 0.001525878906 /end COMPU_METHOD
/begin COMPU_METHOD CM_n0p75_0_KV "scale -0.75" RAT_FUNC "%.3f" "KV" COEFFS 0 1 0 0 0 -0.75 /end COMPU_METHOD
/begin COMPU_METHOD CM_40_0_obmin "scale 40" RAT_FUNC "%.1f" "ob/min" COEFFS 0 1 0 0 0 40 /end COMPU_METHOD
/begin COMPU_METHOD CM_5_n50_C "scale 5" RAT_FUNC "%.1f" "C" COEFFS 0 1 -50 0 0 5 /end COMPU_METHOD
/begin COMPU_METHOD CM_0p005215686275_0p2_V "scale 0.00521569" RAT_FUNC "%.3f" "V" COEFFS 0 1 0.2 0 0 0.005215686275 /end COMPU_METHOD
/begin COMPU_METHOD CM_0p52_0_mVms "scale 0.52" RAT_FUNC "%.3f" "mV/ms" COEFFS 0 1 0 0 0 0.52 /end COMPU_METHOD
/begin COMPU_METHOD CM_0p09362_0_1V "scale 0.09362" RAT_FUNC "%.3f" "1/V" COEFFS 0 1 0 0 0 0.09362 /end COMPU_METHOD
/begin COMPU_METHOD CM_0p005215686275_0_V "scale 0.00521569" RAT_FUNC "%.3f" "V" COEFFS 0 1 0 0 0 0.005215686275 /end COMPU_METHOD
/begin COMPU_METHOD CM_0p8695652174_0_mg "scale 0.869565" RAT_FUNC "%.3f" "mg" COEFFS 0 1 0 0 0 0.8695652174 /end COMPU_METHOD
/begin COMPU_METHOD CM_0p8695652174_0_mgs "scale 0.869565" RAT_FUNC "%.3f" "mg/s" COEFFS 0 1 0 0 0 0.8695652174 /end COMPU_METHOD
/begin COMPU_METHOD CM_0p05_0_s "scale 0.05" RAT_FUNC "%.3f" "s" COEFFS 0 1 0 0 0 0.05 /end COMPU_METHOD
/begin COMPU_METHOD CM_0p01_0 "scale 0.01" RAT_FUNC "%.3f" "-" COEFFS 0 1 0 0 0 0.01 /end COMPU_METHOD
/begin COMPU_METHOD CM_0p01_0p05_s "scale 0.01" RAT_FUNC "%.3f" "s" COEFFS 0 1 0.05 0 0 0.01 /end COMPU_METHOD
/begin COMPU_METHOD CM_0p0704_0_V "scale 0.0704" RAT_FUNC "%.3f" "V" COEFFS 0 1 0 0 0 0.0704 /end COMPU_METHOD
/begin COMPU_METHOD CM_0p02392578125_0_1s "scale 0.0239258" RAT_FUNC "%.3f" "1/s" COEFFS 0 1 0 0 0 0.02392578125 /end COMPU_METHOD
/begin COMPU_METHOD CM_0p0444_0_g "scale 0.0444" RAT_FUNC "%.3f" "g" COEFFS 0 1 0 0 0 0.0444 /end COMPU_METHOD
/begin COMPU_METHOD CM_0p2_0_s "scale 0.2" RAT_FUNC "%.3f" "s" COEFFS 0 1 0 0 0 0.2 /end COMPU_METHOD
/begin COMPU_METHOD CM_1p25_0_kmh "scale 1.25" RAT_FUNC "%.1f" "km/h" COEFFS 0 1 0 0 0 1.25 /end COMPU_METHOD
/begin COMPU_METHOD CM_7p8125En06_0_kgh1min "scale 7.8125e-06" RAT_FUNC "%.3f" "(kg/h)/(1/min)/%" COEFFS 0 1 0 0 0 7.8125e-06 /end COMPU_METHOD
/begin COMPU_METHOD CM_0p00078125_0 "scale 0.00078125" RAT_FUNC "%.3f" "" COEFFS 0 1 0 0 0 0.00078125 /end COMPU_METHOD
/begin COMPU_METHOD CM_0p001525878906_0_ugladrossely "scale 0.00152588" RAT_FUNC "%.3f" "% ugla drosselya" COEFFS 0 1 0 0 0 0.001525878906 /end COMPU_METHOD
/begin COMPU_METHOD CM_0p01219512195_0_ugoldrosselya "scale 0.0121951" RAT_FUNC "%.3f" "ugol drosselya, grad" COEFFS 0 1 0 0 0 0.01219512195 /end COMPU_METHOD
/begin COMPU_METHOD CM_0p0078125_0_mnozhitel "scale 0.0078125" RAT_FUNC "%.3f" "mnozhitel" COEFFS 0 1 0 0 0 0.0078125 /end COMPU_METHOD
/begin RECORD_LAYOUT RL_AXIS_U8 NO_AXIS_PTS_X 1 UBYTE AXIS_PTS_X 2 UBYTE INDEX_INCR DIRECT /end RECORD_LAYOUT
/begin RECORD_LAYOUT RL_AXIS_U16 NO_AXIS_PTS_X 1 UWORD AXIS_PTS_X 2 UWORD INDEX_INCR DIRECT /end RECORD_LAYOUT
/begin RECORD_LAYOUT RL_GRID_UBYTE FNC_VALUES 1 UBYTE ROW_DIR DIRECT /end RECORD_LAYOUT
/begin RECORD_LAYOUT RL_GRID_SBYTE FNC_VALUES 1 SBYTE ROW_DIR DIRECT /end RECORD_LAYOUT
/begin RECORD_LAYOUT RL_3D_A8_UBYTE NO_AXIS_PTS_Y 1 UBYTE NO_AXIS_PTS_X 2 UBYTE AXIS_PTS_Y 3 UBYTE INDEX_INCR DIRECT AXIS_PTS_X 4 UBYTE INDEX_INCR DIRECT FNC_VALUES 5 UBYTE ROW_DIR DIRECT /end RECORD_LAYOUT
/begin RECORD_LAYOUT RL_2D_A8_UBYTE NO_AXIS_PTS_X 1 UBYTE AXIS_PTS_X 2 UBYTE INDEX_INCR DIRECT FNC_VALUES 3 UBYTE ROW_DIR DIRECT /end RECORD_LAYOUT
/begin RECORD_LAYOUT RL_3D_A8_UWORD NO_AXIS_PTS_Y 1 UBYTE NO_AXIS_PTS_X 2 UBYTE AXIS_PTS_Y 3 UBYTE INDEX_INCR DIRECT AXIS_PTS_X 4 UBYTE INDEX_INCR DIRECT FNC_VALUES 5 UWORD ROW_DIR DIRECT /end RECORD_LAYOUT
/begin RECORD_LAYOUT RL_2D_A16_UWORD NO_AXIS_PTS_X 1 UBYTE AXIS_PTS_X 2 UWORD INDEX_INCR DIRECT FNC_VALUES 3 UWORD ROW_DIR DIRECT /end RECORD_LAYOUT
/begin RECORD_LAYOUT RL_2D_A8_UWORD NO_AXIS_PTS_X 1 UBYTE AXIS_PTS_X 2 UBYTE INDEX_INCR DIRECT FNC_VALUES 3 UWORD ROW_DIR DIRECT /end RECORD_LAYOUT
/begin RECORD_LAYOUT RL_3D_A8_SBYTE NO_AXIS_PTS_Y 1 UBYTE NO_AXIS_PTS_X 2 UBYTE AXIS_PTS_Y 3 UBYTE INDEX_INCR DIRECT AXIS_PTS_X 4 UBYTE INDEX_INCR DIRECT FNC_VALUES 5 SBYTE ROW_DIR DIRECT /end RECORD_LAYOUT
/begin RECORD_LAYOUT RL_GRID_UWORD FNC_VALUES 1 UWORD ROW_DIR DIRECT /end RECORD_LAYOUT
/begin RECORD_LAYOUT RL_GRID_SWORD FNC_VALUES 1 SWORD ROW_DIR DIRECT /end RECORD_LAYOUT
/begin RECORD_LAYOUT RL_2D_A16_UBYTE NO_AXIS_PTS_X 1 UBYTE AXIS_PTS_X 2 UWORD INDEX_INCR DIRECT FNC_VALUES 3 UBYTE ROW_DIR DIRECT /end RECORD_LAYOUT
/begin RECORD_LAYOUT RL_AXIS_BARE_UBYTE AXIS_PTS_X 1 UBYTE INDEX_INCR DIRECT /end RECORD_LAYOUT
/begin RECORD_LAYOUT RL_AXIS_BARE_UWORD AXIS_PTS_X 1 UWORD INDEX_INCR DIRECT /end RECORD_LAYOUT
/begin AXIS_PTS SNM16_ZU "engine speed, 16 points" 0x10103 NO_INPUT_QUANTITY RL_AXIS_U8 0 CM_40_0_rpm 16 0 10200 /end AXIS_PTS
/begin AXIS_PTS SNM16_OP "engine speed for KFZWOP, 16 points" 0x100F2 NO_INPUT_QUANTITY RL_AXIS_U8 0 CM_40_0_rpm 16 0 10200 /end AXIS_PTS
/begin AXIS_PTS SRL12_ZU "relative load, 12 points" 0x10157 NO_INPUT_QUANTITY RL_AXIS_U8 0 CM_0p75_0 12 0 191.25 /end AXIS_PTS
/begin AXIS_PTS SRL11_OP "relative load for KFZWOP, 11 points" 0x14B70 NO_INPUT_QUANTITY RL_AXIS_U16 0 CM_0p0234375_0 11 0 1535.98 /end AXIS_PTS
/begin AXIS_PTS SNM16_GK "engine speed for KFLBTS, 16 points" 0x181F7 NO_INPUT_QUANTITY RL_AXIS_U8 0 CM_40_0_rpm 16 0 10200 /end AXIS_PTS
/begin AXIS_PTS SRL12_GK "relative load for KFLBTS, 12 points" 0x1821E NO_INPUT_QUANTITY RL_AXIS_U8 0 CM_0p75_0 12 0 191.25 /end AXIS_PTS
/begin AXIS_PTS SNM08_KO "engine speed for A/C compressor, 8 points" 0x119D9 NO_INPUT_QUANTITY RL_AXIS_U8 0 CM_40_0_rpm 8 0 10200 /end AXIS_PTS
/begin AXIS_PTS AX_18FCB_Y "rpm" 0x18FCB NO_INPUT_QUANTITY RL_AXIS_BARE_UBYTE 0 CM_40_0_rpm 6 -0 10200 /end AXIS_PTS
/begin AXIS_PTS AX_18FD8_Y "rpm" 0x18FD8 NO_INPUT_QUANTITY RL_AXIS_BARE_UBYTE 0 CM_40_0_rpm 6 -0 10200 /end AXIS_PTS
/begin AXIS_PTS AX_18FE5_Y "rpm" 0x18FE5 NO_INPUT_QUANTITY RL_AXIS_BARE_UBYTE 0 CM_40_0_rpm 6 -0 10200 /end AXIS_PTS
/begin AXIS_PTS AX_1955C_Y "rpm" 0x1955C NO_INPUT_QUANTITY RL_AXIS_BARE_UBYTE 0 CM_40_0_rpm 6 -0 10200 /end AXIS_PTS
/begin AXIS_PTS AX_19569_Y "rpm" 0x19569 NO_INPUT_QUANTITY RL_AXIS_BARE_UBYTE 0 CM_40_0_rpm 6 -0 10200 /end AXIS_PTS
/begin AXIS_PTS AX_18AC1_Y "Grad C" 0x18AC1 NO_INPUT_QUANTITY RL_AXIS_BARE_UBYTE 0 CM_0p75_48_GradC 8 -48 143.25 /end AXIS_PTS
/begin AXIS_PTS AX_18AD2_Y "rpm" 0x18AD2 NO_INPUT_QUANTITY RL_AXIS_BARE_UBYTE 0 CM_40_0_rpm 8 -0 10200 /end AXIS_PTS
/begin AXIS_PTS AX_14BE0_X "% momenta" 0x14BE0 NO_INPUT_QUANTITY RL_AXIS_BARE_UWORD 0 CM_0p001525878906_0_momenta 12 -0 99.9985 /end AXIS_PTS
/begin AXIS_PTS AX_14BC0_Y "ob/min" 0x14BC0 NO_INPUT_QUANTITY RL_AXIS_BARE_UWORD 0 CM_0p25_0_obmin 16 -0 16383.8 /end AXIS_PTS
/begin AXIS_PTS AX_1512A_X "% napolneniya" 0x1512A NO_INPUT_QUANTITY RL_AXIS_BARE_UWORD 0 CM_0p0234375_0_napolneniya 12 -0 1535.98 /end AXIS_PTS
/begin AXIS_PTS AX_15116_Y "ob/min" 0x15116 NO_INPUT_QUANTITY RL_AXIS_BARE_UWORD 0 CM_0p25_0_obmin 10 -0 16383.8 /end AXIS_PTS
/begin AXIS_PTS AX_19516_Y "rpm" 0x19516 NO_INPUT_QUANTITY RL_AXIS_BARE_UBYTE 0 CM_40_0_rpm 10 -0 10200 /end AXIS_PTS
/begin AXIS_PTS AX_11581_Y "rpm" 0x11581 NO_INPUT_QUANTITY RL_AXIS_BARE_UBYTE 0 CM_40_0_rpm 6 -0 10200 /end AXIS_PTS
/begin AXIS_PTS AX_15688_X "% ugla drosselya" 0x15688 NO_INPUT_QUANTITY RL_AXIS_BARE_UWORD 0 CM_IDENTITY 6 -0 65535 /end AXIS_PTS
/begin AXIS_PTS AX_15668_Y "pspvdk" 0x15668 NO_INPUT_QUANTITY RL_AXIS_BARE_UWORD 0 CM_IDENTITY 16 -0 65535 /end AXIS_PTS
/begin AXIS_PTS AX_1AC92_X "ob/min" 0x1AC92 NO_INPUT_QUANTITY RL_AXIS_BARE_UWORD 0 CM_0p25_0_obmin 12 -0 16383.8 /end AXIS_PTS
/begin AXIS_PTS AX_1AC7A_Y "ugol drosselya, grad" 0x1AC7A NO_INPUT_QUANTITY RL_AXIS_BARE_UWORD 0 CM_0p01219512195_0_ugoldrosselya 12 -0 799.207 /end AXIS_PTS
/begin AXIS_PTS AX_11A2F_Y "Grad C" 0x11A2F NO_INPUT_QUANTITY RL_AXIS_BARE_UBYTE 0 CM_0p75_48_GradC 6 -48 143.25 /end AXIS_PTS
/begin CHARACTERISTIC SGA08MDUB "podtverzhdena damos addr 0x10068 | base point distribution of actual gear 8 b.pt." CURVE 0x10068 RL_GRID_UBYTE 0 CM_IDENTITY 0 255
 /begin AXIS_DESCR FIX_AXIS NO_INPUT_QUANTITY CM_IDENTITY 8 0 7 FIX_AXIS_PAR_DIST 0 1 8 /end AXIS_DESCR
/end CHARACTERISTIC
/begin CHARACTERISTIC SML05DKUB "podtverzhdena damos addr 0x10071 | base point distribution air mass" CURVE 0x10071 RL_GRID_UBYTE 0 CM_4_0_kgh 0 1020
 /begin AXIS_DESCR FIX_AXIS NO_INPUT_QUANTITY CM_IDENTITY 5 0 4 FIX_AXIS_PAR_DIST 0 1 5 /end AXIS_DESCR
/end CHARACTERISTIC
/begin CHARACTERISTIC SML05LKUB "podtverzhdena damos addr 0x10077" CURVE 0x10077 RL_GRID_UBYTE 0 CM_4_0_kgh 0 1020
 /begin AXIS_DESCR FIX_AXIS NO_INPUT_QUANTITY CM_IDENTITY 5 0 4 FIX_AXIS_PAR_DIST 0 1 5 /end AXIS_DESCR
/end CHARACTERISTIC
/begin CHARACTERISTIC SML08LHUB "podtverzhdena damos addr 0x1007D | ml dependet basic point (number 8)" CURVE 0x1007D RL_GRID_UBYTE 0 CM_4_0_kgh 0 1020
 /begin AXIS_DESCR FIX_AXIS NO_INPUT_QUANTITY CM_IDENTITY 8 0 7 FIX_AXIS_PAR_DIST 0 1 8 /end AXIS_DESCR
/end CHARACTERISTIC
/begin CHARACTERISTIC SNG06LLSB "adres podtverzhden damos-veroyatno addr 0x10086 | IMYA NE PODTVERZHDENO, adres: kod: mov r12, #0x85 @0x834C6C | Datapoint distribution, speed gradient, 6 datapoints" CURVE 0x10086 RL_GRID_SBYTE 0 CM_100_0_Umins -12800 12700
 /begin AXIS_DESCR FIX_AXIS NO_INPUT_QUANTITY CM_IDENTITY 6 0 5 FIX_AXIS_PAR_DIST 0 1 6 /end AXIS_DESCR
/end CHARACTERISTIC
/begin CHARACTERISTIC SNM05DKUB "podtverzhdena damos addr 0x1008D | base point distribution nmot" CURVE 0x1008D RL_GRID_UBYTE 0 CM_40_0_Upm 0 10200
 /begin AXIS_DESCR FIX_AXIS NO_INPUT_QUANTITY CM_IDENTITY 5 0 4 FIX_AXIS_PAR_DIST 0 1 5 /end AXIS_DESCR
/end CHARACTERISTIC
/begin CHARACTERISTIC SNM06LLUB "podtverzhdena damos addr 0x10093 | distribution of engine speed" CURVE 0x10093 RL_GRID_UBYTE 0 CM_40_0_Upm 0 10200
 /begin AXIS_DESCR FIX_AXIS NO_INPUT_QUANTITY CM_IDENTITY 6 0 5 FIX_AXIS_PAR_DIST 0 1 6 /end AXIS_DESCR
/end CHARACTERISTIC
/begin CHARACTERISTIC SNM07LRUB "podtverzhdena damos addr 0x1009A" CURVE 0x1009A RL_GRID_UBYTE 0 CM_40_0_Upm 0 10200
 /begin AXIS_DESCR FIX_AXIS NO_INPUT_QUANTITY CM_IDENTITY 7 0 6 FIX_AXIS_PAR_DIST 0 1 7 /end AXIS_DESCR
/end CHARACTERISTIC
/begin CHARACTERISTIC SNM08DMUB "podtverzhdena damos addr 0x100A2 | Datapoint distribution in DMD, 8 speed datapoints" CURVE 0x100A2 RL_GRID_UBYTE 0 CM_40_0_Upm 0 10200
 /begin AXIS_DESCR FIX_AXIS NO_INPUT_QUANTITY CM_IDENTITY 8 0 7 FIX_AXIS_PAR_DIST 0 1 8 /end AXIS_DESCR
/end CHARACTERISTIC
/begin CHARACTERISTIC SNM08LHUB "podtverzhdena damos addr 0x100AB | nmot dependet basic point (number 8)" CURVE 0x100AB RL_GRID_UBYTE 0 CM_40_0_Upm 0 10200
 /begin AXIS_DESCR FIX_AXIS NO_INPUT_QUANTITY CM_IDENTITY 8 0 7 FIX_AXIS_PAR_DIST 0 1 8 /end AXIS_DESCR
/end CHARACTERISTIC
/begin CHARACTERISTIC SNM08__UB "podtverzhdena damos addr 0x100B4 | Base point distribution engine speed, 8 base points" CURVE 0x100B4 RL_GRID_UBYTE 0 CM_40_0_Upm 0 10200
 /begin AXIS_DESCR FIX_AXIS NO_INPUT_QUANTITY CM_IDENTITY 8 0 7 FIX_AXIS_PAR_DIST 0 1 8 /end AXIS_DESCR
/end CHARACTERISTIC
/begin CHARACTERISTIC SNM10FEUB "podtverzhdena damos addr 0x100BD" CURVE 0x100BD RL_GRID_UBYTE 0 CM_40_0_Upm 0 10200
 /begin AXIS_DESCR FIX_AXIS NO_INPUT_QUANTITY CM_IDENTITY 10 0 9 FIX_AXIS_PAR_DIST 0 1 10 /end AXIS_DESCR
/end CHARACTERISTIC
/begin CHARACTERISTIC SNM12ESUB "podtverzhdena damos addr 0x100C8 | Distribution for the engine speed nmot" CURVE 0x100C8 RL_GRID_UBYTE 0 CM_40_0_Upm 0 10200
 /begin AXIS_DESCR FIX_AXIS NO_INPUT_QUANTITY CM_IDENTITY 12 0 11 FIX_AXIS_PAR_DIST 0 1 12 /end AXIS_DESCR
/end CHARACTERISTIC
/begin CHARACTERISTIC SNM12FEUB_100D5 "podtverzhdena damos addr 0x100D5 | set points of WDKSMX, WDKUGDN" CURVE 0x100D5 RL_GRID_UBYTE 0 CM_40_0_Upm 0 10200
 /begin AXIS_DESCR FIX_AXIS NO_INPUT_QUANTITY CM_IDENTITY 12 0 11 FIX_AXIS_PAR_DIST 0 1 12 /end AXIS_DESCR
/end CHARACTERISTIC
/begin CHARACTERISTIC SNM16CIUB "podtverzhdena damos addr 0x100E2 | Base point distribution of engine speed, 16 base pts." CURVE 0x100E2 RL_GRID_UBYTE 0 CM_40_0_Upm 0 10200
 /begin AXIS_DESCR FIX_AXIS NO_INPUT_QUANTITY CM_IDENTITY 16 0 15 FIX_AXIS_PAR_DIST 0 1 16 /end AXIS_DESCR
/end CHARACTERISTIC
/begin CHARACTERISTIC SNM16OPUB "podtverzhdena damos addr 0x100F3" CURVE 0x100F3 RL_GRID_UBYTE 0 CM_40_0_Upm 0 10200
 /begin AXIS_DESCR FIX_AXIS NO_INPUT_QUANTITY CM_IDENTITY 16 0 15 FIX_AXIS_PAR_DIST 0 1 16 /end AXIS_DESCR
/end CHARACTERISTIC
/begin CHARACTERISTIC SNM16ZUUB "podtverzhdena damos addr 0x10104 | datapoint distribution engine speed, 16 datapoints" CURVE 0x10104 RL_GRID_UBYTE 0 CM_40_0_Upm 0 10200
 /begin AXIS_DESCR FIX_AXIS NO_INPUT_QUANTITY CM_IDENTITY 16 0 15 FIX_AXIS_PAR_DIST 0 1 16 /end AXIS_DESCR
/end CHARACTERISTIC
/begin CHARACTERISTIC SNM24ZUUB "podtverzhdena damos addr 0x10115 | datapoint distribution of engine speed, 24 datapoints" CURVE 0x10115 RL_GRID_UBYTE 0 CM_40_0_Upm 0 10200
 /begin AXIS_DESCR FIX_AXIS NO_INPUT_QUANTITY CM_IDENTITY 24 0 23 FIX_AXIS_PAR_DIST 0 1 24 /end AXIS_DESCR
/end CHARACTERISTIC
/begin CHARACTERISTIC SQM05TEUB "podtverzhdena damos addr 0x1012E | air mass quotient dependet basic point (number =5)" CURVE 0x1012E RL_GRID_UBYTE 0 CM_0p0625_0 0 15.9375
 /begin AXIS_DESCR FIX_AXIS NO_INPUT_QUANTITY CM_IDENTITY 5 0 4 FIX_AXIS_PAR_DIST 0 1 5 /end AXIS_DESCR
/end CHARACTERISTIC
/begin CHARACTERISTIC SRL06LHUB "podtverzhdena damos addr 0x10134" CURVE 0x10134 RL_GRID_UBYTE 0 CM_0p75_0 0 191.25
 /begin AXIS_DESCR FIX_AXIS NO_INPUT_QUANTITY CM_IDENTITY 6 0 5 FIX_AXIS_PAR_DIST 0 1 6 /end AXIS_DESCR
/end CHARACTERISTIC
/begin CHARACTERISTIC SRL06LRUB "podtverzhdena damos addr 0x1013B" CURVE 0x1013B RL_GRID_UBYTE 0 CM_0p75_0 0 191.25
 /begin AXIS_DESCR FIX_AXIS NO_INPUT_QUANTITY CM_IDENTITY 6 0 5 FIX_AXIS_PAR_DIST 0 1 6 /end AXIS_DESCR
/end CHARACTERISTIC
/begin CHARACTERISTIC SRL08DMUB "podtverzhdena damos addr 0x10142" CURVE 0x10142 RL_GRID_UBYTE 0 CM_0p75_0 0 191.25
 /begin AXIS_DESCR FIX_AXIS NO_INPUT_QUANTITY CM_IDENTITY 8 0 7 FIX_AXIS_PAR_DIST 0 1 8 /end AXIS_DESCR
/end CHARACTERISTIC
/begin CHARACTERISTIC SRL12ESUB "podtverzhdena damos addr 0x1014B | Distribution for the relative air charge rl" CURVE 0x1014B RL_GRID_UBYTE 0 CM_0p75_0 0 191.25
 /begin AXIS_DESCR FIX_AXIS NO_INPUT_QUANTITY CM_IDENTITY 12 0 11 FIX_AXIS_PAR_DIST 0 1 12 /end AXIS_DESCR
/end CHARACTERISTIC
/begin CHARACTERISTIC SRL12ZUUB "podtverzhdena damos addr 0x10158 | datapoint distribution relative air charge, 12 datapoints" CURVE 0x10158 RL_GRID_UBYTE 0 CM_0p75_0 0 191.25
 /begin AXIS_DESCR FIX_AXIS NO_INPUT_QUANTITY CM_IDENTITY 12 0 11 FIX_AXIS_PAR_DIST 0 1 12 /end AXIS_DESCR
/end CHARACTERISTIC
/begin CHARACTERISTIC SRL16ZUUB "podtverzhdena damos addr 0x10165 | datapoint distribution relative charge, 16 datapoints" CURVE 0x10165 RL_GRID_UBYTE 0 CM_0p75_0 0 191.25
 /begin AXIS_DESCR FIX_AXIS NO_INPUT_QUANTITY CM_IDENTITY 16 0 15 FIX_AXIS_PAR_DIST 0 1 16 /end AXIS_DESCR
/end CHARACTERISTIC
/begin CHARACTERISTIC STM12ESUB "podtverzhdena damos addr 0x10176 | Distribution for the engine coolant temperature tmot" CURVE 0x10176 RL_GRID_UBYTE 0 CM_0p75_48_GradC -48 143.25
 /begin AXIS_DESCR FIX_AXIS NO_INPUT_QUANTITY CM_IDENTITY 12 0 11 FIX_AXIS_PAR_DIST 0 1 12 /end AXIS_DESCR
/end CHARACTERISTIC
/begin CHARACTERISTIC NARASTG "adres podtverzhden damos-veroyatno addr 0x101E9 | IMYA NE PODTVERZHDENO, adres: kod: movb RL5, [r4+#0x1e8] @0x83A9C6 | RPM threshold in higher gear for AR active" CURVE 0x101E9 RL_GRID_UBYTE 0 CM_40_0_Upm 0 10200
 /begin AXIS_DESCR FIX_AXIS NO_INPUT_QUANTITY CM_IDENTITY 6 0 5 FIX_AXIS_PAR_DIST 0 1 6 /end AXIS_DESCR
/end CHARACTERISTIC
/begin CHARACTERISTIC KFETAZW "podtverzhdena profil addr 0x101F4 | Karta KPD po uglu operezheniya zazhiganiya. Klassicheskiy format Bosch: zagolovok nx/ny i osi vnutri bloka." MAP 0x101F4 RL_3D_A8_UBYTE 0 CM_0p5_0 0 127.5 /begin AXIS_DESCR STD_AXIS NO_INPUT_QUANTITY CM_IDENTITY 16 0 255 /end AXIS_DESCR /begin AXIS_DESCR STD_AXIS NO_INPUT_QUANTITY CM_IDENTITY 16 0 255 /end AXIS_DESCR /end CHARACTERISTIC
/begin CHARACTERISTIC KFETAZWN "podtverzhdena profil addr 0x10316 | To zhe na holostom hodu." MAP 0x10316 RL_3D_A8_UBYTE 0 CM_0p5_0 0 127.5 /begin AXIS_DESCR STD_AXIS NO_INPUT_QUANTITY CM_IDENTITY 16 0 255 /end AXIS_DESCR /begin AXIS_DESCR STD_AXIS NO_INPUT_QUANTITY CM_IDENTITY 16 0 255 /end AXIS_DESCR /end CHARACTERISTIC
/begin CHARACTERISTIC KFMPED "podtverzhdena damos-tochno addr 0x10452 | MDFAW" MAP 0x10452 RL_GRID_UBYTE 0 CM_0p390625_0 0 99.6094
 /begin AXIS_DESCR FIX_AXIS NO_INPUT_QUANTITY CM_IDENTITY 8 0 7 FIX_AXIS_PAR_DIST 0 1 8 /end AXIS_DESCR
 /begin AXIS_DESCR FIX_AXIS NO_INPUT_QUANTITY CM_IDENTITY 16 0 15 FIX_AXIS_PAR_DIST 0 1 16 /end AXIS_DESCR
/end CHARACTERISTIC
/begin CHARACTERISTIC ETADZW "adres podtverzhden damos-veroyatno addr 0x104D3 | IMYA NE PODTVERZHDENO, adres: kod: movb RL5, [r4+#0x4d3] @0x83B5A6 | ignition efficiency depending on delta ignition angle" CURVE 0x104D3 RL_GRID_UBYTE 0 CM_0p5_0 0 127.5
 /begin AXIS_DESCR FIX_AXIS NO_INPUT_QUANTITY CM_IDENTITY 65 0 64 FIX_AXIS_PAR_DIST 0 1 65 /end AXIS_DESCR
/end CHARACTERISTIC
/begin CHARACTERISTIC ETALAM_10515 "podtverzhdena damos addr 0x10515 | Lambda effectiveness" CURVE 0x10515 RL_GRID_UBYTE 0 CM_0p5_0 0 127.5
 /begin AXIS_DESCR FIX_AXIS NO_INPUT_QUANTITY CM_IDENTITY 10 0 9 FIX_AXIS_PAR_DIST 0 1 10 /end AXIS_DESCR
/end CHARACTERISTIC
/begin CHARACTERISTIC KFZWOP "podtverzhdena profil addr 0x10529 | Optimalnyy ugol operezheniya zazhiganiya. Stolbcy = nagruzka (11 tochek, os SRL11OPUW), stroki = oboroty (16 tochek, os SNM16OPUB, x40 ob/min). Stok 0.75..45 grad. " MAP 0x10529 RL_GRID_SBYTE 0 CM_0p75_0_gradKW -96 95.25
 /begin AXIS_DESCR COM_AXIS NO_INPUT_QUANTITY CM_0p0234375_0 11 0 1535.98 AXIS_PTS_REF SRL11_OP /end AXIS_DESCR
 /begin AXIS_DESCR COM_AXIS NO_INPUT_QUANTITY CM_40_0_rpm 16 0 10200 AXIS_PTS_REF SNM16_OP /end AXIS_DESCR
/end CHARACTERISTIC
/begin CHARACTERISTIC NMAXPRL "podtverzhdena damos addr 0x105DB | P-element in NMAX control" CURVE 0x105DB RL_GRID_UBYTE 0 CM_0p00390625_0_Umin 0 0.996094
 /begin AXIS_DESCR FIX_AXIS NO_INPUT_QUANTITY CM_IDENTITY 8 0 7 FIX_AXIS_PAR_DIST 0 1 8 /end AXIS_DESCR
/end CHARACTERISTIC
/begin CHARACTERISTIC NMXDAEF "podtverzhdena damos addr 0x105EC | maximum permitted engine speed for throttle actuator substitute function" CURVE 0x105EC RL_GRID_UBYTE 0 CM_40_0_Upm 0 10200
 /begin AXIS_DESCR FIX_AXIS NO_INPUT_QUANTITY CM_IDENTITY 6 0 5 FIX_AXIS_PAR_DIST 0 1 6 /end AXIS_DESCR
/end CHARACTERISTIC
/begin CHARACTERISTIC ZINMAXRL "podtverzhdena damos addr 0x105FA | I-gradient for NMAX control" CURVE 0x105FA RL_GRID_UBYTE 0 CM_IDENTITY 0 255
 /begin AXIS_DESCR FIX_AXIS NO_INPUT_QUANTITY CM_IDENTITY 8 0 7 FIX_AXIS_PAR_DIST 0 1 8 /end AXIS_DESCR
/end CHARACTERISTIC
/begin CHARACTERISTIC RLMNN "adres podtverzhden damos-veroyatno addr 0x1060D | IMYA NE PODTVERZHDENO, adres: kod: add DPP0, #0x60d @0x82DF2A | characteristic minimum charge" CURVE 0x1060D RL_GRID_UBYTE 0 CM_0p75_0 0 191.25
 /begin AXIS_DESCR FIX_AXIS NO_INPUT_QUANTITY CM_IDENTITY 10 0 9 FIX_AXIS_PAR_DIST 0 1 10 /end AXIS_DESCR
/end CHARACTERISTIC
/begin CHARACTERISTIC RLMNSAN "adres podtverzhden damos-veroyatno addr 0x10617 | IMYA NE PODTVERZHDENO, adres: kod: mov r12, #0x617 @0x83C2E0 | characteristic minimum charge in overrun" CURVE 0x10617 RL_GRID_UBYTE 0 CM_0p75_0 0 191.25
 /begin AXIS_DESCR FIX_AXIS NO_INPUT_QUANTITY CM_IDENTITY 10 0 9 FIX_AXIS_PAR_DIST 0 1 10 /end AXIS_DESCR
/end CHARACTERISTIC
/begin CHARACTERISTIC KFMIRED "adres podtverzhden damos-veroyatno addr 0x10622 | IMYA NE PODTVERZHDENO, adres: kod: mov r12, #0x622 @0x83C3D2 | Map of decreasing control torque for VMAX control" MAP 0x10622 RL_GRID_UBYTE 0 CM_0p390625_0 0 99.6094
 /begin AXIS_DESCR FIX_AXIS NO_INPUT_QUANTITY CM_IDENTITY 3 0 2 FIX_AXIS_PAR_DIST 0 1 3 /end AXIS_DESCR
 /begin AXIS_DESCR FIX_AXIS NO_INPUT_QUANTITY CM_IDENTITY 2 0 1 FIX_AXIS_PAR_DIST 0 1 2 /end AXIS_DESCR
/end CHARACTERISTIC
/begin CHARACTERISTIC SBF02MFSB "podtverzhdena damos addr 0x1062A" CURVE 0x1062A RL_GRID_SBYTE 0 CM_0p217_0_ms2 -27.776 27.559
 /begin AXIS_DESCR FIX_AXIS NO_INPUT_QUANTITY CM_IDENTITY 2 0 1 FIX_AXIS_PAR_DIST 0 1 2 /end AXIS_DESCR
/end CHARACTERISTIC
/begin CHARACTERISTIC FSWALUV "adres podtverzhden damos-veroyatno addr 0x10631 | IMYA NE PODTVERZHDENO, adres: kod: mov r12, #0x630 @0x83C672 | rough road detection threshold = f (vehicle speed)" CURVE 0x10631 RL_GRID_UBYTE 0 CM_0p09803921569_0 0 25
 /begin AXIS_DESCR FIX_AXIS NO_INPUT_QUANTITY CM_IDENTITY 4 0 3 FIX_AXIS_PAR_DIST 0 1 4 /end AXIS_DESCR
/end CHARACTERISTIC
/begin CHARACTERISTIC FUGKUE "adres podtverzhden damos-veroyatno addr 0x10639 | IMYA NE PODTVERZHDENO, adres: kod: movb RL5, [r4+#0x639] @0x83C9AA | Gear box ratio detection" CURVE 0x10639 RL_GRID_UBYTE 0 CM_IDENTITY 0 255
 /begin AXIS_DESCR FIX_AXIS NO_INPUT_QUANTITY CM_IDENTITY 255 0 254 FIX_AXIS_PAR_DIST 0 1 255 /end AXIS_DESCR
/end CHARACTERISTIC
/begin CHARACTERISTIC FKODASH "podtverzhdena damos addr 0x1073B | A/C dependent line for correction factor" CURVE 0x1073B RL_GRID_UBYTE 0 CM_0p03125_0 0 7.96875
 /begin AXIS_DESCR FIX_AXIS NO_INPUT_QUANTITY CM_IDENTITY 8 0 7 FIX_AXIS_PAR_DIST 0 1 8 /end AXIS_DESCR
/end CHARACTERISTIC
/begin CHARACTERISTIC FVDASHM "podtverzhdena damos addr 0x1074C | Gain factor for dashpot" CURVE 0x1074C RL_GRID_UBYTE 0 CM_0p03125_0 0 7.96875
 /begin AXIS_DESCR FIX_AXIS NO_INPUT_QUANTITY CM_IDENTITY 8 0 7 FIX_AXIS_PAR_DIST 0 1 8 /end AXIS_DESCR
/end CHARACTERISTIC
/begin CHARACTERISTIC KFMIDSH0 "podtverzhdena damos-tochno addr 0x1076C | torque for dashpot (geardependent)" MAP 0x1076C RL_GRID_UBYTE 0 CM_0p390625_0 0 99.6094
 /begin AXIS_DESCR FIX_AXIS NO_INPUT_QUANTITY CM_IDENTITY 6 0 5 FIX_AXIS_PAR_DIST 0 1 6 /end AXIS_DESCR
 /begin AXIS_DESCR FIX_AXIS NO_INPUT_QUANTITY CM_IDENTITY 8 0 7 FIX_AXIS_PAR_DIST 0 1 8 /end AXIS_DESCR
/end CHARACTERISTIC
/begin CHARACTERISTIC KFMIDSH1 "podtverzhdena damos-tochno addr 0x107AC | torque for dashpot (geardependent)" MAP 0x107AC RL_GRID_UBYTE 0 CM_0p390625_0 0 99.6094
 /begin AXIS_DESCR FIX_AXIS NO_INPUT_QUANTITY CM_IDENTITY 6 0 5 FIX_AXIS_PAR_DIST 0 1 6 /end AXIS_DESCR
 /begin AXIS_DESCR FIX_AXIS NO_INPUT_QUANTITY CM_IDENTITY 8 0 7 FIX_AXIS_PAR_DIST 0 1 8 /end AXIS_DESCR
/end CHARACTERISTIC
/begin CHARACTERISTIC KFMIDSH2 "podtverzhdena damos-tochno addr 0x107EC | torque for dashpot (geardependent)" MAP 0x107EC RL_GRID_UBYTE 0 CM_0p390625_0 0 99.6094
 /begin AXIS_DESCR FIX_AXIS NO_INPUT_QUANTITY CM_IDENTITY 6 0 5 FIX_AXIS_PAR_DIST 0 1 6 /end AXIS_DESCR
 /begin AXIS_DESCR FIX_AXIS NO_INPUT_QUANTITY CM_IDENTITY 8 0 7 FIX_AXIS_PAR_DIST 0 1 8 /end AXIS_DESCR
/end CHARACTERISTIC
/begin CHARACTERISTIC KFMIDSH3 "podtverzhdena damos-tochno addr 0x1082C | torque for dashpot (geardependent)" MAP 0x1082C RL_GRID_UBYTE 0 CM_0p390625_0 0 99.6094
 /begin AXIS_DESCR FIX_AXIS NO_INPUT_QUANTITY CM_IDENTITY 6 0 5 FIX_AXIS_PAR_DIST 0 1 6 /end AXIS_DESCR
 /begin AXIS_DESCR FIX_AXIS NO_INPUT_QUANTITY CM_IDENTITY 8 0 7 FIX_AXIS_PAR_DIST 0 1 8 /end AXIS_DESCR
/end CHARACTERISTIC
/begin CHARACTERISTIC ZDSH1GS "adres podtverzhden damos-veroyatno addr 0x1085C | IMYA NE PODTVERZHDENO, adres: kod: movb RL5, [r4+#0x85c] @0x83CC08 | time constant for dash pot decay speed (geardependent)" CURVE 0x1085C RL_GRID_UBYTE 0 CM_IDENTITY 0 255
 /begin AXIS_DESCR FIX_AXIS NO_INPUT_QUANTITY CM_IDENTITY 6 0 5 FIX_AXIS_PAR_DIST 0 1 6 /end AXIS_DESCR
/end CHARACTERISTIC
/begin CHARACTERISTIC ZDSHGS "adres podtverzhden damos-veroyatno addr 0x10862 | IMYA NE PODTVERZHDENO, adres: kod: movb RL5, [r4+#0x862] @0x83CBC8 | time constant for dash pot decay speed (geardependent)" CURVE 0x10862 RL_GRID_UBYTE 0 CM_IDENTITY 0 255
 /begin AXIS_DESCR FIX_AXIS NO_INPUT_QUANTITY CM_IDENTITY 6 0 5 FIX_AXIS_PAR_DIST 0 1 6 /end AXIS_DESCR
/end CHARACTERISTIC
/begin CHARACTERISTIC DZWETA "adres podtverzhden damos-veroyatno addr 0x1086C | IMYA NE PODTVERZHDENO, adres: kod: movb RL5, [r4+#0x86c] @0x83DA96 | delta ignition angle from efficiency" CURVE 0x1086C RL_GRID_SBYTE 0 CM_0p75_0_gradKW -96 95.25
 /begin AXIS_DESCR FIX_AXIS NO_INPUT_QUANTITY CM_IDENTITY 201 0 200 FIX_AXIS_PAR_DIST 0 1 201 /end AXIS_DESCR
/end CHARACTERISTIC
/begin CHARACTERISTIC KFZWMS "podtverzhdena profil addr 0x10935 | Predelno pozdniy ugol zazhiganiya. V stoke vsya karta ravna -33 (-24.75 grad). Pravitsya tyuningom." MAP 0x10935 RL_GRID_SBYTE 0 CM_0p75_0_gradKW -96 95.25
 /begin AXIS_DESCR COM_AXIS NO_INPUT_QUANTITY CM_0p75_0 12 0 191.25 AXIS_PTS_REF SRL12_ZU /end AXIS_DESCR
 /begin AXIS_DESCR COM_AXIS NO_INPUT_QUANTITY CM_40_0_rpm 16 0 10200 AXIS_PTS_REF SNM16_ZU /end AXIS_DESCR
/end CHARACTERISTIC
/begin CHARACTERISTIC KFZW "podtverzhdena profil addr 0x109F5 | Osnovnaya karta ugla operezheniya zazhiganiya. Stolbcy = nagruzka (12 tochek, os SRL12ZUUB), stroki = oboroty (16 tochek, SNM16ZUUB). Stok -0.75..42.75 grad." MAP 0x109F5 RL_GRID_SBYTE 0 CM_0p75_0_gradKW -96 95.25
 /begin AXIS_DESCR COM_AXIS NO_INPUT_QUANTITY CM_0p75_0 12 0 191.25 AXIS_PTS_REF SRL12_ZU /end AXIS_DESCR
 /begin AXIS_DESCR COM_AXIS NO_INPUT_QUANTITY CM_40_0_rpm 16 0 10200 AXIS_PTS_REF SNM16_ZU /end AXIS_DESCR
/end CHARACTERISTIC
/begin CHARACTERISTIC KFZW2 "podtverzhdena profil addr 0x10AB5 | Karta zazhiganiya, variant 2. Stok 2.25..33.75 grad." MAP 0x10AB5 RL_GRID_SBYTE 0 CM_0p75_0_gradKW -96 95.25
 /begin AXIS_DESCR COM_AXIS NO_INPUT_QUANTITY CM_0p75_0 12 0 191.25 AXIS_PTS_REF SRL12_ZU /end AXIS_DESCR
 /begin AXIS_DESCR COM_AXIS NO_INPUT_QUANTITY CM_40_0_rpm 16 0 10200 AXIS_PTS_REF SNM16_ZU /end AXIS_DESCR
/end CHARACTERISTIC
/begin CHARACTERISTIC FSZTM "podtverzhdena damos addr 0x10B76 | Factor dwell angle correction tmot depending" CURVE 0x10B76 RL_GRID_UBYTE 0 CM_0p0078125_0 0 1.99219
 /begin AXIS_DESCR FIX_AXIS NO_INPUT_QUANTITY CM_IDENTITY 8 0 7 FIX_AXIS_PAR_DIST 0 1 8 /end AXIS_DESCR
/end CHARACTERISTIC
/begin CHARACTERISTIC KFSZT "podtverzhdena damos addr 0x10B98 | Dwell angle characteristic map" MAP 0x10B98 RL_GRID_UBYTE 0 CM_0p1_0_ms 0 25.5
 /begin AXIS_DESCR FIX_AXIS NO_INPUT_QUANTITY CM_IDENTITY 8 0 7 FIX_AXIS_PAR_DIST 0 1 8 /end AXIS_DESCR
 /begin AXIS_DESCR FIX_AXIS NO_INPUT_QUANTITY CM_IDENTITY 8 0 7 FIX_AXIS_PAR_DIST 0 1 8 /end AXIS_DESCR
/end CHARACTERISTIC
/begin CHARACTERISTIC SNS06LLSB "adres podtverzhden damos-veroyatno addr 0x10F02 | IMYA NE PODTVERZHDENO, adres: kod: mov r12, #0xf01 @0x83F1DE | Datapoint distribution, set-speed deviation, 06 datapoints., idle-speed control." CURVE 0x10F02 RL_GRID_SBYTE 0 CM_10_0_Umin -1280 1270
 /begin AXIS_DESCR FIX_AXIS NO_INPUT_QUANTITY CM_IDENTITY 6 0 5 FIX_AXIS_PAR_DIST 0 1 6 /end AXIS_DESCR
/end CHARACTERISTIC
/begin CHARACTERISTIC ZNSMST "adres podtverzhden damos-veroyatno addr 0x10F14 | IMYA NE PODTVERZHDENO, adres: kod: mov r12, #0xf14 @0x83ED6C | time constant for decay of reference speed at start" CURVE 0x10F14 RL_GRID_UBYTE 0 CM_IDENTITY 0 255
 /begin AXIS_DESCR FIX_AXIS NO_INPUT_QUANTITY CM_IDENTITY 6 0 5 FIX_AXIS_PAR_DIST 0 1 6 /end AXIS_DESCR
/end CHARACTERISTIC
/begin CHARACTERISTIC DMLLRIMXN "adres podtverzhden damos-veroyatno addr 0x10F1B | IMYA NE PODTVERZHDENO, adres: kod: mov r12, #0xf1b @0x83F85E | Safety concept: upper limit for dmllri" CURVE 0x10F1B RL_GRID_UBYTE 0 CM_0p390625_0 0 99.6094
 /begin AXIS_DESCR FIX_AXIS NO_INPUT_QUANTITY CM_IDENTITY 6 0 5 FIX_AXIS_PAR_DIST 0 1 6 /end AXIS_DESCR
/end CHARACTERISTIC
/begin CHARACTERISTIC DMLLRLMNN "adres podtverzhden damos-veroyatno addr 0x10F21 | IMYA NE PODTVERZHDENO, adres: kod: mov r12, #0xf21 @0x83F9C8 | Lower limit for dmllrl" CURVE 0x10F21 RL_GRID_SBYTE 0 CM_0p3906_0 -49.9968 49.6062
 /begin AXIS_DESCR FIX_AXIS NO_INPUT_QUANTITY CM_IDENTITY 6 0 5 FIX_AXIS_PAR_DIST 0 1 6 /end AXIS_DESCR
/end CHARACTERISTIC
/begin CHARACTERISTIC DMLLRLMXN "adres podtverzhden damos-veroyatno addr 0x10F27 | IMYA NE PODTVERZHDENO, adres: kod: mov r12, #0xf27 @0x83F9AA | Safety concept: upper limit for dmllrl" CURVE 0x10F27 RL_GRID_UBYTE 0 CM_0p390625_0 0 99.6094
 /begin AXIS_DESCR FIX_AXIS NO_INPUT_QUANTITY CM_IDENTITY 6 0 5 FIX_AXIS_PAR_DIST 0 1 6 /end AXIS_DESCR
/end CHARACTERISTIC
/begin CHARACTERISTIC DMLLRMNN "adres podtverzhden damos-veroyatno addr 0x10F2D | IMYA NE PODTVERZHDENO, adres: kod: mov r12, #0xf2d @0x83F368 | Lower limit for dmllr_w" CURVE 0x10F2D RL_GRID_SBYTE 0 CM_0p3906_0 -49.9968 49.6062
 /begin AXIS_DESCR FIX_AXIS NO_INPUT_QUANTITY CM_IDENTITY 6 0 5 FIX_AXIS_PAR_DIST 0 1 6 /end AXIS_DESCR
/end CHARACTERISTIC
/begin CHARACTERISTIC DMLLRMXN "adres podtverzhden damos-veroyatno addr 0x10F33 | IMYA NE PODTVERZHDENO, adres: kod: mov r12, #0xf33 @0x83F356 | Safety concept: upper limit for dmllr" CURVE 0x10F33 RL_GRID_UBYTE 0 CM_0p390625_0 0 99.6094
 /begin AXIS_DESCR FIX_AXIS NO_INPUT_QUANTITY CM_IDENTITY 6 0 5 FIX_AXIS_PAR_DIST 0 1 6 /end AXIS_DESCR
/end CHARACTERISTIC
/begin CHARACTERISTIC DVNG "adres podtverzhden damos-veroyatno addr 0x10F3B | IMYA NE PODTVERZHDENO, adres: kod: mov r12, #0xf3b @0x83F398 | LLR: D-gain depending of ngfil for vehicle at rest" CURVE 0x10F3B RL_GRID_SBYTE 0 CM_n0p00048828125_0_sUmin -0.0620117 0.0625
 /begin AXIS_DESCR FIX_AXIS NO_INPUT_QUANTITY CM_IDENTITY 6 0 5 FIX_AXIS_PAR_DIST 0 1 6 /end AXIS_DESCR
/end CHARACTERISTIC
/begin CHARACTERISTIC DVNGV "adres podtverzhden damos-veroyatno addr 0x10F41 | IMYA NE PODTVERZHDENO, adres: kod: mov r12, #0xf41 @0x83F386 | LLR: D-gain depending of ngfil for vehicle rolling" CURVE 0x10F41 RL_GRID_SBYTE 0 CM_n0p00048828125_0_sUmin -0.0620117 0.0625
 /begin AXIS_DESCR FIX_AXIS NO_INPUT_QUANTITY CM_IDENTITY 6 0 5 FIX_AXIS_PAR_DIST 0 1 6 /end AXIS_DESCR
/end CHARACTERISTIC
/begin CHARACTERISTIC FDDN "adres podtverzhden damos-veroyatno addr 0x10F47 | IMYA NE PODTVERZHDENO, adres: kod: mov r12, #0xf47 @0x83F3A8 | LLR: weightning factor for D-amplification" CURVE 0x10F47 RL_GRID_UBYTE 0 CM_0p00390625_0 0 0.996094
 /begin AXIS_DESCR FIX_AXIS NO_INPUT_QUANTITY CM_IDENTITY 6 0 5 FIX_AXIS_PAR_DIST 0 1 6 /end AXIS_DESCR
/end CHARACTERISTIC
/begin CHARACTERISTIC GFDLDN "adres podtverzhden damos-veroyatno addr 0x10F4E | IMYA NE PODTVERZHDENO, adres: kod: mov r12, #0xf4e @0x83F8B4 | LLR: weightning factor for D-amplification on the air path" CURVE 0x10F4E RL_GRID_UBYTE 0 CM_0p00390625_0 0 0.996094
 /begin AXIS_DESCR FIX_AXIS NO_INPUT_QUANTITY CM_IDENTITY 6 0 5 FIX_AXIS_PAR_DIST 0 1 6 /end AXIS_DESCR
/end CHARACTERISTIC
/begin CHARACTERISTIC IVDN "adres podtverzhden damos-veroyatno addr 0x10F54 | IMYA NE PODTVERZHDENO, adres: kod: mov r12, #0xf54 @0x83F6DA | LLR: I-gain for vehicle at rest" CURVE 0x10F54 RL_GRID_UBYTE 0 CM_0p0023828125_0_sUmin 0 0.607617
 /begin AXIS_DESCR FIX_AXIS NO_INPUT_QUANTITY CM_IDENTITY 6 0 5 FIX_AXIS_PAR_DIST 0 1 6 /end AXIS_DESCR
/end CHARACTERISTIC
/begin CHARACTERISTIC IVDNDTE "adres podtverzhden damos-veroyatno addr 0x10F5A | IMYA NE PODTVERZHDENO, adres: kod: mov r12, #0xf5a @0x83F6AC | LLR: I-gain at DTEV" CURVE 0x10F5A RL_GRID_UBYTE 0 CM_0p0023828125_0_sUmin 0 0.607617
 /begin AXIS_DESCR FIX_AXIS NO_INPUT_QUANTITY CM_IDENTITY 6 0 5 FIX_AXIS_PAR_DIST 0 1 6 /end AXIS_DESCR
/end CHARACTERISTIC
/begin CHARACTERISTIC PVDN "adres podtverzhden damos-veroyatno addr 0x10F71 | IMYA NE PODTVERZHDENO, adres: kod: mov r12, #0xf71 @0x83F296 | LLR: P-gain for vehicle at rest" CURVE 0x10F71 RL_GRID_UBYTE 0 CM_0p001525878906_0 0 0.389099
 /begin AXIS_DESCR FIX_AXIS NO_INPUT_QUANTITY CM_IDENTITY 6 0 5 FIX_AXIS_PAR_DIST 0 1 6 /end AXIS_DESCR
/end CHARACTERISTIC
/begin CHARACTERISTIC PVLDN "adres podtverzhden damos-veroyatno addr 0x10F83 | IMYA NE PODTVERZHDENO, adres: kod: mov r12, #0xf83 @0x83F938 | LLR: P-gain for vehicle at rest (air path)" CURVE 0x10F83 RL_GRID_UBYTE 0 CM_0p001525878906_0 0 0.389099
 /begin AXIS_DESCR FIX_AXIS NO_INPUT_QUANTITY CM_IDENTITY 6 0 5 FIX_AXIS_PAR_DIST 0 1 6 /end AXIS_DESCR
/end CHARACTERISTIC
/begin CHARACTERISTIC PVLDNV "adres podtverzhden damos-veroyatno addr 0x10F89 | IMYA NE PODTVERZHDENO, adres: kod: mov r12, #0xf89 @0x83F90E | LLR: P-gain for vehicle at rest (air path)" CURVE 0x10F89 RL_GRID_UBYTE 0 CM_0p001525878906_0 0 0.389099
 /begin AXIS_DESCR FIX_AXIS NO_INPUT_QUANTITY CM_IDENTITY 6 0 5 FIX_AXIS_PAR_DIST 0 1 6 /end AXIS_DESCR
/end CHARACTERISTIC
/begin CHARACTERISTIC SDN06LLSB "adres podtverzhden damos-veroyatno addr 0x10F90 | IMYA NE PODTVERZHDENO, adres: kod: mov r12, #0xf8f @0x83F266 | 10 Sst." CURVE 0x10F90 RL_GRID_SBYTE 0 CM_10_0_Umin -1280 1270
 /begin AXIS_DESCR FIX_AXIS NO_INPUT_QUANTITY CM_IDENTITY 6 0 5 FIX_AXIS_PAR_DIST 0 1 6 /end AXIS_DESCR
/end CHARACTERISTIC
/begin CHARACTERISTIC SNS206LLSB "adres podtverzhden damos-veroyatno addr 0x10F96 | IMYA NE PODTVERZHDENO, adres: kod: mov r12, #0xf96 @0x83F5BC" CURVE 0x10F96 RL_GRID_UBYTE 0 CM_IDENTITY 0 255
 /begin AXIS_DESCR FIX_AXIS NO_INPUT_QUANTITY CM_IDENTITY 6 0 5 FIX_AXIS_PAR_DIST 0 1 6 /end AXIS_DESCR
/end CHARACTERISTIC
/begin CHARACTERISTIC KLMDLOAD2 "podtverzhdena damos addr 0x10FA3 | charact. line for torque for electrical load 2" CURVE 0x10FA3 RL_GRID_UBYTE 0 CM_0p390625_0 0 99.6094
 /begin AXIS_DESCR FIX_AXIS NO_INPUT_QUANTITY CM_IDENTITY 8 0 7 FIX_AXIS_PAR_DIST 0 1 8 /end AXIS_DESCR
/end CHARACTERISTIC
/begin CHARACTERISTIC FABMDWA "podtverzhdena damos addr 0x10FBB | Factor to decrease the converter torque depending of nturb" CURVE 0x10FBB RL_GRID_UBYTE 0 CM_0p00390625_0 0 0.996094
 /begin AXIS_DESCR FIX_AXIS NO_INPUT_QUANTITY CM_IDENTITY 6 0 5 FIX_AXIS_PAR_DIST 0 1 6 /end AXIS_DESCR
/end CHARACTERISTIC
/begin CHARACTERISTIC TVFSAM "adres podtverzhden damos-veroyatno addr 0x10FC9 | IMYA NE PODTVERZHDENO, adres: kod: mov r12, #0xfc9 @0x8407D8 | Delay time after DRIVE-position switch off" CURVE 0x10FC9 RL_GRID_UBYTE 0 CM_0p02_0_s 0 5.1
 /begin AXIS_DESCR FIX_AXIS NO_INPUT_QUANTITY CM_IDENTITY 6 0 5 FIX_AXIS_PAR_DIST 0 1 6 /end AXIS_DESCR
/end CHARACTERISTIC
/begin CHARACTERISTIC TVFSAMR "adres podtverzhden damos-veroyatno addr 0x10FCF | IMYA NE PODTVERZHDENO, adres: kod: mov r12, #0xfcf @0x8407F8 | delay time after DRIVE-position switch off (Reverse)" CURVE 0x10FCF RL_GRID_UBYTE 0 CM_0p02_0_s 0 5.1
 /begin AXIS_DESCR FIX_AXIS NO_INPUT_QUANTITY CM_IDENTITY 6 0 5 FIX_AXIS_PAR_DIST 0 1 6 /end AXIS_DESCR
/end CHARACTERISTIC
/begin CHARACTERISTIC TVFSEM "adres podtverzhden damos-veroyatno addr 0x10FD5 | IMYA NE PODTVERZHDENO, adres: kod: mov r12, #0xfd5 @0x8407E8 | delay time after DRIVE-position switch on" CURVE 0x10FD5 RL_GRID_UBYTE 0 CM_0p02_0_s 0 5.1
 /begin AXIS_DESCR FIX_AXIS NO_INPUT_QUANTITY CM_IDENTITY 6 0 5 FIX_AXIS_PAR_DIST 0 1 6 /end AXIS_DESCR
/end CHARACTERISTIC
/begin CHARACTERISTIC TVFSEMR "adres podtverzhden damos-veroyatno addr 0x10FDB | IMYA NE PODTVERZHDENO, adres: kod: mov r12, #0xfdb @0x840808 | delay time after DRIVE-position switch on (Reverse)" CURVE 0x10FDB RL_GRID_UBYTE 0 CM_0p02_0_s 0 5.1
 /begin AXIS_DESCR FIX_AXIS NO_INPUT_QUANTITY CM_IDENTITY 6 0 5 FIX_AXIS_PAR_DIST 0 1 6 /end AXIS_DESCR
/end CHARACTERISTIC
/begin CHARACTERISTIC UEVERG "adres podtverzhden damos-veroyatno addr 0x10FE2 | IMYA NE PODTVERZHDENO, adres: kod: movb RL5, [r4+#0xfe2] @0x8404FA | Gear ratio depending of the gear" CURVE 0x10FE2 RL_GRID_UBYTE 0 CM_0p0625_0 0 15.9375
 /begin AXIS_DESCR FIX_AXIS NO_INPUT_QUANTITY CM_IDENTITY 14 0 13 FIX_AXIS_PAR_DIST 0 1 14 /end AXIS_DESCR
/end CHARACTERISTIC
/begin CHARACTERISTIC ZKMDWAM "adres podtverzhden damos-veroyatno addr 0x10FF0 | IMYA NE PODTVERZHDENO, adres: kod: mov r12, #0xff0 @0x840770 | Time constant for converter torque change" CURVE 0x10FF0 RL_GRID_UBYTE 0 CM_IDENTITY 0 255
 /begin AXIS_DESCR FIX_AXIS NO_INPUT_QUANTITY CM_IDENTITY 6 0 5 FIX_AXIS_PAR_DIST 0 1 6 /end AXIS_DESCR
/end CHARACTERISTIC
/begin CHARACTERISTIC FZN0 "adres podtverzhden damos-veroyatno addr 0x10FF8 | IMYA NE PODTVERZHDENO, adres: kod: mov r12, #0xff8 @0x8429F6 | Cylinder individual factor at neutral camshaft position EV 1" CURVE 0x10FF8 RL_GRID_UBYTE 0 CM_0p001953125_n0p75 0.75 1.24805
 /begin AXIS_DESCR FIX_AXIS NO_INPUT_QUANTITY CM_IDENTITY 16 0 15 FIX_AXIS_PAR_DIST 0 1 16 /end AXIS_DESCR
/end CHARACTERISTIC
/begin CHARACTERISTIC FZN1 "adres podtverzhden damos-veroyatno addr 0x11008 | IMYA NE PODTVERZHDENO, adres: kod: mov r12, #0x1008 @0x842A18 | Cylinder individual factor at neutral camshaft position EV 1" CURVE 0x11008 RL_GRID_UBYTE 0 CM_0p001953125_n0p75 0.75 1.24805
 /begin AXIS_DESCR FIX_AXIS NO_INPUT_QUANTITY CM_IDENTITY 16 0 15 FIX_AXIS_PAR_DIST 0 1 16 /end AXIS_DESCR
/end CHARACTERISTIC
/begin CHARACTERISTIC FZN2 "adres podtverzhden damos-veroyatno addr 0x11018 | IMYA NE PODTVERZHDENO, adres: kod: mov r12, #0x1018 @0x842A3A | Cylinder individual factor at neutral camshaft position EV 2" CURVE 0x11018 RL_GRID_UBYTE 0 CM_0p001953125_n0p75 0.75 1.24805
 /begin AXIS_DESCR FIX_AXIS NO_INPUT_QUANTITY CM_IDENTITY 16 0 15 FIX_AXIS_PAR_DIST 0 1 16 /end AXIS_DESCR
/end CHARACTERISTIC
/begin CHARACTERISTIC FZN3 "adres podtverzhden damos-veroyatno addr 0x11028 | IMYA NE PODTVERZHDENO, adres: kod: mov r12, #0x1028 @0x842A5C | Cylinder individual factor at neutral camshaft position EV 3" CURVE 0x11028 RL_GRID_UBYTE 0 CM_0p001953125_n0p75 0.75 1.24805
 /begin AXIS_DESCR FIX_AXIS NO_INPUT_QUANTITY CM_IDENTITY 16 0 15 FIX_AXIS_PAR_DIST 0 1 16 /end AXIS_DESCR
/end CHARACTERISTIC
/begin CHARACTERISTIC FZN4 "adres podtverzhden damos-veroyatno addr 0x11038 | IMYA NE PODTVERZHDENO, adres: kod: mov r12, #0x1038 @0x851692 | Cylinder individual factor at neutral camshaft position EV 4" CURVE 0x11038 RL_GRID_UBYTE 0 CM_0p001953125_n0p75 0.75 1.24805
 /begin AXIS_DESCR FIX_AXIS NO_INPUT_QUANTITY CM_IDENTITY 16 0 15 FIX_AXIS_PAR_DIST 0 1 16 /end AXIS_DESCR
/end CHARACTERISTIC
/begin CHARACTERISTIC FZNWN0 "adres podtverzhden damos-veroyatno addr 0x11078 | IMYA NE PODTVERZHDENO, adres: kod: mov r12, #0x1078 @0x8429E8 | Cylinder individual factor at active camshaft position EV 1" CURVE 0x11078 RL_GRID_UBYTE 0 CM_0p001953125_n0p75 0.75 1.24805
 /begin AXIS_DESCR FIX_AXIS NO_INPUT_QUANTITY CM_IDENTITY 16 0 15 FIX_AXIS_PAR_DIST 0 1 16 /end AXIS_DESCR
/end CHARACTERISTIC
/begin CHARACTERISTIC FZNWN1 "adres podtverzhden damos-veroyatno addr 0x11088 | IMYA NE PODTVERZHDENO, adres: kod: mov r12, #0x1088 @0x842A0A | Cylinder individual factor at active camshaft position EV 1" CURVE 0x11088 RL_GRID_UBYTE 0 CM_0p001953125_n0p75 0.75 1.24805
 /begin AXIS_DESCR FIX_AXIS NO_INPUT_QUANTITY CM_IDENTITY 16 0 15 FIX_AXIS_PAR_DIST 0 1 16 /end AXIS_DESCR
/end CHARACTERISTIC
/begin CHARACTERISTIC FZNWN2 "adres podtverzhden damos-veroyatno addr 0x11098 | IMYA NE PODTVERZHDENO, adres: kod: mov r12, #0x1098 @0x842A2C | Cylinder individual factor at active camshaft position EV 2" CURVE 0x11098 RL_GRID_UBYTE 0 CM_0p001953125_n0p75 0.75 1.24805
 /begin AXIS_DESCR FIX_AXIS NO_INPUT_QUANTITY CM_IDENTITY 16 0 15 FIX_AXIS_PAR_DIST 0 1 16 /end AXIS_DESCR
/end CHARACTERISTIC
/begin CHARACTERISTIC FZNWN3 "adres podtverzhden damos-veroyatno addr 0x110A8 | IMYA NE PODTVERZHDENO, adres: kod: mov r12, #0x10a8 @0x842A4E | Cylinder individual factor at active camshaft position EV 3" CURVE 0x110A8 RL_GRID_UBYTE 0 CM_0p001953125_n0p75 0.75 1.24805
 /begin AXIS_DESCR FIX_AXIS NO_INPUT_QUANTITY CM_IDENTITY 16 0 15 FIX_AXIS_PAR_DIST 0 1 16 /end AXIS_DESCR
/end CHARACTERISTIC
/begin CHARACTERISTIC MAP_115_112C2_14 "adres podtverzhden mapscan addr 0x112C2 | IMYA NE PODTVERZHDENO, adres: kod: mov r12, #0x12c1 @0x842B94" CURVE 0x112C2 RL_2D_A8_UBYTE 0 CM_IDENTITY 0 255 /begin AXIS_DESCR STD_AXIS NO_INPUT_QUANTITY CM_IDENTITY 14 0 255 /end AXIS_DESCR /end CHARACTERISTIC
/begin CHARACTERISTIC MAP_120_11567_8 "adres podtverzhden mapscan addr 0x11567 | IMYA NE PODTVERZHDENO, adres: kod: mov r12, #0x1567 @0x842BFE" CURVE 0x11567 RL_2D_A8_UBYTE 0 CM_IDENTITY 0 255 /begin AXIS_DESCR STD_AXIS NO_INPUT_QUANTITY CM_IDENTITY 8 0 255 /end AXIS_DESCR /end CHARACTERISTIC
/begin CHARACTERISTIC MAP_123_11595_8 "adres podtverzhden mapscan addr 0x11595 | IMYA NE PODTVERZHDENO, adres: kod: mov r12, #0x1595 @0x845110" CURVE 0x11595 RL_2D_A8_UBYTE 0 CM_IDENTITY 0 255 /begin AXIS_DESCR STD_AXIS NO_INPUT_QUANTITY CM_IDENTITY 8 0 255 /end AXIS_DESCR /end CHARACTERISTIC
/begin CHARACTERISTIC MAP_124_115EC_7 "adres podtverzhden mapscan addr 0x115EC | IMYA NE PODTVERZHDENO, adres: kod: mov r12, #0x15ec @0x84AD12" CURVE 0x115EC RL_2D_A8_UBYTE 0 CM_IDENTITY 0 255 /begin AXIS_DESCR STD_AXIS NO_INPUT_QUANTITY CM_IDENTITY 7 0 255 /end AXIS_DESCR /end CHARACTERISTIC
/begin CHARACTERISTIC MAP_127_11616_8 "adres podtverzhden mapscan addr 0x11616 | IMYA NE PODTVERZHDENO, adres: kod: mov r12, #0x1616 @0x84C188" CURVE 0x11616 RL_2D_A8_UBYTE 0 CM_IDENTITY 0 255 /begin AXIS_DESCR STD_AXIS NO_INPUT_QUANTITY CM_IDENTITY 8 0 255 /end AXIS_DESCR /end CHARACTERISTIC
/begin CHARACTERISTIC MAP_128_11673_6 "adres podtverzhden mapscan addr 0x11673 | IMYA NE PODTVERZHDENO, adres: kod: mov r12, #0x1673 @0x850670" CURVE 0x11673 RL_2D_A8_UBYTE 0 CM_IDENTITY 0 255 /begin AXIS_DESCR STD_AXIS NO_INPUT_QUANTITY CM_IDENTITY 6 0 255 /end AXIS_DESCR /end CHARACTERISTIC
/begin CHARACTERISTIC MAP_129_1168B_6 "adres podtverzhden mapscan addr 0x1168B | IMYA NE PODTVERZHDENO, adres: kod: mov r12, #0x168b @0x85199E" CURVE 0x1168B RL_2D_A8_UBYTE 0 CM_IDENTITY 0 255 /begin AXIS_DESCR STD_AXIS NO_INPUT_QUANTITY CM_IDENTITY 6 0 255 /end AXIS_DESCR /end CHARACTERISTIC
/begin CHARACTERISTIC MAP_130_11698_12 "adres podtverzhden mapscan addr 0x11698 | IMYA NE PODTVERZHDENO, adres: kod: mov r12, #0x1698 @0x851A20" CURVE 0x11698 RL_2D_A8_UBYTE 0 CM_IDENTITY 0 255 /begin AXIS_DESCR STD_AXIS NO_INPUT_QUANTITY CM_IDENTITY 12 0 255 /end AXIS_DESCR /end CHARACTERISTIC
/begin CHARACTERISTIC MAP_131_116B2_6x6 "adres podtverzhden mapscan addr 0x116B2 | IMYA NE PODTVERZHDENO, adres: kod: mov r12, #0x16b2 @0x8519AC" MAP 0x116B2 RL_3D_A8_UBYTE 0 CM_IDENTITY 0 255 /begin AXIS_DESCR STD_AXIS NO_INPUT_QUANTITY CM_IDENTITY 6 0 255 /end AXIS_DESCR /begin AXIS_DESCR STD_AXIS NO_INPUT_QUANTITY CM_IDENTITY 6 0 255 /end AXIS_DESCR /end CHARACTERISTIC
/begin CHARACTERISTIC MAP_132_116E5_4 "adres podtverzhden mapscan addr 0x116E5 | IMYA NE PODTVERZHDENO, adres: kod: mov r12, #0x16e4 @0x851A3E" CURVE 0x116E5 RL_2D_A8_UBYTE 0 CM_IDENTITY 0 255 /begin AXIS_DESCR STD_AXIS NO_INPUT_QUANTITY CM_IDENTITY 4 0 255 /end AXIS_DESCR /end CHARACTERISTIC
/begin CHARACTERISTIC KFAGRS "podtverzhdena damos-tochno addr 0x1171F | map EGR set value, camshaft position late" MAP 0x1171F RL_GRID_UBYTE 0 CM_0p01953125_0_V 0 4.98047
 /begin AXIS_DESCR FIX_AXIS NO_INPUT_QUANTITY CM_IDENTITY 12 0 11 FIX_AXIS_PAR_DIST 0 1 12 /end AXIS_DESCR
 /begin AXIS_DESCR FIX_AXIS NO_INPUT_QUANTITY CM_IDENTITY 16 0 15 FIX_AXIS_PAR_DIST 0 1 16 /end AXIS_DESCR
/end CHARACTERISTIC
/begin CHARACTERISTIC MAP_134_11986_5x6 "adres podtverzhden mapscan addr 0x11986 | IMYA NE PODTVERZHDENO, adres: kod: mov r12, #0x1985 @0x855EC2" MAP 0x11986 RL_3D_A8_UBYTE 0 CM_IDENTITY 0 255 /begin AXIS_DESCR STD_AXIS NO_INPUT_QUANTITY CM_IDENTITY 6 0 255 /end AXIS_DESCR /begin AXIS_DESCR STD_AXIS NO_INPUT_QUANTITY CM_IDENTITY 5 0 255 /end AXIS_DESCR /end CHARACTERISTIC
/begin CHARACTERISTIC MAP_137_11A1A_6 "adres podtverzhden mapscan addr 0x11A1A | IMYA NE PODTVERZHDENO, adres: kod: mov r12, #0x1a1a @0x8572A2" CURVE 0x11A1A RL_2D_A8_UBYTE 0 CM_IDENTITY 0 255 /begin AXIS_DESCR STD_AXIS NO_INPUT_QUANTITY CM_IDENTITY 6 0 255 /end AXIS_DESCR /end CHARACTERISTIC
/begin CHARACTERISTIC MAP_139_11A40_10x10 "adres podtverzhden mapscan addr 0x11A40 | IMYA NE PODTVERZHDENO, adres: kod: mov r12, #0x1a40 @0x858D00" MAP 0x11A40 RL_3D_A8_UBYTE 0 CM_IDENTITY 0 255 /begin AXIS_DESCR STD_AXIS NO_INPUT_QUANTITY CM_IDENTITY 10 0 255 /end AXIS_DESCR /begin AXIS_DESCR STD_AXIS NO_INPUT_QUANTITY CM_IDENTITY 10 0 255 /end AXIS_DESCR /end CHARACTERISTIC
/begin CHARACTERISTIC FFTEV6 "adres podtverzhden damos-veroyatno addr 0x11ABB | IMYA NE PODTVERZHDENO, adres: kod: movbz r4, 0x1abb @0x859B1E | freeze frame table: injector power stage 6" CURVE 0x11ABB RL_GRID_UBYTE 0 CM_IDENTITY 0 255
 /begin AXIS_DESCR FIX_AXIS NO_INPUT_QUANTITY CM_IDENTITY 2 0 1 FIX_AXIS_PAR_DIST 0 1 2 /end AXIS_DESCR
/end CHARACTERISTIC
/begin CHARACTERISTIC FFTFRAO "adres podtverzhden damos-veroyatno addr 0x11ABD | IMYA NE PODTVERZHDENO, adres: kod: movbz r13, 0x1abd @0x859DB4 | freeze frame table: FRAO mixture adaptation" CURVE 0x11ABD RL_GRID_UBYTE 0 CM_IDENTITY 0 255
 /begin AXIS_DESCR FIX_AXIS NO_INPUT_QUANTITY CM_IDENTITY 2 0 1 FIX_AXIS_PAR_DIST 0 1 2 /end AXIS_DESCR
/end CHARACTERISTIC
/begin CHARACTERISTIC FFTFRAU "adres podtverzhden damos-veroyatno addr 0x11ABF | IMYA NE PODTVERZHDENO, adres: kod: movbz r13, 0x1abf @0x859D2A | freeze frame table: FRAU mixture adaptation" CURVE 0x11ABF RL_GRID_UBYTE 0 CM_IDENTITY 0 255
 /begin AXIS_DESCR FIX_AXIS NO_INPUT_QUANTITY CM_IDENTITY 2 0 1 FIX_AXIS_PAR_DIST 0 1 2 /end AXIS_DESCR
/end CHARACTERISTIC
/begin CHARACTERISTIC FFTFRST "adres podtverzhden damos-veroyatno addr 0x11AC1 | IMYA NE PODTVERZHDENO, adres: kod: movbz r13, 0x1ac1 @0x859D86 | freeze frame table: deviation of lambda loop control" CURVE 0x11AC1 RL_GRID_UBYTE 0 CM_IDENTITY 0 255
 /begin AXIS_DESCR FIX_AXIS NO_INPUT_QUANTITY CM_IDENTITY 2 0 1 FIX_AXIS_PAR_DIST 0 1 2 /end AXIS_DESCR
/end CHARACTERISTIC
/begin CHARACTERISTIC FFTGE "adres podtverzhden damos-veroyatno addr 0x11AC3 | IMYA NE PODTVERZHDENO, adres: kod: mov r12, #0x1ac2 @0x859F5E | freeze frame table: transmission intervention" CURVE 0x11AC3 RL_GRID_UBYTE 0 CM_IDENTITY 0 255
 /begin AXIS_DESCR FIX_AXIS NO_INPUT_QUANTITY CM_IDENTITY 2 0 1 FIX_AXIS_PAR_DIST 0 1 2 /end AXIS_DESCR
/end CHARACTERISTIC
/begin CHARACTERISTIC FFTHSH "adres podtverzhden damos-veroyatno addr 0x11AC5 | IMYA NE PODTVERZHDENO, adres: kod: cmpb RL3, 0x1ac5 @0x86175C | Table of ambient condition for heating O2-sensor post cat" CURVE 0x11AC5 RL_GRID_UBYTE 0 CM_IDENTITY 0 255
 /begin AXIS_DESCR FIX_AXIS NO_INPUT_QUANTITY CM_IDENTITY 2 0 1 FIX_AXIS_PAR_DIST 0 1 2 /end AXIS_DESCR
/end CHARACTERISTIC
/begin CHARACTERISTIC FFTHSHE "adres podtverzhden damos-veroyatno addr 0x11AC7 | IMYA NE PODTVERZHDENO, adres: kod: movb RL4, 0x1ac7 @0x8615BE | Table of environmental cond.for output stage heating lambda sens. downstr.of cat" CURVE 0x11AC7 RL_GRID_UBYTE 0 CM_IDENTITY 0 255
 /begin AXIS_DESCR FIX_AXIS NO_INPUT_QUANTITY CM_IDENTITY 2 0 1 FIX_AXIS_PAR_DIST 0 1 2 /end AXIS_DESCR
/end CHARACTERISTIC
/begin CHARACTERISTIC FFTHSV "adres podtverzhden damos-veroyatno addr 0x11AC9 | IMYA NE PODTVERZHDENO, adres: kod: cmpb RL4, 0x1ac9 @0x861740 | Table of ambient condition for heating O2-sensor pre cat" CURVE 0x11AC9 RL_GRID_UBYTE 0 CM_IDENTITY 0 255
 /begin AXIS_DESCR FIX_AXIS NO_INPUT_QUANTITY CM_IDENTITY 2 0 1 FIX_AXIS_PAR_DIST 0 1 2 /end AXIS_DESCR
/end CHARACTERISTIC
/begin CHARACTERISTIC FFTHSVE "adres podtverzhden damos-veroyatno addr 0x11ACB | IMYA NE PODTVERZHDENO, adres: kod: mov r12, #0x1acb @0x859F74 | Freeze frame table: 02 Sensor Heater power stage" CURVE 0x11ACB RL_GRID_UBYTE 0 CM_IDENTITY 0 255
 /begin AXIS_DESCR FIX_AXIS NO_INPUT_QUANTITY CM_IDENTITY 2 0 1 FIX_AXIS_PAR_DIST 0 1 2 /end AXIS_DESCR
/end CHARACTERISTIC
/begin CHARACTERISTIC FFTKAT "adres podtverzhden damos-veroyatno addr 0x11ACD | IMYA NE PODTVERZHDENO, adres: kod: cmpb RL1, 0x1acd @0x861778 | Freeze frame table: catalyst" CURVE 0x11ACD RL_GRID_UBYTE 0 CM_IDENTITY 0 255
 /begin AXIS_DESCR FIX_AXIS NO_INPUT_QUANTITY CM_IDENTITY 2 0 1 FIX_AXIS_PAR_DIST 0 1 2 /end AXIS_DESCR
/end CHARACTERISTIC
/begin CHARACTERISTIC FFTKOSE "adres podtverzhden damos-veroyatno addr 0x11ACF | IMYA NE PODTVERZHDENO, adres: kod: movb RL5, 0x1acf @0x8641EC | Freeze frame table: A/C compressor control power stage" CURVE 0x11ACF RL_GRID_UBYTE 0 CM_IDENTITY 0 255
 /begin AXIS_DESCR FIX_AXIS NO_INPUT_QUANTITY CM_IDENTITY 2 0 1 FIX_AXIS_PAR_DIST 0 1 2 /end AXIS_DESCR
/end CHARACTERISTIC
/begin CHARACTERISTIC FFTKPE "adres podtverzhden damos-veroyatno addr 0x11AD1 | IMYA NE PODTVERZHDENO, adres: kod: movb RL4, 0x1ad1 @0x866212 | Freeze frame table: fuel pump relay power stage" CURVE 0x11AD1 RL_GRID_UBYTE 0 CM_IDENTITY 0 255
 /begin AXIS_DESCR FIX_AXIS NO_INPUT_QUANTITY CM_IDENTITY 2 0 1 FIX_AXIS_PAR_DIST 0 1 2 /end AXIS_DESCR
/end CHARACTERISTIC
/begin CHARACTERISTIC MAP_152_11AD4_16x12 "adres podtverzhden mapscan addr 0x11AD4 | IMYA NE PODTVERZHDENO, adres: kod: mov r12, #0x1ad4 @0x859F38" MAP 0x11AD4 RL_3D_A8_UWORD 0 CM_IDENTITY 0 65535 /begin AXIS_DESCR STD_AXIS NO_INPUT_QUANTITY CM_IDENTITY 12 0 255 /end AXIS_DESCR /begin AXIS_DESCR STD_AXIS NO_INPUT_QUANTITY CM_IDENTITY 16 0 255 /end AXIS_DESCR /end CHARACTERISTIC
/begin CHARACTERISTIC KFDLURZ "podtverzhdena damos-tochno addr 0x11E39 | map engine roughness difference dluts referenz value at ZAS (cylinder cut-off)" MAP 0x11E39 RL_GRID_SBYTE 0 CM_IDENTITY -128 127
 /begin AXIS_DESCR FIX_AXIS NO_INPUT_QUANTITY CM_IDENTITY 8 0 7 FIX_AXIS_PAR_DIST 0 1 8 /end AXIS_DESCR
 /begin AXIS_DESCR FIX_AXIS NO_INPUT_QUANTITY CM_IDENTITY 8 0 7 FIX_AXIS_PAR_DIST 0 1 8 /end AXIS_DESCR
/end CHARACTERISTIC
/begin CHARACTERISTIC ANALUN "adres podtverzhden damos-veroyatno addr 0x11E91 | IMYA NE PODTVERZHDENO, adres: kod: mov r4, #0x1e90 @0x869A04 | number of combustions for deactivation after detected misfire" CURVE 0x11E91 RL_GRID_UBYTE 0 CM_IDENTITY 0 255
 /begin AXIS_DESCR FIX_AXIS NO_INPUT_QUANTITY CM_IDENTITY 8 0 7 FIX_AXIS_PAR_DIST 0 1 8 /end AXIS_DESCR
/end CHARACTERISTIC
/begin CHARACTERISTIC KFLURM1 "podtverzhdena damos-tochno addr 0x1211E | reference base value map for engine roughness for misfire detection" MAP 0x1211E RL_GRID_SBYTE 0 CM_IDENTITY -128 127
 /begin AXIS_DESCR FIX_AXIS NO_INPUT_QUANTITY CM_IDENTITY 8 0 7 FIX_AXIS_PAR_DIST 0 1 8 /end AXIS_DESCR
 /begin AXIS_DESCR FIX_AXIS NO_INPUT_QUANTITY CM_IDENTITY 8 0 7 FIX_AXIS_PAR_DIST 0 1 8 /end AXIS_DESCR
/end CHARACTERISTIC
/begin CHARACTERISTIC KFFWK_0_A "podtverzhdena damos-tochno addr 0x1223F | factors - characteristic map for KFWK" MAP 0x1223F RL_GRID_SBYTE 0 CM_0p0078125_0 -1 0.992188
 /begin AXIS_DESCR FIX_AXIS NO_INPUT_QUANTITY CM_IDENTITY 16 0 15 FIX_AXIS_PAR_DIST 0 1 16 /end AXIS_DESCR
 /begin AXIS_DESCR FIX_AXIS NO_INPUT_QUANTITY CM_IDENTITY 24 0 23 FIX_AXIS_PAR_DIST 0 1 24 /end AXIS_DESCR
/end CHARACTERISTIC
/begin CHARACTERISTIC MAP_171_124D4_6 "adres podtverzhden mapscan addr 0x124D4 | IMYA NE PODTVERZHDENO, adres: kod: mov r12, #0x24d3 @0x868944" CURVE 0x124D4 RL_2D_A8_UBYTE 0 CM_IDENTITY 0 255 /begin AXIS_DESCR STD_AXIS NO_INPUT_QUANTITY CM_IDENTITY 6 0 255 /end AXIS_DESCR /end CHARACTERISTIC
/begin CHARACTERISTIC MAP_172_128BD_21 "adres podtverzhden mapscan addr 0x128BD | IMYA NE PODTVERZHDENO, adres: kod: add r4, #0x28e8 @0x84CA72" CURVE 0x128BD RL_2D_A16_UWORD 0 CM_IDENTITY 0 65535 /begin AXIS_DESCR STD_AXIS NO_INPUT_QUANTITY CM_IDENTITY 21 0 65535 /end AXIS_DESCR /end CHARACTERISTIC
/begin CHARACTERISTIC NDFILOG "adres podtverzhden damos-veroyatno addr 0x14934 | IMYA NE PODTVERZHDENO, adres: kod: movb RL5, [r4+#0x4934] @0x836344 | Threshold for filter output ndfil" CURVE 0x14934 RL_GRID_UBYTE 0 CM_0p25_0_Umin 0 63.75
 /begin AXIS_DESCR FIX_AXIS NO_INPUT_QUANTITY CM_IDENTITY 6 0 5 FIX_AXIS_PAR_DIST 0 1 6 /end AXIS_DESCR
/end CHARACTERISTIC
/begin CHARACTERISTIC MAP_183_149D8_10 "adres podtverzhden mapscan addr 0x149D8 | IMYA NE PODTVERZHDENO, adres: kod: mov r14, #0x49e3 @0x83B654" CURVE 0x149D8 RL_2D_A8_UWORD 0 CM_IDENTITY 0 65535 /begin AXIS_DESCR STD_AXIS NO_INPUT_QUANTITY CM_IDENTITY 10 0 255 /end AXIS_DESCR /end CHARACTERISTIC
/begin CHARACTERISTIC SRL03MFUW "adres podtverzhden damos-veroyatno addr 0x14D7A | IMYA NE PODTVERZHDENO, adres: kod: mov r12, #0x4d78 @0x83C3B2" CURVE 0x14D7A RL_GRID_UBYTE 0 CM_0p0234375_0 0 5.97656
 /begin AXIS_DESCR FIX_AXIS NO_INPUT_QUANTITY CM_IDENTITY 3 0 2 FIX_AXIS_PAR_DIST 0 1 3 /end AXIS_DESCR
/end CHARACTERISTIC
/begin CHARACTERISTIC KFZWMN "podtverzhdena profil addr 0x14DA4 | Karta minimalnogo ugla zazhiganiya. Izmenena kalibrovschikom. ADRES -- ZAGOLOVOK: [16][12][os oborotov][os nagruzki], dannye s 0x14DC2. Razvyazka v profile." MAP 0x14DA4 RL_3D_A8_SBYTE 0 CM_0p75_0_gradKW -96 95.25 /begin AXIS_DESCR STD_AXIS NO_INPUT_QUANTITY CM_0p75_0 16 0 191.25 /end AXIS_DESCR /begin AXIS_DESCR STD_AXIS NO_INPUT_QUANTITY CM_40_0_rpm 12 0 10200 /end AXIS_DESCR /end CHARACTERISTIC
/begin CHARACTERISTIC KFZWMNST "podtverzhdena damos-tochno addr 0x14EA0 | minimal ignition spark advance for engine start and after start" MAP 0x14EA0 RL_GRID_SBYTE 0 CM_0p75_0_gradKW -96 95.25
 /begin AXIS_DESCR FIX_AXIS NO_INPUT_QUANTITY CM_IDENTITY 12 0 11 FIX_AXIS_PAR_DIST 0 1 12 /end AXIS_DESCR
 /begin AXIS_DESCR FIX_AXIS NO_INPUT_QUANTITY CM_IDENTITY 16 0 15 FIX_AXIS_PAR_DIST 0 1 16 /end AXIS_DESCR
/end CHARACTERISTIC
/begin CHARACTERISTIC KFZWWLNM "podtverzhdena damos-tochno addr 0x14F96 | Delta ignition sparc advance during engine warm up phase" MAP 0x14F96 RL_GRID_SBYTE 0 CM_0p75_0_gradKW -96 95.25
 /begin AXIS_DESCR FIX_AXIS NO_INPUT_QUANTITY CM_IDENTITY 6 0 5 FIX_AXIS_PAR_DIST 0 1 6 /end AXIS_DESCR
 /begin AXIS_DESCR FIX_AXIS NO_INPUT_QUANTITY CM_IDENTITY 16 0 15 FIX_AXIS_PAR_DIST 0 1 16 /end AXIS_DESCR
/end CHARACTERISTIC
/begin CHARACTERISTIC MAP_211_14FF7_5 "adres podtverzhden mapscan addr 0x14FF7 | IMYA NE PODTVERZHDENO, adres: kod: mov r13, #0x4ff7 @0x83E4B8" CURVE 0x14FF7 RL_2D_A8_UBYTE 0 CM_IDENTITY 0 255 /begin AXIS_DESCR STD_AXIS NO_INPUT_QUANTITY CM_IDENTITY 5 0 255 /end AXIS_DESCR /end CHARACTERISTIC
/begin CHARACTERISTIC KFWK_0_A "podtverzhdena damos-tochno addr 0x1502E | spark-advance-angle characteristic map for knock-protection function" MAP 0x1502E RL_GRID_SBYTE 0 CM_IDENTITY -128 127
 /begin AXIS_DESCR FIX_AXIS NO_INPUT_QUANTITY CM_IDENTITY 6 0 5 FIX_AXIS_PAR_DIST 0 1 6 /end AXIS_DESCR
 /begin AXIS_DESCR FIX_AXIS NO_INPUT_QUANTITY CM_IDENTITY 6 0 5 FIX_AXIS_PAR_DIST 0 1 6 /end AXIS_DESCR
/end CHARACTERISTIC
/begin CHARACTERISTIC MDST "podtverzhdena damos addr 0x1507E | Starting torque" CURVE 0x1507E RL_GRID_SBYTE 0 CM_0p78_0 -99.84 99.06
 /begin AXIS_DESCR FIX_AXIS NO_INPUT_QUANTITY CM_IDENTITY 8 0 7 FIX_AXIS_PAR_DIST 0 1 8 /end AXIS_DESCR
/end CHARACTERISTIC
/begin CHARACTERISTIC FNSTABNV "podtverzhdena damos addr 0x1509D | Factor for engine speed stabilisation by torque" CURVE 0x1509D RL_GRID_UWORD 0 CM_0p0001220703125_0 0 7.99988
 /begin AXIS_DESCR FIX_AXIS NO_INPUT_QUANTITY CM_IDENTITY 6 0 5 FIX_AXIS_PAR_DIST 0 1 6 /end AXIS_DESCR
/end CHARACTERISTIC
/begin CHARACTERISTIC MAP_221_15261_6 "adres podtverzhden mapscan addr 0x15261 | IMYA NE PODTVERZHDENO, adres: kod: mov r15, [r4+#0x5260] @0x842C36" CURVE 0x15261 RL_2D_A16_UWORD 0 CM_IDENTITY 0 65535 /begin AXIS_DESCR STD_AXIS NO_INPUT_QUANTITY CM_IDENTITY 6 0 65535 /end AXIS_DESCR /end CHARACTERISTIC
/begin CHARACTERISTIC KFDYES_0_A "podtverzhdena damos-tochno addr 0x15B82 | Threshold for dynamic presetting values" MAP 0x15B82 RL_GRID_UBYTE 0 CM_0p0234375_0 0 5.97656
 /begin AXIS_DESCR FIX_AXIS NO_INPUT_QUANTITY CM_IDENTITY 4 0 3 FIX_AXIS_PAR_DIST 0 1 4 /end AXIS_DESCR
 /begin AXIS_DESCR FIX_AXIS NO_INPUT_QUANTITY CM_IDENTITY 16 0 15 FIX_AXIS_PAR_DIST 0 1 16 /end AXIS_DESCR
/end CHARACTERISTIC
/begin CHARACTERISTIC WFRL "adres podtverzhden damos-veroyatno addr 0x15DEA | IMYA NE PODTVERZHDENO, adres: kod: mov r12, #0x5dea @0x84B8DA | fuel wall hang.up" CURVE 0x15DEA RL_GRID_UWORD 0 CM_0p09375_0 0 6143.91
 /begin AXIS_DESCR FIX_AXIS NO_INPUT_QUANTITY CM_IDENTITY 26 0 25 FIX_AXIS_PAR_DIST 0 1 26 /end AXIS_DESCR
/end CHARACTERISTIC
/begin CHARACTERISTIC TVUB "podtverzhdena damos addr 0x15E35 | voltage correction" CURVE 0x15E35 RL_GRID_UBYTE 0 CM_0p002666666667_0_ms 0 0.68
 /begin AXIS_DESCR FIX_AXIS NO_INPUT_QUANTITY CM_IDENTITY 5 0 4 FIX_AXIS_PAR_DIST 0 1 5 /end AXIS_DESCR
/end CHARACTERISTIC
/begin CHARACTERISTIC TVCO "podtverzhdena damos addr 0x15E87 | idle-speed potentiometer correction" CURVE 0x15E87 RL_GRID_SWORD 0 CM_0p046875_0 -1536 1535.95
 /begin AXIS_DESCR FIX_AXIS NO_INPUT_QUANTITY CM_IDENTITY 8 0 7 FIX_AXIS_PAR_DIST 0 1 8 /end AXIS_DESCR
/end CHARACTERISTIC
/begin CHARACTERISTIC DMSTES "podtverzhdena damos addr 0x15EAB | characteristic line maximum increase of purge mass flow" CURVE 0x15EAB RL_GRID_UBYTE 0 CM_3p2_0_kgh 0 816
 /begin AXIS_DESCR FIX_AXIS NO_INPUT_QUANTITY CM_IDENTITY 6 0 5 FIX_AXIS_PAR_DIST 0 1 6 /end AXIS_DESCR
/end CHARACTERISTIC
/begin CHARACTERISTIC AGREDRLS "podtverzhdena damos addr 0x15F40 | EGR-reduction depending on drlsol" CURVE 0x15F40 RL_GRID_UWORD 0 CM_1p525878906En05_0 0 0.999985
 /begin AXIS_DESCR FIX_AXIS NO_INPUT_QUANTITY CM_IDENTITY 5 0 4 FIX_AXIS_PAR_DIST 0 1 5 /end AXIS_DESCR
/end CHARACTERISTIC
/begin CHARACTERISTIC KLAFTE "adres podtverzhden damos-veroyatno addr 0x15F4C | IMYA NE PODTVERZHDENO, adres: kod: mov r12, [r5+#0x5f4c] @0x8506BE | characteristic of Saint-Venant of purge control valve an line AKF-TEV" CURVE 0x15F4C RL_GRID_UWORD 0 CM_3p051757812En05_0 0 1.99997
 /begin AXIS_DESCR FIX_AXIS NO_INPUT_QUANTITY CM_IDENTITY 14 0 13 FIX_AXIS_PAR_DIST 0 1 14 /end AXIS_DESCR
/end CHARACTERISTIC
/begin CHARACTERISTIC MSNTATE "podtverzhdena damos addr 0x15F6D | Characteristic standardized mass flow through TEV" CURVE 0x15F6D RL_GRID_UWORD 0 CM_0p000390625_0_kgh 0 25.5996
 /begin AXIS_DESCR FIX_AXIS NO_INPUT_QUANTITY CM_IDENTITY 10 0 9 FIX_AXIS_PAR_DIST 0 1 10 /end AXIS_DESCR
/end CHARACTERISTIC
/begin CHARACTERISTIC MAP_261_15F88_12 "adres podtverzhden mapscan addr 0x15F88 | IMYA NE PODTVERZHDENO, adres: kod: mov r12, #0x5f88 @0x85182E" CURVE 0x15F88 RL_2D_A16_UWORD 0 CM_IDENTITY 0 65535 /begin AXIS_DESCR STD_AXIS NO_INPUT_QUANTITY CM_IDENTITY 12 0 65535 /end AXIS_DESCR /end CHARACTERISTIC
/begin CHARACTERISTIC CDCDK "adres podtverzhden damos-veroyatno addr 0x16001 | IMYA NE PODTVERZHDENO, adres: kod: mov r12, #0x6000 @0x831D08 | code word CARB: throttle position sensor" CURVE 0x16001 RL_GRID_UBYTE 0 CM_IDENTITY 0 255
 /begin AXIS_DESCR FIX_AXIS NO_INPUT_QUANTITY CM_IDENTITY 4 0 3 FIX_AXIS_PAR_DIST 0 1 4 /end AXIS_DESCR
/end CHARACTERISTIC
/begin CHARACTERISTIC CDCLSH "adres podtverzhden damos-veroyatno addr 0x16101 | IMYA NE PODTVERZHDENO, adres: kod: mov r13, [r2+#0x6100] @0x85219C | code word CARB: lambda sensor downstream catalyst" CURVE 0x16101 RL_GRID_UBYTE 0 CM_IDENTITY 0 255
 /begin AXIS_DESCR FIX_AXIS NO_INPUT_QUANTITY CM_IDENTITY 4 0 3 FIX_AXIS_PAR_DIST 0 1 4 /end AXIS_DESCR
/end CHARACTERISTIC
/begin CHARACTERISTIC MAP_309_16156_5 "adres podtverzhden mapscan addr 0x16156 | IMYA NE PODTVERZHDENO, adres: kod: mov r14, #0x615c @0x85502A" CURVE 0x16156 RL_2D_A8_UWORD 0 CM_IDENTITY 0 65535 /begin AXIS_DESCR STD_AXIS NO_INPUT_QUANTITY CM_IDENTITY 5 0 255 /end AXIS_DESCR /end CHARACTERISTIC
/begin CHARACTERISTIC CDCTES "adres podtverzhden damos-veroyatno addr 0x161A1 | IMYA NE PODTVERZHDENO, adres: kod: mov r13, #0x61a1 @0x8564E0 | code word CARB: canister purge system" CURVE 0x161A1 RL_GRID_UBYTE 0 CM_IDENTITY 0 255
 /begin AXIS_DESCR FIX_AXIS NO_INPUT_QUANTITY CM_IDENTITY 4 0 3 FIX_AXIS_PAR_DIST 0 1 4 /end AXIS_DESCR
/end CHARACTERISTIC
/begin CHARACTERISTIC CDCTEVE "adres podtverzhden damos-veroyatno addr 0x161A9 | IMYA NE PODTVERZHDENO, adres: kod: mov r13, #0x61a8 @0x83E582 | code word CARB: canister purge valve power stage" CURVE 0x161A9 RL_GRID_UBYTE 0 CM_IDENTITY 0 255
 /begin AXIS_DESCR FIX_AXIS NO_INPUT_QUANTITY CM_IDENTITY 4 0 3 FIX_AXIS_PAR_DIST 0 1 4 /end AXIS_DESCR
/end CHARACTERISTIC
/begin CHARACTERISTIC NNSTA "podtverzhdena damos addr 0x18195 | engine-speed transition normal -> start" CURVE 0x18195 RL_GRID_UBYTE 0 CM_40_0_Upm 0 10200
 /begin AXIS_DESCR FIX_AXIS NO_INPUT_QUANTITY CM_IDENTITY 3 0 2 FIX_AXIS_PAR_DIST 0 1 3 /end AXIS_DESCR
/end CHARACTERISTIC
/begin CHARACTERISTIC NSTNM "podtverzhdena damos addr 0x1819C | transition start -> normal" CURVE 0x1819C RL_GRID_UBYTE 0 CM_40_0_Upm 0 10200
 /begin AXIS_DESCR FIX_AXIS NO_INPUT_QUANTITY CM_IDENTITY 3 0 2 FIX_AXIS_PAR_DIST 0 1 3 /end AXIS_DESCR
/end CHARACTERISTIC
/begin CHARACTERISTIC SDK10TEUB "podtverzhdena damos addr 0x181A3 | wdkba dependet basic point (number 10)" CURVE 0x181A3 RL_GRID_UBYTE 0 CM_0p3921568627_0_DK 0 100
 /begin AXIS_DESCR FIX_AXIS NO_INPUT_QUANTITY CM_IDENTITY 10 0 9 FIX_AXIS_PAR_DIST 0 1 10 /end AXIS_DESCR
/end CHARACTERISTIC
/begin CHARACTERISTIC SEZ06TMUB "podtverzhdena damos addr 0x181AE | Datapoint distribution of ignition timing efficiency" CURVE 0x181AE RL_GRID_UBYTE 0 CM_0p5_0 0 127.5
 /begin AXIS_DESCR FIX_AXIS NO_INPUT_QUANTITY CM_IDENTITY 6 0 5 FIX_AXIS_PAR_DIST 0 1 6 /end AXIS_DESCR
/end CHARACTERISTIC
/begin CHARACTERISTIC SFR05TEUB "podtverzhdena damos addr 0x181B5 | frmit dependet basic point (number 5)" CURVE 0x181B5 RL_GRID_UBYTE 0 CM_0p0078125_0 0 1.99219
 /begin AXIS_DESCR FIX_AXIS NO_INPUT_QUANTITY CM_IDENTITY 5 0 4 FIX_AXIS_PAR_DIST 0 1 5 /end AXIS_DESCR
/end CHARACTERISTIC
/begin CHARACTERISTIC SGA06MFUB "podtverzhdena damos addr 0x181BB" CURVE 0x181BB RL_GRID_UBYTE 0 CM_IDENTITY 0 255
 /begin AXIS_DESCR FIX_AXIS NO_INPUT_QUANTITY CM_IDENTITY 6 0 5 FIX_AXIS_PAR_DIST 0 1 6 /end AXIS_DESCR
/end CHARACTERISTIC
/begin CHARACTERISTIC SKS06ESUB "podtverzhdena damos addr 0x181C2 | Distribution for the start adaption factor kstaa" CURVE 0x181C2 RL_GRID_UBYTE 0 CM_0p0078125_0 0 1.99219
 /begin AXIS_DESCR FIX_AXIS NO_INPUT_QUANTITY CM_IDENTITY 6 0 5 FIX_AXIS_PAR_DIST 0 1 6 /end AXIS_DESCR
/end CHARACTERISTIC
/begin CHARACTERISTIC SML06TEUB "podtverzhdena damos addr 0x181C9 | ml dependet basic point (number 6)" CURVE 0x181C9 RL_GRID_UBYTE 0 CM_4_0_kgh 0 1020
 /begin AXIS_DESCR FIX_AXIS NO_INPUT_QUANTITY CM_IDENTITY 6 0 5 FIX_AXIS_PAR_DIST 0 1 6 /end AXIS_DESCR
/end CHARACTERISTIC
/begin CHARACTERISTIC SML06TMUB "podtverzhdena damos addr 0x181D0 | ml dependet basic point (number 6)" CURVE 0x181D0 RL_GRID_UBYTE 0 CM_4_0_kgh 0 1020
 /begin AXIS_DESCR FIX_AXIS NO_INPUT_QUANTITY CM_IDENTITY 6 0 5 FIX_AXIS_PAR_DIST 0 1 6 /end AXIS_DESCR
/end CHARACTERISTIC
/begin CHARACTERISTIC SNM06LHUB "podtverzhdena damos addr 0x181D7" CURVE 0x181D7 RL_GRID_UBYTE 0 CM_40_0_Upm 0 10200
 /begin AXIS_DESCR FIX_AXIS NO_INPUT_QUANTITY CM_IDENTITY 6 0 5 FIX_AXIS_PAR_DIST 0 1 6 /end AXIS_DESCR
/end CHARACTERISTIC
/begin CHARACTERISTIC SNM06MFUB "podtverzhdena damos addr 0x181DE" CURVE 0x181DE RL_GRID_UBYTE 0 CM_40_0_Upm 0 10200
 /begin AXIS_DESCR FIX_AXIS NO_INPUT_QUANTITY CM_IDENTITY 6 0 5 FIX_AXIS_PAR_DIST 0 1 6 /end AXIS_DESCR
/end CHARACTERISTIC
/begin CHARACTERISTIC SNM07ESUB "podtverzhdena damos addr 0x181E5 | Base point distribution of engine speed, 7 base pts." CURVE 0x181E5 RL_GRID_UBYTE 0 CM_40_0_Upm 0 10200
 /begin AXIS_DESCR FIX_AXIS NO_INPUT_QUANTITY CM_IDENTITY 7 0 6 FIX_AXIS_PAR_DIST 0 1 7 /end AXIS_DESCR
/end CHARACTERISTIC
/begin CHARACTERISTIC SNM10TEUB "podtverzhdena damos addr 0x181ED | nmot dependet basic point (number 10)" CURVE 0x181ED RL_GRID_UBYTE 0 CM_40_0_Upm 0 10200
 /begin AXIS_DESCR FIX_AXIS NO_INPUT_QUANTITY CM_IDENTITY 10 0 9 FIX_AXIS_PAR_DIST 0 1 10 /end AXIS_DESCR
/end CHARACTERISTIC
/begin CHARACTERISTIC SNM16GKUB_181F8 "podtverzhdena damos addr 0x181F8 | Datapoint distribution mixture control 16 nmot datapoints" CURVE 0x181F8 RL_GRID_UBYTE 0 CM_40_0_Upm 0 10200
 /begin AXIS_DESCR FIX_AXIS NO_INPUT_QUANTITY CM_IDENTITY 16 0 15 FIX_AXIS_PAR_DIST 0 1 16 /end AXIS_DESCR
/end CHARACTERISTIC
/begin CHARACTERISTIC SNM16KRUB "podtverzhdena damos addr 0x18209 | datapoint distribution engine speed, 16 datapoints" CURVE 0x18209 RL_GRID_UBYTE 0 CM_40_0_Upm 0 10200
 /begin AXIS_DESCR FIX_AXIS NO_INPUT_QUANTITY CM_IDENTITY 16 0 15 FIX_AXIS_PAR_DIST 0 1 16 /end AXIS_DESCR
/end CHARACTERISTIC
/begin CHARACTERISTIC SRL04KRUB "podtverzhdena damos addr 0x1821A | datapoint distribution relative charge, 4 datapoints" CURVE 0x1821A RL_GRID_UBYTE 0 CM_0p75_0 0 191.25
 /begin AXIS_DESCR FIX_AXIS NO_INPUT_QUANTITY CM_IDENTITY 4 0 3 FIX_AXIS_PAR_DIST 0 1 4 /end AXIS_DESCR
/end CHARACTERISTIC
/begin CHARACTERISTIC SRL12GKUB_1821F "podtverzhdena damos addr 0x1821F" CURVE 0x1821F RL_GRID_UBYTE 0 CM_0p75_0 0 191.25
 /begin AXIS_DESCR FIX_AXIS NO_INPUT_QUANTITY CM_IDENTITY 12 0 11 FIX_AXIS_PAR_DIST 0 1 12 /end AXIS_DESCR
/end CHARACTERISTIC
/begin CHARACTERISTIC ST107TMUB "podtverzhdena damos addr 0x1822C | tabgmst dependet basic point (number 7)" CURVE 0x1822C RL_GRID_UBYTE 0 CM_5_50_GradC -50 1225
 /begin AXIS_DESCR FIX_AXIS NO_INPUT_QUANTITY CM_IDENTITY 7 0 6 FIX_AXIS_PAR_DIST 0 1 7 /end AXIS_DESCR
/end CHARACTERISTIC
/begin CHARACTERISTIC ST307TMUB "podtverzhdena damos addr 0x18234 | tkatmst dependet basic point (number 7)" CURVE 0x18234 RL_GRID_UBYTE 0 CM_5_50_GradC -50 1225
 /begin AXIS_DESCR FIX_AXIS NO_INPUT_QUANTITY CM_IDENTITY 7 0 6 FIX_AXIS_PAR_DIST 0 1 7 /end AXIS_DESCR
/end CHARACTERISTIC
/begin CHARACTERISTIC STA06ESUB "podtverzhdena damos addr 0x1823C | Distribution for the air temperature in the intake manifold" CURVE 0x1823C RL_GRID_UBYTE 0 CM_0p75_48_GradC -48 143.25
 /begin AXIS_DESCR FIX_AXIS NO_INPUT_QUANTITY CM_IDENTITY 6 0 5 FIX_AXIS_PAR_DIST 0 1 6 /end AXIS_DESCR
/end CHARACTERISTIC
/begin CHARACTERISTIC STM04__UB "podtverzhdena damos addr 0x18243" CURVE 0x18243 RL_GRID_UBYTE 0 CM_0p75_48_GradC -48 143.25
 /begin AXIS_DESCR FIX_AXIS NO_INPUT_QUANTITY CM_IDENTITY 4 0 3 FIX_AXIS_PAR_DIST 0 1 4 /end AXIS_DESCR
/end CHARACTERISTIC
/begin CHARACTERISTIC STM05SAUB "podtverzhdena damos addr 0x18248 | base point distribution" CURVE 0x18248 RL_GRID_UBYTE 0 CM_0p75_48_GradC -48 143.25
 /begin AXIS_DESCR FIX_AXIS NO_INPUT_QUANTITY CM_IDENTITY 5 0 4 FIX_AXIS_PAR_DIST 0 1 5 /end AXIS_DESCR
/end CHARACTERISTIC
/begin CHARACTERISTIC STM05TMUB "podtverzhdena damos addr 0x1824E | tmst dependet basic point (number 5)" CURVE 0x1824E RL_GRID_UBYTE 0 CM_0p75_48_GradC -48 143.25
 /begin AXIS_DESCR FIX_AXIS NO_INPUT_QUANTITY CM_IDENTITY 5 0 4 FIX_AXIS_PAR_DIST 0 1 5 /end AXIS_DESCR
/end CHARACTERISTIC
/begin CHARACTERISTIC STM06LLUB "podtverzhdena damos addr 0x18254 | Datapoint distribution, engine temperature, 6 datapoints" CURVE 0x18254 RL_GRID_UBYTE 0 CM_0p75_48_GradC -48 143.25
 /begin AXIS_DESCR FIX_AXIS NO_INPUT_QUANTITY CM_IDENTITY 6 0 5 FIX_AXIS_PAR_DIST 0 1 6 /end AXIS_DESCR
/end CHARACTERISTIC
/begin CHARACTERISTIC STM06__UB "podtverzhdena damos addr 0x1825B | Datapoint distribution, engine temperature, 6 datapoints" CURVE 0x1825B RL_GRID_UBYTE 0 CM_0p75_48_GradC -48 143.25
 /begin AXIS_DESCR FIX_AXIS NO_INPUT_QUANTITY CM_IDENTITY 6 0 5 FIX_AXIS_PAR_DIST 0 1 6 /end AXIS_DESCR
/end CHARACTERISTIC
/begin CHARACTERISTIC STM08DMUB "podtverzhdena damos addr 0x18262" CURVE 0x18262 RL_GRID_UBYTE 0 CM_0p75_48_GradC -48 143.25
 /begin AXIS_DESCR FIX_AXIS NO_INPUT_QUANTITY CM_IDENTITY 8 0 7 FIX_AXIS_PAR_DIST 0 1 8 /end AXIS_DESCR
/end CHARACTERISTIC
/begin CHARACTERISTIC STM08LEUB "podtverzhdena damos addr 0x1826B" CURVE 0x1826B RL_GRID_UBYTE 0 CM_0p75_48_GradC -48 143.25
 /begin AXIS_DESCR FIX_AXIS NO_INPUT_QUANTITY CM_IDENTITY 8 0 7 FIX_AXIS_PAR_DIST 0 1 8 /end AXIS_DESCR
/end CHARACTERISTIC
/begin CHARACTERISTIC STM09ESUB "podtverzhdena damos addr 0x18274 | Base point distribution of engine temperature, 9 base pts." CURVE 0x18274 RL_GRID_UBYTE 0 CM_0p75_48_GradC -48 143.25
 /begin AXIS_DESCR FIX_AXIS NO_INPUT_QUANTITY CM_IDENTITY 9 0 8 FIX_AXIS_PAR_DIST 0 1 9 /end AXIS_DESCR
/end CHARACTERISTIC
/begin CHARACTERISTIC STS12ESUB "podtverzhdena damos addr 0x1827E | Distribution for engine coolant temperature at start" CURVE 0x1827E RL_GRID_UBYTE 0 CM_0p75_48_GradC -48 143.25
 /begin AXIS_DESCR FIX_AXIS NO_INPUT_QUANTITY CM_IDENTITY 12 0 11 FIX_AXIS_PAR_DIST 0 1 12 /end AXIS_DESCR
/end CHARACTERISTIC
/begin CHARACTERISTIC STW06MDUB "podtverzhdena damos addr 0x1828B" CURVE 0x1828B RL_GRID_UBYTE 0 CM_0p75_48_GradC -48 143.25
 /begin AXIS_DESCR FIX_AXIS NO_INPUT_QUANTITY CM_IDENTITY 6 0 5 FIX_AXIS_PAR_DIST 0 1 6 /end AXIS_DESCR
/end CHARACTERISTIC
/begin CHARACTERISTIC FLRAG "adres podtverzhden damos-veroyatno addr 0x18291 | IMYA NE PODTVERZHDENO, adres: kod: movb RL5, [r4+#0x290] @0x83AD0C | amplification of load controller at AT" CURVE 0x18291 RL_GRID_UBYTE 0 CM_0p0625_0 0 15.9375
 /begin AXIS_DESCR FIX_AXIS NO_INPUT_QUANTITY CM_IDENTITY 6 0 5 FIX_AXIS_PAR_DIST 0 1 6 /end AXIS_DESCR
/end CHARACTERISTIC
/begin CHARACTERISTIC FLRAWG "adres podtverzhden damos-veroyatno addr 0x18297 | IMYA NE PODTVERZHDENO, adres: kod: movb RL5, [r4+#0x296] @0x83ADB4 | amplification of load controller" CURVE 0x18297 RL_GRID_UBYTE 0 CM_0p0625_0 0 15.9375
 /begin AXIS_DESCR FIX_AXIS NO_INPUT_QUANTITY CM_IDENTITY 6 0 5 FIX_AXIS_PAR_DIST 0 1 6 /end AXIS_DESCR
/end CHARACTERISTIC
/begin CHARACTERISTIC FLRHG "adres podtverzhden damos-veroyatno addr 0x1829D | IMYA NE PODTVERZHDENO, adres: kod: movb RL5, [r4+#0x29c] @0x83AC60 | amplification of load controller" CURVE 0x1829D RL_GRID_UBYTE 0 CM_0p0625_0 0 15.9375
 /begin AXIS_DESCR FIX_AXIS NO_INPUT_QUANTITY CM_IDENTITY 6 0 5 FIX_AXIS_PAR_DIST 0 1 6 /end AXIS_DESCR
/end CHARACTERISTIC
/begin CHARACTERISTIC FRARAG "adres podtverzhden damos-veroyatno addr 0x182A3 | IMYA NE PODTVERZHDENO, adres: kod: movb RL5, [r4+#0x2a2] @0x83AD42 | amplification factor at AT" CURVE 0x182A3 RL_GRID_UBYTE 0 CM_0p01220703125_0_Upm 0 3.11279
 /begin AXIS_DESCR FIX_AXIS NO_INPUT_QUANTITY CM_IDENTITY 6 0 5 FIX_AXIS_PAR_DIST 0 1 6 /end AXIS_DESCR
/end CHARACTERISTIC
/begin CHARACTERISTIC FRARAWG "adres podtverzhden damos-veroyatno addr 0x182A9 | IMYA NE PODTVERZHDENO, adres: kod: movb RL5, [r4+#0x2a8] @0x83ADEA | amplification factor" CURVE 0x182A9 RL_GRID_UBYTE 0 CM_0p01220703125_0_Upm 0 3.11279
 /begin AXIS_DESCR FIX_AXIS NO_INPUT_QUANTITY CM_IDENTITY 6 0 5 FIX_AXIS_PAR_DIST 0 1 6 /end AXIS_DESCR
/end CHARACTERISTIC
/begin CHARACTERISTIC FRARHG "adres podtverzhden damos-veroyatno addr 0x182AF | IMYA NE PODTVERZHDENO, adres: kod: mov ADCON, #0x2af @0x832662 | amplification factor" CURVE 0x182AF RL_GRID_UBYTE 0 CM_0p01220703125_0_Upm 0 3.11279
 /begin AXIS_DESCR FIX_AXIS NO_INPUT_QUANTITY CM_IDENTITY 6 0 5 FIX_AXIS_PAR_DIST 0 1 6 /end AXIS_DESCR
/end CHARACTERISTIC
/begin CHARACTERISTIC RLVMXN_182B7 "podtverzhdena damos addr 0x182B7 | maximum volumetric flow with open throttle valve" CURVE 0x182B7 RL_GRID_UBYTE 0 CM_0p75_0 0 191.25
 /begin AXIS_DESCR FIX_AXIS NO_INPUT_QUANTITY CM_IDENTITY 11 0 10 FIX_AXIS_PAR_DIST 0 1 11 /end AXIS_DESCR
/end CHARACTERISTIC
/begin CHARACTERISTIC RLVSMXN_182CE "podtverzhdena damos addr 0x182CE | maximum volumetric flow with open throttle valve and SU" CURVE 0x182CE RL_GRID_UBYTE 0 CM_0p75_0 0 191.25
 /begin AXIS_DESCR FIX_AXIS NO_INPUT_QUANTITY CM_IDENTITY 11 0 10 FIX_AXIS_PAR_DIST 0 1 11 /end AXIS_DESCR
/end CHARACTERISTIC
/begin CHARACTERISTIC DFAUWKN "adres podtverzhden damos-veroyatno addr 0x182E6 | IMYA NE PODTVERZHDENO, adres: kod: mov r12, #0x2e6 @0x83BBE8 | Damping ratio for filtering torque on a low clutch torque and op. lockup clutch" CURVE 0x182E6 RL_GRID_UBYTE 0 CM_0p00390625_0 0 0.996094
 /begin AXIS_DESCR FIX_AXIS NO_INPUT_QUANTITY CM_IDENTITY 6 0 5 FIX_AXIS_PAR_DIST 0 1 6 /end AXIS_DESCR
/end CHARACTERISTIC
/begin CHARACTERISTIC DFAWKN "adres podtverzhden damos-veroyatno addr 0x182EC | IMYA NE PODTVERZHDENO, adres: kod: mov r12, #0x2ec @0x83BC1E | Damping ratio for filtering torque on an openned lockup clutch" CURVE 0x182EC RL_GRID_UBYTE 0 CM_0p00390625_0 0 0.996094
 /begin AXIS_DESCR FIX_AXIS NO_INPUT_QUANTITY CM_IDENTITY 6 0 5 FIX_AXIS_PAR_DIST 0 1 6 /end AXIS_DESCR
/end CHARACTERISTIC
/begin CHARACTERISTIC KFDMDFA "podtverzhdena damos-tochno addr 0x182F5 | Map Damping ratio for filtering motors torque" MAP 0x182F5 RL_GRID_UBYTE 0 CM_0p00390625_0 0 0.996094
 /begin AXIS_DESCR FIX_AXIS NO_INPUT_QUANTITY CM_IDENTITY 6 0 5 FIX_AXIS_PAR_DIST 0 1 6 /end AXIS_DESCR
 /begin AXIS_DESCR FIX_AXIS NO_INPUT_QUANTITY CM_IDENTITY 6 0 5 FIX_AXIS_PAR_DIST 0 1 6 /end AXIS_DESCR
/end CHARACTERISTIC
/begin CHARACTERISTIC KFDMDFAS "podtverzhdena damos-tochno addr 0x18319 | Map Damping ratio for filtering motor torque on fuel feed restart" MAP 0x18319 RL_GRID_UBYTE 0 CM_0p00390625_0 0 0.996094
 /begin AXIS_DESCR FIX_AXIS NO_INPUT_QUANTITY CM_IDENTITY 6 0 5 FIX_AXIS_PAR_DIST 0 1 6 /end AXIS_DESCR
 /begin AXIS_DESCR FIX_AXIS NO_INPUT_QUANTITY CM_IDENTITY 6 0 5 FIX_AXIS_PAR_DIST 0 1 6 /end AXIS_DESCR
/end CHARACTERISTIC
/begin CHARACTERISTIC KFDMDFAU "podtverzhdena damos-tochno addr 0x1833D | Map damping ratio for filtering motor torque on low clutch torque" MAP 0x1833D RL_GRID_UBYTE 0 CM_0p00390625_0 0 0.996094
 /begin AXIS_DESCR FIX_AXIS NO_INPUT_QUANTITY CM_IDENTITY 6 0 5 FIX_AXIS_PAR_DIST 0 1 6 /end AXIS_DESCR
 /begin AXIS_DESCR FIX_AXIS NO_INPUT_QUANTITY CM_IDENTITY 6 0 5 FIX_AXIS_PAR_DIST 0 1 6 /end AXIS_DESCR
/end CHARACTERISTIC
/begin CHARACTERISTIC KFZMDFA "podtverzhdena damos-tochno addr 0x18361 | Map time constant values for filtering motor torque" MAP 0x18361 RL_GRID_UBYTE 0 CM_IDENTITY 0 255
 /begin AXIS_DESCR FIX_AXIS NO_INPUT_QUANTITY CM_IDENTITY 6 0 5 FIX_AXIS_PAR_DIST 0 1 6 /end AXIS_DESCR
 /begin AXIS_DESCR FIX_AXIS NO_INPUT_QUANTITY CM_IDENTITY 6 0 5 FIX_AXIS_PAR_DIST 0 1 6 /end AXIS_DESCR
/end CHARACTERISTIC
/begin CHARACTERISTIC KFZMDFAS "podtverzhdena damos-tochno addr 0x18385 | Map time constant values for filtering motor torque on fuel feed restart" MAP 0x18385 RL_GRID_UBYTE 0 CM_IDENTITY 0 255
 /begin AXIS_DESCR FIX_AXIS NO_INPUT_QUANTITY CM_IDENTITY 6 0 5 FIX_AXIS_PAR_DIST 0 1 6 /end AXIS_DESCR
 /begin AXIS_DESCR FIX_AXIS NO_INPUT_QUANTITY CM_IDENTITY 6 0 5 FIX_AXIS_PAR_DIST 0 1 6 /end AXIS_DESCR
/end CHARACTERISTIC
/begin CHARACTERISTIC KFZMDFAU "podtverzhdena damos-tochno addr 0x183A9 | Map time constant values for filtering motor torque on low clutch torque" MAP 0x183A9 RL_GRID_UBYTE 0 CM_IDENTITY 0 255
 /begin AXIS_DESCR FIX_AXIS NO_INPUT_QUANTITY CM_IDENTITY 6 0 5 FIX_AXIS_PAR_DIST 0 1 6 /end AXIS_DESCR
 /begin AXIS_DESCR FIX_AXIS NO_INPUT_QUANTITY CM_IDENTITY 6 0 5 FIX_AXIS_PAR_DIST 0 1 6 /end AXIS_DESCR
/end CHARACTERISTIC
/begin CHARACTERISTIC ZFAUWKN "adres podtverzhden damos-veroyatno addr 0x183D0 | IMYA NE PODTVERZHDENO, adres: kod: mov r12, #0x3d0 @0x83BC5E | lower time constant value for filt. torque on openned lockup clutch" CURVE 0x183D0 RL_GRID_UBYTE 0 CM_IDENTITY 0 255
 /begin AXIS_DESCR FIX_AXIS NO_INPUT_QUANTITY CM_IDENTITY 6 0 5 FIX_AXIS_PAR_DIST 0 1 6 /end AXIS_DESCR
/end CHARACTERISTIC
/begin CHARACTERISTIC ZFAWKN "adres podtverzhden damos-veroyatno addr 0x183D6 | IMYA NE PODTVERZHDENO, adres: kod: mov r12, #0x3d6 @0x83BC94 | time constant for filtering motor torque on openned lockup clutch" CURVE 0x183D6 RL_GRID_UBYTE 0 CM_IDENTITY 0 255
 /begin AXIS_DESCR FIX_AXIS NO_INPUT_QUANTITY CM_IDENTITY 6 0 5 FIX_AXIS_PAR_DIST 0 1 6 /end AXIS_DESCR
/end CHARACTERISTIC
/begin CHARACTERISTIC REDZEM "podtverzhdena damos addr 0x183DF | threshold between ignition intervention and injector disabling" CURVE 0x183DF RL_GRID_UBYTE 0 CM_IDENTITY 0 255
 /begin AXIS_DESCR FIX_AXIS NO_INPUT_QUANTITY CM_IDENTITY 5 0 4 FIX_AXIS_PAR_DIST 0 1 5 /end AXIS_DESCR
/end CHARACTERISTIC
/begin CHARACTERISTIC WPHN "adres podtverzhden damos-veroyatno addr 0x183EB | IMYA NE PODTVERZHDENO, adres: kod: mov r12, #0x3eb @0x83DA00 | phase correction" CURVE 0x183EB RL_GRID_SBYTE 0 CM_0p75_0_gradKW -96 95.25
 /begin AXIS_DESCR FIX_AXIS NO_INPUT_QUANTITY CM_IDENTITY 8 0 7 FIX_AXIS_PAR_DIST 0 1 8 /end AXIS_DESCR
/end CHARACTERISTIC
/begin CHARACTERISTIC DZWSPM "adres podtverzhden damos-veroyatno addr 0x183F3 | IMYA NE PODTVERZHDENO, adres: kod: mov r12, #0x3f3 @0x83E370 | delta latest ignition angle relative to engine temperature" CURVE 0x183F3 RL_GRID_SBYTE 0 CM_0p75_0_gradKW -96 95.25
 /begin AXIS_DESCR FIX_AXIS NO_INPUT_QUANTITY CM_IDENTITY 6 0 5 FIX_AXIS_PAR_DIST 0 1 6 /end AXIS_DESCR
/end CHARACTERISTIC
/begin CHARACTERISTIC KFTVSA "adres podtverzhden damos-somnitelno addr 0x18449 | IMYA NE PODTVERZHDENO, adres: kod: mov r12, #0x449 @0x83E6D0 | Retard time for overrun fuel cut-off" MAP 0x18449 RL_GRID_UBYTE 0 CM_0p01_0_s 0 2.55
 /begin AXIS_DESCR FIX_AXIS NO_INPUT_QUANTITY CM_IDENTITY 8 0 7 FIX_AXIS_PAR_DIST 0 1 8 /end AXIS_DESCR
 /begin AXIS_DESCR FIX_AXIS NO_INPUT_QUANTITY CM_IDENTITY 5 0 4 FIX_AXIS_PAR_DIST 0 1 5 /end AXIS_DESCR
/end CHARACTERISTIC
/begin CHARACTERISTIC NWECVTM "adres podtverzhden damos-veroyatno addr 0x18471 | IMYA NE PODTVERZHDENO, adres: kod: mov r12, #0x471 @0x83E6AE | Fuel restart-speed at CVT" CURVE 0x18471 RL_GRID_UBYTE 0 CM_40_0_Upm 0 10200
 /begin AXIS_DESCR FIX_AXIS NO_INPUT_QUANTITY CM_IDENTITY 5 0 4 FIX_AXIS_PAR_DIST 0 1 5 /end AXIS_DESCR
/end CHARACTERISTIC
/begin CHARACTERISTIC TVSATM "adres podtverzhden damos-veroyatno addr 0x18476 | IMYA NE PODTVERZHDENO, adres: kod: mov r12, #0x476 @0x83E69A | delay time after cranking for fuel cut off" CURVE 0x18476 RL_GRID_UBYTE 0 CM_IDENTITY 0 255
 /begin AXIS_DESCR FIX_AXIS NO_INPUT_QUANTITY CM_IDENTITY 5 0 4 FIX_AXIS_PAR_DIST 0 1 5 /end AXIS_DESCR
/end CHARACTERISTIC
/begin CHARACTERISTIC DNEVTMOD "podtverzhdena damos addr 0x1847D | char.line delta desired engine speed dependent on evtmod" CURVE 0x1847D RL_GRID_UBYTE 0 CM_10_0_Umin 0 2550
 /begin AXIS_DESCR FIX_AXIS NO_INPUT_QUANTITY CM_IDENTITY 8 0 7 FIX_AXIS_PAR_DIST 0 1 8 /end AXIS_DESCR
/end CHARACTERISTIC
/begin CHARACTERISTIC DNLBZ "podtverzhdena damos addr 0x1848E | Idle speed increase for battery charging balance" CURVE 0x1848E RL_GRID_UBYTE 0 CM_10_0_Umin 0 2550
 /begin AXIS_DESCR FIX_AXIS NO_INPUT_QUANTITY CM_IDENTITY 6 0 5 FIX_AXIS_PAR_DIST 0 1 6 /end AXIS_DESCR
/end CHARACTERISTIC
/begin CHARACTERISTIC FNSSTM "podtverzhdena damos addr 0x1849B | Faktor for taget engine speed during start" CURVE 0x1849B RL_GRID_UBYTE 0 CM_0p0078125_0 0 1.99219
 /begin AXIS_DESCR FIX_AXIS NO_INPUT_QUANTITY CM_IDENTITY 6 0 5 FIX_AXIS_PAR_DIST 0 1 6 /end AXIS_DESCR
/end CHARACTERISTIC
/begin CHARACTERISTIC NFSM "adres podtverzhden damos-veroyatno addr 0x184AA | IMYA NE PODTVERZHDENO, adres: kod: mov r12, #0x4aa @0x83ED0C | desired engine speed DRIVE-position switch on" CURVE 0x184AA RL_GRID_UBYTE 0 CM_10_0_Umin 0 2550
 /begin AXIS_DESCR FIX_AXIS NO_INPUT_QUANTITY CM_IDENTITY 6 0 5 FIX_AXIS_PAR_DIST 0 1 6 /end AXIS_DESCR
/end CHARACTERISTIC
/begin CHARACTERISTIC NLLM "adres podtverzhden damos-veroyatno addr 0x184B0 | IMYA NE PODTVERZHDENO, adres: kod: mov r12, #0x4b0 @0x83ECF8 | desired engine speed" CURVE 0x184B0 RL_GRID_UBYTE 0 CM_10_0_Umin 0 2550
 /begin AXIS_DESCR FIX_AXIS NO_INPUT_QUANTITY CM_IDENTITY 6 0 5 FIX_AXIS_PAR_DIST 0 1 6 /end AXIS_DESCR
/end CHARACTERISTIC
/begin CHARACTERISTIC NSLPP "podtverzhdena damos addr 0x184B7 | Target speed depending on the pump pressure of power steerung" CURVE 0x184B7 RL_GRID_UBYTE 0 CM_10_0_Umin 0 2550
 /begin AXIS_DESCR FIX_AXIS NO_INPUT_QUANTITY CM_IDENTITY 4 0 3 FIX_AXIS_PAR_DIST 0 1 4 /end AXIS_DESCR
/end CHARACTERISTIC
/begin CHARACTERISTIC NSLPPFS "podtverzhdena damos addr 0x184C0 | Target speed depending on the pump pressure of power steering with B_fs=1" CURVE 0x184C0 RL_GRID_UBYTE 0 CM_10_0_Umin 0 2550
 /begin AXIS_DESCR FIX_AXIS NO_INPUT_QUANTITY CM_IDENTITY 4 0 3 FIX_AXIS_PAR_DIST 0 1 4 /end AXIS_DESCR
/end CHARACTERISTIC
/begin CHARACTERISTIC NTANS "podtverzhdena damos addr 0x184C9 | idle speed rpm tans-dependent" CURVE 0x184C9 RL_GRID_UBYTE 0 CM_10_0_Umin 0 2550
 /begin AXIS_DESCR FIX_AXIS NO_INPUT_QUANTITY CM_IDENTITY 8 0 7 FIX_AXIS_PAR_DIST 0 1 8 /end AXIS_DESCR
/end CHARACTERISTIC
/begin CHARACTERISTIC LIMXDNS "adres podtverzhden damos-veroyatno addr 0x184D9 | IMYA NE PODTVERZHDENO, adres: kod: mov r12, #0x4d9 @0x83F5F4 | upper integrator limit for standing car" CURVE 0x184D9 RL_GRID_UBYTE 0 CM_0p09764705882_0 0 24.9
 /begin AXIS_DESCR FIX_AXIS NO_INPUT_QUANTITY CM_IDENTITY 6 0 5 FIX_AXIS_PAR_DIST 0 1 6 /end AXIS_DESCR
/end CHARACTERISTIC
/begin CHARACTERISTIC LIMXVDNS "adres podtverzhden damos-veroyatno addr 0x184DF | IMYA NE PODTVERZHDENO, adres: kod: mov r12, #0x4df @0x83F5DC | upper integrator limit for rolling car" CURVE 0x184DF RL_GRID_UBYTE 0 CM_0p09764705882_0 0 24.9
 /begin AXIS_DESCR FIX_AXIS NO_INPUT_QUANTITY CM_IDENTITY 6 0 5 FIX_AXIS_PAR_DIST 0 1 6 /end AXIS_DESCR
/end CHARACTERISTIC
/begin CHARACTERISTIC LISTM "adres podtverzhden damos-veroyatno addr 0x184E5 | IMYA NE PODTVERZHDENO, adres: kod: mov r12, #0x4e5 @0x83F482 | value of idle speed control integrator during start" CURVE 0x184E5 RL_GRID_UBYTE 0 CM_0p09764705882_0 0 24.9
 /begin AXIS_DESCR FIX_AXIS NO_INPUT_QUANTITY CM_IDENTITY 6 0 5 FIX_AXIS_PAR_DIST 0 1 6 /end AXIS_DESCR
/end CHARACTERISTIC
/begin CHARACTERISTIC DMDKOE "podtverzhdena damos addr 0x184FC | Start value of torque filter when AC is swiched on" CURVE 0x184FC RL_GRID_UBYTE 0 CM_0p1960784314_0 0 50
 /begin AXIS_DESCR FIX_AXIS NO_INPUT_QUANTITY CM_IDENTITY 6 0 5 FIX_AXIS_PAR_DIST 0 1 6 /end AXIS_DESCR
/end CHARACTERISTIC
/begin CHARACTERISTIC KFMDKO "podtverzhdena damos-tochno addr 0x18516 | map for torque needed for air condition" MAP 0x18516 RL_GRID_UBYTE 0 CM_0p1960784314_0 0 50
 /begin AXIS_DESCR FIX_AXIS NO_INPUT_QUANTITY CM_IDENTITY 6 0 5 FIX_AXIS_PAR_DIST 0 1 6 /end AXIS_DESCR
 /begin AXIS_DESCR FIX_AXIS NO_INPUT_QUANTITY CM_IDENTITY 6 0 5 FIX_AXIS_PAR_DIST 0 1 6 /end AXIS_DESCR
/end CHARACTERISTIC
/begin CHARACTERISTIC EVTMODO "podtverzhdena damos addr 0x185CD | offset for evtmod depending on filtered engine temperature" CURVE 0x185CD RL_GRID_SBYTE 0 CM_0p75_48_GradC -144 47.25
 /begin AXIS_DESCR FIX_AXIS NO_INPUT_QUANTITY CM_IDENTITY 12 0 11 FIX_AXIS_PAR_DIST 0 1 12 /end AXIS_DESCR
/end CHARACTERISTIC
/begin CHARACTERISTIC FDVANS "podtverzhdena damos addr 0x185E6 | Temperature factor for air at throttle valve" CURVE 0x185E6 RL_GRID_UBYTE 0 CM_0p0078125_0 0 1.99219
 /begin AXIS_DESCR FIX_AXIS NO_INPUT_QUANTITY CM_IDENTITY 8 0 7 FIX_AXIS_PAR_DIST 0 1 8 /end AXIS_DESCR
/end CHARACTERISTIC
/begin CHARACTERISTIC FWFTBRTA "podtverzhdena damos addr 0x185F7 | Weighting for ftbr as a function of tans" CURVE 0x185F7 RL_GRID_UBYTE 0 CM_0p0078125_0 0 1.99219
 /begin AXIS_DESCR FIX_AXIS NO_INPUT_QUANTITY CM_IDENTITY 14 0 13 FIX_AXIS_PAR_DIST 0 1 14 /end AXIS_DESCR
/end CHARACTERISTIC
/begin CHARACTERISTIC MAP_399_18613_10x8 "adres podtverzhden mapscan addr 0x18613 | IMYA NE PODTVERZHDENO, adres: kod: mov r12, #0x613 @0x843E08" MAP 0x18613 RL_3D_A8_UBYTE 0 CM_IDENTITY 0 255 /begin AXIS_DESCR STD_AXIS NO_INPUT_QUANTITY CM_IDENTITY 8 0 255 /end AXIS_DESCR /begin AXIS_DESCR STD_AXIS NO_INPUT_QUANTITY CM_IDENTITY 10 0 255 /end AXIS_DESCR /end CHARACTERISTIC
/begin CHARACTERISTIC FZPUSA "podtverzhdena damos addr 0x1867D | correction faktor time constant ambient pressure adaptation during fuel cut-off" CURVE 0x1867D RL_GRID_UBYTE 0 CM_0p0078125_0 0 1.99219
 /begin AXIS_DESCR FIX_AXIS NO_INPUT_QUANTITY CM_IDENTITY 8 0 7 FIX_AXIS_PAR_DIST 0 1 8 /end AXIS_DESCR
/end CHARACTERISTIC
/begin CHARACTERISTIC WDKHKDN "podtverzhdena damos addr 0x18695 | High threshold throttle plate for altitude adaptation" CURVE 0x18695 RL_GRID_UBYTE 0 CM_0p390625_0 0 99.6094
 /begin AXIS_DESCR FIX_AXIS NO_INPUT_QUANTITY CM_IDENTITY 6 0 5 FIX_AXIS_PAR_DIST 0 1 6 /end AXIS_DESCR
/end CHARACTERISTIC
/begin CHARACTERISTIC WDKHKN "adres podtverzhden damos-veroyatno addr 0x186A2 | IMYA NE PODTVERZHDENO, adres: kod: mov r12, #0x6a1 @0x84468A | Low threshold throttle plate for altitude adaptation" CURVE 0x186A2 RL_GRID_UBYTE 0 CM_0p390625_0 0 99.6094
 /begin AXIS_DESCR FIX_AXIS NO_INPUT_QUANTITY CM_IDENTITY 6 0 5 FIX_AXIS_PAR_DIST 0 1 6 /end AXIS_DESCR
/end CHARACTERISTIC
/begin CHARACTERISTIC WPUAVLN "podtverzhdena damos addr 0x186AF | Throttle valve angle as of which VL ambient pressure adaptation is active" CURVE 0x186AF RL_GRID_UBYTE 0 CM_0p3921568627_0_DK 0 100
 /begin AXIS_DESCR FIX_AXIS NO_INPUT_QUANTITY CM_IDENTITY 12 0 11 FIX_AXIS_PAR_DIST 0 1 12 /end AXIS_DESCR
/end CHARACTERISTIC
/begin CHARACTERISTIC WPUAVLSN "podtverzhdena damos addr 0x186C8 | Throttle valve angle as of which VL ambient pressure adaptation is blocked" CURVE 0x186C8 RL_GRID_UBYTE 0 CM_0p3921568627_0_DK 0 100
 /begin AXIS_DESCR FIX_AXIS NO_INPUT_QUANTITY CM_IDENTITY 12 0 11 FIX_AXIS_PAR_DIST 0 1 12 /end AXIS_DESCR
/end CHARACTERISTIC
/begin CHARACTERISTIC KFFTAGRV "podtverzhdena damos addr 0x186F6 | Factor for temperature decrease between EGR line and EGR valve" MAP 0x186F6 RL_GRID_UBYTE 0 CM_0p0078125_0 0 1.99219
 /begin AXIS_DESCR FIX_AXIS NO_INPUT_QUANTITY CM_IDENTITY 6 0 5 FIX_AXIS_PAR_DIST 0 1 6 /end AXIS_DESCR
 /begin AXIS_DESCR FIX_AXIS NO_INPUT_QUANTITY CM_IDENTITY 8 0 7 FIX_AXIS_PAR_DIST 0 1 8 /end AXIS_DESCR
/end CHARACTERISTIC
/begin CHARACTERISTIC KFFTDAG "podtverzhdena damos addr 0x18736 | Factor for temperatur decrease between EGR line and EGR induction" MAP 0x18736 RL_GRID_UBYTE 0 CM_0p0078125_0 0 1.99219
 /begin AXIS_DESCR FIX_AXIS NO_INPUT_QUANTITY CM_IDENTITY 6 0 5 FIX_AXIS_PAR_DIST 0 1 6 /end AXIS_DESCR
 /begin AXIS_DESCR FIX_AXIS NO_INPUT_QUANTITY CM_IDENTITY 8 0 7 FIX_AXIS_PAR_DIST 0 1 8 /end AXIS_DESCR
/end CHARACTERISTIC
/begin CHARACTERISTIC MAP_407_18768_6 "adres podtverzhden mapscan addr 0x18768 | IMYA NE PODTVERZHDENO, adres: kod: mov r12, #0x767 @0x8454B0" CURVE 0x18768 RL_2D_A8_UBYTE 0 CM_IDENTITY 0 255 /begin AXIS_DESCR STD_AXIS NO_INPUT_QUANTITY CM_IDENTITY 6 0 255 /end AXIS_DESCR /end CHARACTERISTIC
/begin CHARACTERISTIC KFSU "podtverzhdena damos addr 0x18775 | Load/speed performance characteristics for suction tube switchover" MAP 0x18775 RL_GRID_UBYTE 0 CM_IDENTITY 0 255
 /begin AXIS_DESCR FIX_AXIS NO_INPUT_QUANTITY CM_IDENTITY 6 0 5 FIX_AXIS_PAR_DIST 0 1 6 /end AXIS_DESCR
 /begin AXIS_DESCR FIX_AXIS NO_INPUT_QUANTITY CM_IDENTITY 6 0 5 FIX_AXIS_PAR_DIST 0 1 6 /end AXIS_DESCR
/end CHARACTERISTIC
/begin CHARACTERISTIC MAP_409_1879A_6 "adres podtverzhden mapscan addr 0x1879A | IMYA NE PODTVERZHDENO, adres: kod: mov r12, #0x799 @0x8454C4" CURVE 0x1879A RL_2D_A8_UBYTE 0 CM_IDENTITY 0 255 /begin AXIS_DESCR STD_AXIS NO_INPUT_QUANTITY CM_IDENTITY 6 0 255 /end AXIS_DESCR /end CHARACTERISTIC
/begin CHARACTERISTIC KFSU2 "podtverzhdena damos addr 0x187A7 | map for intake manifold switch over, flap 2" MAP 0x187A7 RL_GRID_UBYTE 0 CM_IDENTITY 0 255
 /begin AXIS_DESCR FIX_AXIS NO_INPUT_QUANTITY CM_IDENTITY 6 0 5 FIX_AXIS_PAR_DIST 0 1 6 /end AXIS_DESCR
 /begin AXIS_DESCR FIX_AXIS NO_INPUT_QUANTITY CM_IDENTITY 6 0 5 FIX_AXIS_PAR_DIST 0 1 6 /end AXIS_DESCR
/end CHARACTERISTIC
/begin CHARACTERISTIC TVSUM "podtverzhdena damos addr 0x187D5 | delay time for intake manifold switch over in dependence of engine temperatur" CURVE 0x187D5 RL_GRID_UBYTE 0 CM_0p1_0_s 0 25.5
 /begin AXIS_DESCR FIX_AXIS NO_INPUT_QUANTITY CM_IDENTITY 6 0 5 FIX_AXIS_PAR_DIST 0 1 6 /end AXIS_DESCR
/end CHARACTERISTIC
/begin CHARACTERISTIC ATMABKA "adres podtverzhden damos-veroyatno addr 0x187E2 | IMYA NE PODTVERZHDENO, adres: kod: mov r12, #0x7e2 @0x845E20 | factor reduction of exhaust gas temperature = f(soak time)" CURVE 0x187E2 RL_GRID_UBYTE 0 CM_0p00390625_0 0 0.996094
 /begin AXIS_DESCR FIX_AXIS NO_INPUT_QUANTITY CM_IDENTITY 6 0 5 FIX_AXIS_PAR_DIST 0 1 6 /end AXIS_DESCR
/end CHARACTERISTIC
/begin CHARACTERISTIC ATMABKK "adres podtverzhden damos-veroyatno addr 0x187E8 | IMYA NE PODTVERZHDENO, adres: kod: mov r12, #0x7e8 @0x845E8C | factor reduction for catalyst temperature = f(soak time)" CURVE 0x187E8 RL_GRID_UBYTE 0 CM_0p00390625_0 0 0.996094
 /begin AXIS_DESCR FIX_AXIS NO_INPUT_QUANTITY CM_IDENTITY 6 0 5 FIX_AXIS_PAR_DIST 0 1 6 /end AXIS_DESCR
/end CHARACTERISTIC
/begin CHARACTERISTIC FATMRML "adres podtverzhden damos-veroyatno addr 0x187EF | IMYA NE PODTVERZHDENO, adres: kod: mov r12, #0x7ef @0x845B92 | divide factor exhaust-/exhaust-pipe temperature" CURVE 0x187EF RL_GRID_UBYTE 0 CM_0p00390625_0 0 0.996094
 /begin AXIS_DESCR FIX_AXIS NO_INPUT_QUANTITY CM_IDENTITY 7 0 6 FIX_AXIS_PAR_DIST 0 1 7 /end AXIS_DESCR
/end CHARACTERISTIC
/begin CHARACTERISTIC KATMEXML "adres podtverzhden damos-veroyatno addr 0x187F9 | IMYA NE PODTVERZHDENO, adres: kod: mov r12, #0x7f9 @0x845CAA | Temperature of the exotherme in the catalyst tkatm" CURVE 0x187F9 RL_GRID_SBYTE 0 CM_5_0_GradC -640 635
 /begin AXIS_DESCR FIX_AXIS NO_INPUT_QUANTITY CM_IDENTITY 7 0 6 FIX_AXIS_PAR_DIST 0 1 7 /end AXIS_DESCR
/end CHARACTERISTIC
/begin CHARACTERISTIC KFATMLA "podtverzhdena damos-tochno addr 0x18800 | map exhaust gas temperature correction = f(lambda)" MAP 0x18800 RL_GRID_SBYTE 0 CM_5_0_GradC -640 635
 /begin AXIS_DESCR FIX_AXIS NO_INPUT_QUANTITY CM_IDENTITY 6 0 5 FIX_AXIS_PAR_DIST 0 1 6 /end AXIS_DESCR
 /begin AXIS_DESCR FIX_AXIS NO_INPUT_QUANTITY CM_IDENTITY 6 0 5 FIX_AXIS_PAR_DIST 0 1 6 /end AXIS_DESCR
/end CHARACTERISTIC
/begin CHARACTERISTIC KFATMZW "podtverzhdena damos-tochno addr 0x18824 | map exhaust gas temperature correktion = f(ignition-variation)" MAP 0x18824 RL_GRID_SBYTE 0 CM_5_0_GradC -640 635
 /begin AXIS_DESCR FIX_AXIS NO_INPUT_QUANTITY CM_IDENTITY 6 0 5 FIX_AXIS_PAR_DIST 0 1 6 /end AXIS_DESCR
 /begin AXIS_DESCR FIX_AXIS NO_INPUT_QUANTITY CM_IDENTITY 6 0 5 FIX_AXIS_PAR_DIST 0 1 6 /end AXIS_DESCR
/end CHARACTERISTIC
/begin CHARACTERISTIC KFTATM "podtverzhdena damos-tochno addr 0x1885A | map exhaust gas temperature f(nmot,rl)" MAP 0x1885A RL_GRID_SBYTE 0 CM_5_50_GradC -690 585
 /begin AXIS_DESCR FIX_AXIS NO_INPUT_QUANTITY CM_IDENTITY 8 0 7 FIX_AXIS_PAR_DIST 0 1 8 /end AXIS_DESCR
 /begin AXIS_DESCR FIX_AXIS NO_INPUT_QUANTITY CM_IDENTITY 8 0 7 FIX_AXIS_PAR_DIST 0 1 8 /end AXIS_DESCR
/end CHARACTERISTIC
/begin CHARACTERISTIC KLATMLAE "adres podtverzhden damos-veroyatno addr 0x1889A | IMYA NE PODTVERZHDENO, adres: kod: add DPP0, #0x89a @0x860AA6 | Temperature of the exotherme decrease during enrichment" CURVE 0x1889A RL_GRID_UBYTE 0 CM_0p00390625_0 0 0.996094
 /begin AXIS_DESCR FIX_AXIS NO_INPUT_QUANTITY CM_IDENTITY 6 0 5 FIX_AXIS_PAR_DIST 0 1 6 /end AXIS_DESCR
/end CHARACTERISTIC
/begin CHARACTERISTIC KLATMZWE "adres podtverzhden damos-veroyatno addr 0x188A0 | IMYA NE PODTVERZHDENO, adres: kod: mov r12, #0x8a0 @0x845C7A | Temperature of the exotherme decrease in cat during ignition retard tkatm" CURVE 0x188A0 RL_GRID_UBYTE 0 CM_0p00390625_0 0 0.996094
 /begin AXIS_DESCR FIX_AXIS NO_INPUT_QUANTITY CM_IDENTITY 6 0 5 FIX_AXIS_PAR_DIST 0 1 6 /end AXIS_DESCR
/end CHARACTERISTIC
/begin CHARACTERISTIC FRINH1 "podtverzhdena damos addr 0x188C0 | Multiplication factor for RIN nominal value downstream of the catalyzer" CURVE 0x188C0 RL_GRID_UBYTE 0 CM_0p25_0 0 63.75
 /begin AXIS_DESCR FIX_AXIS NO_INPUT_QUANTITY CM_IDENTITY 5 0 4 FIX_AXIS_PAR_DIST 0 1 5 /end AXIS_DESCR
/end CHARACTERISTIC
/begin CHARACTERISTIC MAP_422_188CA_5 "adres podtverzhden mapscan addr 0x188CA | IMYA NE PODTVERZHDENO, adres: kod: mov r12, #0x8ca @0x847560" CURVE 0x188CA RL_2D_A8_UBYTE 0 CM_IDENTITY 0 255 /begin AXIS_DESCR STD_AXIS NO_INPUT_QUANTITY CM_IDENTITY 5 0 255 /end AXIS_DESCR /end CHARACTERISTIC
/begin CHARACTERISTIC KFTPKOR "podtverzhdena damos-tochno addr 0x18907 | correction map for the measured cycle duration TP (tpsvkof)" MAP 0x18907 RL_GRID_UBYTE 0 CM_0p0078125_0 0 1.99219
 /begin AXIS_DESCR FIX_AXIS NO_INPUT_QUANTITY CM_IDENTITY 7 0 6 FIX_AXIS_PAR_DIST 0 1 7 /end AXIS_DESCR
 /begin AXIS_DESCR FIX_AXIS NO_INPUT_QUANTITY CM_IDENTITY 8 0 7 FIX_AXIS_PAR_DIST 0 1 8 /end AXIS_DESCR
/end CHARACTERISTIC
/begin CHARACTERISTIC FFRITMS "podtverzhdena damos addr 0x1898F | tmst dependent factor to modify I-dynamic of lambda control" CURVE 0x1898F RL_GRID_UBYTE 0 CM_0p00390625_0 0 0.996094
 /begin AXIS_DESCR FIX_AXIS NO_INPUT_QUANTITY CM_IDENTITY 4 0 3 FIX_AXIS_PAR_DIST 0 1 4 /end AXIS_DESCR
/end CHARACTERISTIC
/begin CHARACTERISTIC KFRI "podtverzhdena damos-tochno addr 0x18997 | I characteristic map" MAP 0x18997 RL_GRID_UBYTE 0 CM_0p3058103976_0_s 0 77.9817
 /begin AXIS_DESCR FIX_AXIS NO_INPUT_QUANTITY CM_IDENTITY 6 0 5 FIX_AXIS_PAR_DIST 0 1 6 /end AXIS_DESCR
 /begin AXIS_DESCR FIX_AXIS NO_INPUT_QUANTITY CM_IDENTITY 7 0 6 FIX_AXIS_PAR_DIST 0 1 7 /end AXIS_DESCR
/end CHARACTERISTIC
/begin CHARACTERISTIC KFRP "podtverzhdena damos-tochno addr 0x189EB | P characteristic map" MAP 0x189EB RL_GRID_UBYTE 0 CM_0p048828125_0 0 12.4512
 /begin AXIS_DESCR FIX_AXIS NO_INPUT_QUANTITY CM_IDENTITY 6 0 5 FIX_AXIS_PAR_DIST 0 1 6 /end AXIS_DESCR
 /begin AXIS_DESCR FIX_AXIS NO_INPUT_QUANTITY CM_IDENTITY 7 0 6 FIX_AXIS_PAR_DIST 0 1 7 /end AXIS_DESCR
/end CHARACTERISTIC
/begin CHARACTERISTIC RLLRUN_18AD2 "adres podtverzhden damos-veroyatno addr 0x18AD2 | IMYA NE PODTVERZHDENO, adres: kod: mov r12, #0xad1 @0x84B798 | char.line above nmot,lower rL control limit for controller in front of catalyst" CURVE 0x18AD2 RL_GRID_UBYTE 0 CM_0p75_0 0 191.25
 /begin AXIS_DESCR FIX_AXIS NO_INPUT_QUANTITY CM_IDENTITY 8 0 7 FIX_AXIS_PAR_DIST 0 1 8 /end AXIS_DESCR
/end CHARACTERISTIC
/begin CHARACTERISTIC KFFTV "podtverzhdena damos-tochno addr 0x18AEA | weighting map for TVLRH" MAP 0x18AEA RL_GRID_UBYTE 0 CM_0p0078125_0 0 1.99219
 /begin AXIS_DESCR FIX_AXIS NO_INPUT_QUANTITY CM_IDENTITY 6 0 5 FIX_AXIS_PAR_DIST 0 1 6 /end AXIS_DESCR
 /begin AXIS_DESCR FIX_AXIS NO_INPUT_QUANTITY CM_IDENTITY 6 0 5 FIX_AXIS_PAR_DIST 0 1 6 /end AXIS_DESCR
/end CHARACTERISTIC
/begin CHARACTERISTIC DTVKAML2 "adres podtverzhden damos-veroyatno addr 0x18B57 | IMYA NE PODTVERZHDENO, adres: kod: mov r12, #0xb56 @0x84C13E | delta-tv for cat oxygen neutralization (air mass dependent) bank2" CURVE 0x18B57 RL_GRID_SBYTE 0 CM_0p01_0_s -1.28 1.27
 /begin AXIS_DESCR FIX_AXIS NO_INPUT_QUANTITY CM_IDENTITY 5 0 4 FIX_AXIS_PAR_DIST 0 1 5 /end AXIS_DESCR
/end CHARACTERISTIC
/begin CHARACTERISTIC FNSKHLL "podtverzhdena damos addr 0x18B81 | factor idle speed increase after start" CURVE 0x18B81 RL_GRID_UBYTE 0 CM_0p0078125_0 0 1.99219
 /begin AXIS_DESCR FIX_AXIS NO_INPUT_QUANTITY CM_IDENTITY 5 0 4 FIX_AXIS_PAR_DIST 0 1 5 /end AXIS_DESCR
/end CHARACTERISTIC
/begin CHARACTERISTIC FTMLAKH "adres podtverzhden damos-veroyatno addr 0x18BB0 | IMYA NE PODTVERZHDENO, adres: kod: mov r12, #0xbaf @0x84D4D8 | tmot-correction of lambda-weighting at catalyst heating" CURVE 0x18BB0 RL_GRID_UBYTE 0 CM_0p00390625_0 0 0.996094
 /begin AXIS_DESCR FIX_AXIS NO_INPUT_QUANTITY CM_IDENTITY 4 0 3 FIX_AXIS_PAR_DIST 0 1 4 /end AXIS_DESCR
/end CHARACTERISTIC
/begin CHARACTERISTIC MAP_446_18BBA_4 "adres podtverzhden mapscan addr 0x18BBA | IMYA NE PODTVERZHDENO, adres: kod: mov r12, #0xbb9 @0x84D3F8" CURVE 0x18BBA RL_2D_A16_UBYTE 0 CM_IDENTITY 0 255 /begin AXIS_DESCR STD_AXIS NO_INPUT_QUANTITY CM_IDENTITY 4 0 65535 /end AXIS_DESCR /end CHARACTERISTIC
/begin CHARACTERISTIC KFNLLKHM "podtverzhdena damos addr 0x18BC7 | Nominal idling speed during catalyzer heating" MAP 0x18BC7 RL_GRID_UBYTE 0 CM_10_0_Umin 0 2550
 /begin AXIS_DESCR FIX_AXIS NO_INPUT_QUANTITY CM_IDENTITY 4 0 3 FIX_AXIS_PAR_DIST 0 1 4 /end AXIS_DESCR
 /begin AXIS_DESCR FIX_AXIS NO_INPUT_QUANTITY CM_IDENTITY 8 0 7 FIX_AXIS_PAR_DIST 0 1 8 /end AXIS_DESCR
/end CHARACTERISTIC
/begin CHARACTERISTIC MLSUS "podtverzhdena damos addr 0x18BE9 | reference of air mass flow integral" CURVE 0x18BE9 RL_GRID_UBYTE 0 CM_0p02275555556_0_kg 0 5.80267
 /begin AXIS_DESCR FIX_AXIS NO_INPUT_QUANTITY CM_IDENTITY 12 0 11 FIX_AXIS_PAR_DIST 0 1 12 /end AXIS_DESCR
/end CHARACTERISTIC
/begin CHARACTERISTIC NFSKHM "adres podtverzhden damos-veroyatno addr 0x18C01 | IMYA NE PODTVERZHDENO, adres: kod: mov r12, #0xc01 @0x84D3B2 | LL nominal speed with driving graduations and catalyzer heating" CURVE 0x18C01 RL_GRID_UBYTE 0 CM_10_0_Umin 0 2550
 /begin AXIS_DESCR FIX_AXIS NO_INPUT_QUANTITY CM_IDENTITY 4 0 3 FIX_AXIS_PAR_DIST 0 1 4 /end AXIS_DESCR
/end CHARACTERISTIC
/begin CHARACTERISTIC FMDKHFH "adres podtverzhden damos-veroyatno addr 0x18C10 | IMYA NE PODTVERZHDENO, adres: kod: mov r12, #0xc0f @0x84D762 | altitude correction of torque reserve for catalyst heating" CURVE 0x18C10 RL_GRID_UBYTE 0 CM_0p0078125_0 0 1.99219
 /begin AXIS_DESCR FIX_AXIS NO_INPUT_QUANTITY CM_IDENTITY 4 0 3 FIX_AXIS_PAR_DIST 0 1 4 /end AXIS_DESCR
/end CHARACTERISTIC
/begin CHARACTERISTIC FMDKHTM "adres podtverzhden damos-veroyatno addr 0x18C19 | IMYA NE PODTVERZHDENO, adres: kod: mov r12, #0xc18 @0x84D776 | tmot-correction of torque reserve for catalyst heating" CURVE 0x18C19 RL_GRID_UBYTE 0 CM_0p0078125_0 0 1.99219
 /begin AXIS_DESCR FIX_AXIS NO_INPUT_QUANTITY CM_IDENTITY 8 0 7 FIX_AXIS_PAR_DIST 0 1 8 /end AXIS_DESCR
/end CHARACTERISTIC
/begin CHARACTERISTIC MAP_454_18CCE_4 "adres podtverzhden mapscan addr 0x18CCE | IMYA NE PODTVERZHDENO, adres: kod: mov r12, #0xccd @0x84D6D4" CURVE 0x18CCE RL_2D_A8_UBYTE 0 CM_IDENTITY 0 255 /begin AXIS_DESCR STD_AXIS NO_INPUT_QUANTITY CM_IDENTITY 4 0 255 /end AXIS_DESCR /end CHARACTERISTIC
/begin CHARACTERISTIC KFEKWTMP "podtverzhdena damos-tochno addr 0x18CD7 | characteristic diagram efficiency while keeping catalyst warm" MAP 0x18CD7 RL_GRID_UBYTE 0 CM_0p5_0 0 127.5
 /begin AXIS_DESCR FIX_AXIS NO_INPUT_QUANTITY CM_IDENTITY 4 0 3 FIX_AXIS_PAR_DIST 0 1 4 /end AXIS_DESCR
 /begin AXIS_DESCR FIX_AXIS NO_INPUT_QUANTITY CM_IDENTITY 4 0 3 FIX_AXIS_PAR_DIST 0 1 4 /end AXIS_DESCR
/end CHARACTERISTIC
/begin CHARACTERISTIC MAP_456_18CE9_8 "adres podtverzhden mapscan addr 0x18CE9 | IMYA NE PODTVERZHDENO, adres: kod: mov r12, #0xce8 @0x84D972" CURVE 0x18CE9 RL_2D_A8_UBYTE 0 CM_IDENTITY 0 255 /begin AXIS_DESCR STD_AXIS NO_INPUT_QUANTITY CM_IDENTITY 8 0 255 /end AXIS_DESCR /end CHARACTERISTIC
/begin CHARACTERISTIC KFLMSKH "podtverzhdena damos-tochno addr 0x18CFA | Performance characteristics lambda engine nominal at catalyst heating" MAP 0x18CFA RL_GRID_UBYTE 0 CM_0p0078125_0 0 1.99219
 /begin AXIS_DESCR FIX_AXIS NO_INPUT_QUANTITY CM_IDENTITY 8 0 7 FIX_AXIS_PAR_DIST 0 1 8 /end AXIS_DESCR
 /begin AXIS_DESCR FIX_AXIS NO_INPUT_QUANTITY CM_IDENTITY 8 0 7 FIX_AXIS_PAR_DIST 0 1 8 /end AXIS_DESCR
/end CHARACTERISTIC
/begin CHARACTERISTIC MAP_458_18D3B_8 "adres podtverzhden mapscan addr 0x18D3B | IMYA NE PODTVERZHDENO, adres: kod: mov r12, #0xd3a @0x84D93C" CURVE 0x18D3B RL_2D_A8_UBYTE 0 CM_IDENTITY 0 255 /begin AXIS_DESCR STD_AXIS NO_INPUT_QUANTITY CM_IDENTITY 8 0 255 /end AXIS_DESCR /end CHARACTERISTIC
/begin CHARACTERISTIC SENZZYL "adres podtverzhden damos-veroyatno addr 0x18DB0 | IMYA NE PODTVERZHDENO, adres: kod: mov r12, #0xdaf @0x84DCD0 | knock sensor for sw-cylinder counter 0-7" CURVE 0x18DB0 RL_GRID_UBYTE 0 CM_1_n1 1 256
 /begin AXIS_DESCR FIX_AXIS NO_INPUT_QUANTITY CM_IDENTITY 8 0 7 FIX_AXIS_PAR_DIST 0 1 8 /end AXIS_DESCR
/end CHARACTERISTIC
/begin CHARACTERISTIC DWKRMSN "adres podtverzhden damos-veroyatno addr 0x18E5D | IMYA NE PODTVERZHDENO, adres: kod: mov r12, #0xe5d @0x84E464 | delta ignition angle knock control distance from mean retarding" CURVE 0x18E5D RL_GRID_SBYTE 0 CM_n0p75_0_gradKW -95.25 96
 /begin AXIS_DESCR FIX_AXIS NO_INPUT_QUANTITY CM_IDENTITY 16 0 15 FIX_AXIS_PAR_DIST 0 1 16 /end AXIS_DESCR
/end CHARACTERISTIC
/begin CHARACTERISTIC KRAL1N "adres podtverzhden damos-veroyatno addr 0x18E6D | IMYA NE PODTVERZHDENO, adres: kod: mov r12, #0xe6d @0x84E478 | load range for adaption maps 1" CURVE 0x18E6D RL_GRID_UBYTE 0 CM_0p75_0 0 191.25
 /begin AXIS_DESCR FIX_AXIS NO_INPUT_QUANTITY CM_IDENTITY 16 0 15 FIX_AXIS_PAR_DIST 0 1 16 /end AXIS_DESCR
/end CHARACTERISTIC
/begin CHARACTERISTIC KRAL2N "adres podtverzhden damos-veroyatno addr 0x18E7D | IMYA NE PODTVERZHDENO, adres: kod: mov r12, #0xe7d @0x84E48C | load range dor adaption maps 2" CURVE 0x18E7D RL_GRID_UBYTE 0 CM_0p75_0 0 191.25
 /begin AXIS_DESCR FIX_AXIS NO_INPUT_QUANTITY CM_IDENTITY 16 0 15 FIX_AXIS_PAR_DIST 0 1 16 /end AXIS_DESCR
/end CHARACTERISTIC
/begin CHARACTERISTIC MAP_476_18E8E_4 "adres podtverzhden mapscan addr 0x18E8E | IMYA NE PODTVERZHDENO, adres: kod: mov r12, #0xe8d @0x84E3D8" CURVE 0x18E8E RL_2D_A16_UBYTE 0 CM_IDENTITY 0 255 /begin AXIS_DESCR STD_AXIS NO_INPUT_QUANTITY CM_IDENTITY 4 0 65535 /end AXIS_DESCR /end CHARACTERISTIC
/begin CHARACTERISTIC KRFKN "adres podtverzhden damos-veroyatno addr 0x18F05 | IMYA NE PODTVERZHDENO, adres: kod: mov r12, #0xf05 @0x84EE9E | retard step knock occurrence" CURVE 0x18F05 RL_GRID_SBYTE 0 CM_n0p75_0_gradKW -95.25 96
 /begin AXIS_DESCR FIX_AXIS NO_INPUT_QUANTITY CM_IDENTITY 16 0 15 FIX_AXIS_PAR_DIST 0 1 16 /end AXIS_DESCR
/end CHARACTERISTIC
/begin CHARACTERISTIC KRMXN "adres podtverzhden damos-veroyatno addr 0x18F15 | IMYA NE PODTVERZHDENO, adres: kod: mov r12, #0xf15 @0x84EE62 | maximum retard adjustment" CURVE 0x18F15 RL_GRID_SBYTE 0 CM_n0p75_0_gradKW -95.25 96
 /begin AXIS_DESCR FIX_AXIS NO_INPUT_QUANTITY CM_IDENTITY 16 0 15 FIX_AXIS_PAR_DIST 0 1 16 /end AXIS_DESCR
/end CHARACTERISTIC
/begin CHARACTERISTIC KRNLZAR "adres podtverzhden damos-veroyatno addr 0x18F25 | IMYA NE PODTVERZHDENO, adres: kod: movb RL5, [r4+#0xf25] @0x84EA90 | cylinder individual rpm limit for lead by leading cylinder" CURVE 0x18F25 RL_GRID_UBYTE 0 CM_40_0_Upm 0 10200
 /begin AXIS_DESCR FIX_AXIS NO_INPUT_QUANTITY CM_IDENTITY 8 0 7 FIX_AXIS_PAR_DIST 0 1 8 /end AXIS_DESCR
/end CHARACTERISTIC
/begin CHARACTERISTIC KRVFN "adres podtverzhden damos-veroyatno addr 0x18F2D | IMYA NE PODTVERZHDENO, adres: kod: mov r12, #0xf2d @0x83F368 | number of firings/cyl. or time for ignition advancing" CURVE 0x18F2D RL_GRID_UBYTE 0 CM_IDENTITY 0 255
 /begin AXIS_DESCR FIX_AXIS NO_INPUT_QUANTITY CM_IDENTITY 16 0 15 FIX_AXIS_PAR_DIST 0 1 16 /end AXIS_DESCR
/end CHARACTERISTIC
/begin CHARACTERISTIC MAP_482_18F3D_4 "adres podtverzhden mapscan addr 0x18F3D | IMYA NE PODTVERZHDENO, adres: kod: mov r12, #0xf3d @0x84EE8A" CURVE 0x18F3D RL_2D_A8_UWORD 0 CM_IDENTITY 0 65535 /begin AXIS_DESCR STD_AXIS NO_INPUT_QUANTITY CM_IDENTITY 4 0 255 /end AXIS_DESCR /end CHARACTERISTIC
/begin CHARACTERISTIC LKRN "adres podtverzhden damos-veroyatno addr 0x18F4D | IMYA NE PODTVERZHDENO, adres: kod: mov r12, #0xf4d @0x84EE4E | load-signal threshold knock control" CURVE 0x18F4D RL_GRID_UBYTE 0 CM_0p75_0 0 191.25
 /begin AXIS_DESCR FIX_AXIS NO_INPUT_QUANTITY CM_IDENTITY 16 0 15 FIX_AXIS_PAR_DIST 0 1 16 /end AXIS_DESCR
/end CHARACTERISTIC
/begin CHARACTERISTIC MAP_485_18F71_4 "adres podtverzhden mapscan addr 0x18F71 | IMYA NE PODTVERZHDENO, adres: kod: mov r12, #0xf71 @0x83F296" CURVE 0x18F71 RL_2D_A8_UBYTE 0 CM_IDENTITY 0 255 /begin AXIS_DESCR STD_AXIS NO_INPUT_QUANTITY CM_IDENTITY 4 0 255 /end AXIS_DESCR /end CHARACTERISTIC
/begin CHARACTERISTIC MAP_486_18FA2_4 "adres podtverzhden mapscan addr 0x18FA2 | IMYA NE PODTVERZHDENO, adres: kod: mov r12, #0xfa2 @0x8402EA" CURVE 0x18FA2 RL_2D_A8_UBYTE 0 CM_IDENTITY 0 255 /begin AXIS_DESCR STD_AXIS NO_INPUT_QUANTITY CM_IDENTITY 4 0 255 /end AXIS_DESCR /end CHARACTERISTIC
/begin CHARACTERISTIC WDKSLN_18FCB "adres podtverzhden damos-veroyatno addr 0x18FCB | IMYA NE PODTVERZHDENO, adres: kod: mov r12, #0xfca @0x8506E0 | Throttle valve angle threshold for idle detection" CURVE 0x18FCB RL_GRID_UBYTE 0 CM_0p3921568627_0_DK 0 100
 /begin AXIS_DESCR FIX_AXIS NO_INPUT_QUANTITY CM_IDENTITY 6 0 5 FIX_AXIS_PAR_DIST 0 1 6 /end AXIS_DESCR
/end CHARACTERISTIC
/begin CHARACTERISTIC KFWEE "podtverzhdena damos-tochno addr 0x18FF8 | characteristic map angle end of injection" MAP 0x18FF8 RL_GRID_UBYTE 0 CM_6_0_GradKW 0 1530
 /begin AXIS_DESCR FIX_AXIS NO_INPUT_QUANTITY CM_IDENTITY 8 0 7 FIX_AXIS_PAR_DIST 0 1 8 /end AXIS_DESCR
 /begin AXIS_DESCR FIX_AXIS NO_INPUT_QUANTITY CM_IDENTITY 8 0 7 FIX_AXIS_PAR_DIST 0 1 8 /end AXIS_DESCR
/end CHARACTERISTIC
/begin CHARACTERISTIC KFWEEK "podtverzhdena damos-tochno addr 0x19038 | map for end of injection angle (cold parameters)" MAP 0x19038 RL_GRID_UBYTE 0 CM_6_0_GradKW 0 1530
 /begin AXIS_DESCR FIX_AXIS NO_INPUT_QUANTITY CM_IDENTITY 8 0 7 FIX_AXIS_PAR_DIST 0 1 8 /end AXIS_DESCR
 /begin AXIS_DESCR FIX_AXIS NO_INPUT_QUANTITY CM_IDENTITY 8 0 7 FIX_AXIS_PAR_DIST 0 1 8 /end AXIS_DESCR
/end CHARACTERISTIC
/begin CHARACTERISTIC SNM08GKUB "adres podtverzhden damos-veroyatno addr 0x19079 | IMYA NE PODTVERZHDENO, adres: kod: mov r12, #0x1078 @0x8429E8 | Datapoint distribution mixture control 8 nmot datapoints" CURVE 0x19079 RL_GRID_UBYTE 0 CM_40_0_Upm 0 10200
 /begin AXIS_DESCR FIX_AXIS NO_INPUT_QUANTITY CM_IDENTITY 8 0 7 FIX_AXIS_PAR_DIST 0 1 8 /end AXIS_DESCR
/end CHARACTERISTIC
/begin CHARACTERISTIC WEAN "adres podtverzhden damos-veroyatno addr 0x19093 | IMYA NE PODTVERZHDENO, adres: kod: mov r12, #0x1093 @0x8516F2 | angle injection break off" CURVE 0x19093 RL_GRID_UBYTE 0 CM_6_0_GradKW 0 1530
 /begin AXIS_DESCR FIX_AXIS NO_INPUT_QUANTITY CM_IDENTITY 8 0 7 FIX_AXIS_PAR_DIST 0 1 8 /end AXIS_DESCR
/end CHARACTERISTIC
/begin CHARACTERISTIC WEEM "adres podtverzhden damos-veroyatno addr 0x1909B | IMYA NE PODTVERZHDENO, adres: kod: mov r12, #0x109b @0x8516AA | correction of prestorage angle" CURVE 0x1909B RL_GRID_UBYTE 0 CM_6_0_GradKW 0 1530
 /begin AXIS_DESCR FIX_AXIS NO_INPUT_QUANTITY CM_IDENTITY 8 0 7 FIX_AXIS_PAR_DIST 0 1 8 /end AXIS_DESCR
/end CHARACTERISTIC
/begin CHARACTERISTIC WEEMRFAN "adres podtverzhden damos-veroyatno addr 0x190A3 | IMYA NE PODTVERZHDENO, adres: kod: mov r12, #0x10a3 @0x851640 | end of injection angle at max relative driver request" CURVE 0x190A3 RL_GRID_UBYTE 0 CM_6_0_GradKW 0 1530
 /begin AXIS_DESCR FIX_AXIS NO_INPUT_QUANTITY CM_IDENTITY 8 0 7 FIX_AXIS_PAR_DIST 0 1 8 /end AXIS_DESCR
/end CHARACTERISTIC
/begin CHARACTERISTIC WEESTM "adres podtverzhden damos-veroyatno addr 0x190AB | IMYA NE PODTVERZHDENO, adres: kod: mov r12, #0x10ab @0x8516D8 | correction of pretiming of injection during start" CURVE 0x190AB RL_GRID_UBYTE 0 CM_6_0_GradKW 0 1530
 /begin AXIS_DESCR FIX_AXIS NO_INPUT_QUANTITY CM_IDENTITY 8 0 7 FIX_AXIS_PAR_DIST 0 1 8 /end AXIS_DESCR
/end CHARACTERISTIC
/begin CHARACTERISTIC WEESTN "podtverzhdena damos addr 0x190B4 | end of injection angle during start" CURVE 0x190B4 RL_GRID_UBYTE 0 CM_6_0_GradKW 0 1530
 /begin AXIS_DESCR FIX_AXIS NO_INPUT_QUANTITY CM_IDENTITY 4 0 3 FIX_AXIS_PAR_DIST 0 1 4 /end AXIS_DESCR
/end CHARACTERISTIC
/begin CHARACTERISTIC ZZWEETM "adres podtverzhden damos-veroyatno addr 0x190BD | IMYA NE PODTVERZHDENO, adres: kod: mov r12, #0x10bc @0x8515F6 | Switchover threshold pattern angle" CURVE 0x190BD RL_GRID_UBYTE 0 CM_IDENTITY 0 255
 /begin AXIS_DESCR FIX_AXIS NO_INPUT_QUANTITY CM_IDENTITY 8 0 7 FIX_AXIS_PAR_DIST 0 1 8 /end AXIS_DESCR
/end CHARACTERISTIC
/begin CHARACTERISTIC KFLF "podtverzhdena damos addr 0x190EC | lambda characteristic map at part load" MAP 0x190EC RL_GRID_UBYTE 0 CM_0p0078125_0 0 1.99219
 /begin AXIS_DESCR FIX_AXIS NO_INPUT_QUANTITY CM_IDENTITY 16 0 15 FIX_AXIS_PAR_DIST 0 1 16 /end AXIS_DESCR
 /begin AXIS_DESCR FIX_AXIS NO_INPUT_QUANTITY CM_IDENTITY 12 0 11 FIX_AXIS_PAR_DIST 0 1 12 /end AXIS_DESCR
/end CHARACTERISTIC
/begin CHARACTERISTIC FSTHO "adres podtverzhden damos-veroyatno addr 0x191AD | IMYA NE PODTVERZHDENO, adres: kod: mov r12, #0x11ac @0x851A5A | weighting of factor start" CURVE 0x191AD RL_GRID_UBYTE 0 CM_0p0078125_0 0 1.99219
 /begin AXIS_DESCR FIX_AXIS NO_INPUT_QUANTITY CM_IDENTITY 4 0 3 FIX_AXIS_PAR_DIST 0 1 4 /end AXIS_DESCR
/end CHARACTERISTIC
/begin CHARACTERISTIC FNSA "adres podtverzhden damos-veroyatno addr 0x191B5 | IMYA NE PODTVERZHDENO, adres: kod: mov r12, #0x11b5 @0x851CFC | after start increase" CURVE 0x191B5 RL_GRID_UBYTE 0 CM_0p0078125_0 0 1.99219
 /begin AXIS_DESCR FIX_AXIS NO_INPUT_QUANTITY CM_IDENTITY 6 0 5 FIX_AXIS_PAR_DIST 0 1 6 /end AXIS_DESCR
/end CHARACTERISTIC
/begin CHARACTERISTIC FNSHO "adres podtverzhden damos-veroyatno addr 0x191BC | IMYA NE PODTVERZHDENO, adres: kod: mov r12, #0x11bb @0x851D9C | weighting of afterstart enrichment" CURVE 0x191BC RL_GRID_UBYTE 0 CM_0p0078125_0 0 1.99219
 /begin AXIS_DESCR FIX_AXIS NO_INPUT_QUANTITY CM_IDENTITY 4 0 3 FIX_AXIS_PAR_DIST 0 1 4 /end AXIS_DESCR
/end CHARACTERISTIC
/begin CHARACTERISTIC KFFWL "podtverzhdena damos-tochno addr 0x191DF | map warm-up factor" MAP 0x191DF RL_GRID_UBYTE 0 CM_0p0078125_0 0 1.99219
 /begin AXIS_DESCR FIX_AXIS NO_INPUT_QUANTITY CM_IDENTITY 12 0 11 FIX_AXIS_PAR_DIST 0 1 12 /end AXIS_DESCR
 /begin AXIS_DESCR FIX_AXIS NO_INPUT_QUANTITY CM_IDENTITY 12 0 11 FIX_AXIS_PAR_DIST 0 1 12 /end AXIS_DESCR
/end CHARACTERISTIC
/begin CHARACTERISTIC FUKNSTM "podtverzhdena damos addr 0x1930C | initial value of transient control post cranking factor" CURVE 0x1930C RL_GRID_UBYTE 0 CM_0p015625_0 0 3.98438
 /begin AXIS_DESCR FIX_AXIS NO_INPUT_QUANTITY CM_IDENTITY 9 0 8 FIX_AXIS_PAR_DIST 0 1 9 /end AXIS_DESCR
/end CHARACTERISTIC
/begin CHARACTERISTIC MAP_512_193E0_9 "adres podtverzhden mapscan addr 0x193E0 | IMYA NE PODTVERZHDENO, adres: kod: mov r12, #0x13e0 @0x85235C" CURVE 0x193E0 RL_2D_A8_UBYTE 0 CM_IDENTITY 0 255 /begin AXIS_DESCR STD_AXIS NO_INPUT_QUANTITY CM_IDENTITY 9 0 255 /end AXIS_DESCR /end CHARACTERISTIC
/begin CHARACTERISTIC KFLBTS "podtverzhdena profil addr 0x19636 | Celevaya lyambda zaschity komponentov. Stok obogaschaet do 0.789 na vysokoy nagruzke, csok do 0.844, MPower -- 1.000 vo vseh 192 yacheykah, to est obogaschenie zasc" MAP 0x19636 RL_GRID_UBYTE 0 CM_0p0078125_0 0 1.99219
 /begin AXIS_DESCR COM_AXIS NO_INPUT_QUANTITY CM_0p75_0 12 0 191.25 AXIS_PTS_REF SRL12_GK /end AXIS_DESCR
 /begin AXIS_DESCR COM_AXIS NO_INPUT_QUANTITY CM_40_0_rpm 16 0 10200 AXIS_PTS_REF SNM16_GK /end AXIS_DESCR
/end CHARACTERISTIC
/begin CHARACTERISTIC MAP_521_196F8_5 "adres podtverzhden mapscan addr 0x196F8 | IMYA NE PODTVERZHDENO, adres: kod: mov r12, #0x16fe @0x851A0C" CURVE 0x196F8 RL_2D_A8_UBYTE 0 CM_IDENTITY 0 255 /begin AXIS_DESCR STD_AXIS NO_INPUT_QUANTITY CM_IDENTITY 5 0 255 /end AXIS_DESCR /end CHARACTERISTIC
/begin CHARACTERISTIC MAP_523_19719_8 "adres podtverzhden mapscan addr 0x19719 | IMYA NE PODTVERZHDENO, adres: kod: mov r12, #0x1718 @0x8568A2" CURVE 0x19719 RL_2D_A8_UBYTE 0 CM_IDENTITY 0 255 /begin AXIS_DESCR STD_AXIS NO_INPUT_QUANTITY CM_IDENTITY 8 0 255 /end AXIS_DESCR /end CHARACTERISTIC
/begin CHARACTERISTIC KFTKONS "podtverzhdena damos-tochno addr 0x1972A | A/C switch-on delay time (morning brake sharpness)" MAP 0x1972A RL_GRID_UBYTE 0 CM_IDENTITY 0 255
 /begin AXIS_DESCR FIX_AXIS NO_INPUT_QUANTITY CM_IDENTITY 8 0 7 FIX_AXIS_PAR_DIST 0 1 8 /end AXIS_DESCR
 /begin AXIS_DESCR FIX_AXIS NO_INPUT_QUANTITY CM_IDENTITY 8 0 7 FIX_AXIS_PAR_DIST 0 1 8 /end AXIS_DESCR
/end CHARACTERISTIC
/begin CHARACTERISTIC MAP_525_1976E_6 "adres podtverzhden mapscan addr 0x1976E | IMYA NE PODTVERZHDENO, adres: kod: mov r12, #0x176e @0x857654" CURVE 0x1976E RL_2D_A8_UBYTE 0 CM_IDENTITY 0 255 /begin AXIS_DESCR STD_AXIS NO_INPUT_QUANTITY CM_IDENTITY 6 0 255 /end AXIS_DESCR /end CHARACTERISTIC
/begin CHARACTERISTIC MAP_527_1979E_6 "adres podtverzhden mapscan addr 0x1979E | IMYA NE PODTVERZHDENO, adres: kod: mov r12, #0x179e @0x85741E" CURVE 0x1979E RL_2D_A8_UBYTE 0 CM_IDENTITY 0 255 /begin AXIS_DESCR STD_AXIS NO_INPUT_QUANTITY CM_IDENTITY 6 0 255 /end AXIS_DESCR /end CHARACTERISTIC
/begin CHARACTERISTIC GRID_528_197BC_10x10 "adres podtverzhden gridscan addr 0x197BC | IMYA NE PODTVERZHDENO, adres: kod: mov r12, #0x17bc @0x8574EE" MAP 0x197BC RL_GRID_UBYTE 0 CM_IDENTITY 0 255
 /begin AXIS_DESCR FIX_AXIS NO_INPUT_QUANTITY CM_IDENTITY 10 0 9 FIX_AXIS_PAR_DIST 0 1 10 /end AXIS_DESCR
 /begin AXIS_DESCR FIX_AXIS NO_INPUT_QUANTITY CM_IDENTITY 10 0 9 FIX_AXIS_PAR_DIST 0 1 10 /end AXIS_DESCR
/end CHARACTERISTIC
/begin CHARACTERISTIC KFFTEAX "podtverzhdena damos addr 0x1982B | Characteristic map for limitation of the purge rate" MAP 0x1982B RL_GRID_UBYTE 0 CM_0p001953125_0 0 0.498047
 /begin AXIS_DESCR FIX_AXIS NO_INPUT_QUANTITY CM_IDENTITY 4 0 3 FIX_AXIS_PAR_DIST 0 1 4 /end AXIS_DESCR
 /begin AXIS_DESCR FIX_AXIS NO_INPUT_QUANTITY CM_IDENTITY 5 0 4 FIX_AXIS_PAR_DIST 0 1 5 /end AXIS_DESCR
/end CHARACTERISTIC
/begin CHARACTERISTIC KFQTE "podtverzhdena damos-tochno addr 0x1983F | Map for purge rate increase / decrease" MAP 0x1983F RL_GRID_UBYTE 0 CM_4p768359375En05_0_1s 0 0.0121593
 /begin AXIS_DESCR FIX_AXIS NO_INPUT_QUANTITY CM_IDENTITY 5 0 4 FIX_AXIS_PAR_DIST 0 1 5 /end AXIS_DESCR
 /begin AXIS_DESCR FIX_AXIS NO_INPUT_QUANTITY CM_IDENTITY 6 0 5 FIX_AXIS_PAR_DIST 0 1 6 /end AXIS_DESCR
/end CHARACTERISTIC
/begin CHARACTERISTIC KFTATX "podtverzhdena damos addr 0x1986F | map for max. duty cycle" MAP 0x1986F RL_GRID_UBYTE 0 CM_0p390625_0 0 99.6094
 /begin AXIS_DESCR FIX_AXIS NO_INPUT_QUANTITY CM_IDENTITY 6 0 5 FIX_AXIS_PAR_DIST 0 1 6 /end AXIS_DESCR
 /begin AXIS_DESCR FIX_AXIS NO_INPUT_QUANTITY CM_IDENTITY 10 0 9 FIX_AXIS_PAR_DIST 0 1 10 /end AXIS_DESCR
/end CHARACTERISTIC
/begin CHARACTERISTIC MAP_533_198B4_5 "adres podtverzhden mapscan addr 0x198B4 | IMYA NE PODTVERZHDENO, adres: kod: mov r12, #0x18b4 @0x857944" CURVE 0x198B4 RL_2D_A8_UWORD 0 CM_IDENTITY 0 65535 /begin AXIS_DESCR STD_AXIS NO_INPUT_QUANTITY CM_IDENTITY 5 0 255 /end AXIS_DESCR /end CHARACTERISTIC
/begin CHARACTERISTIC KFTEVP "podtverzhdena damos-tochno addr 0x198C4 | Characteristic map for period time of the PCV" MAP 0x198C4 RL_GRID_UBYTE 0 CM_0p5_0_ms 0 127.5
 /begin AXIS_DESCR FIX_AXIS NO_INPUT_QUANTITY CM_IDENTITY 9 0 8 FIX_AXIS_PAR_DIST 0 1 9 /end AXIS_DESCR
 /begin AXIS_DESCR FIX_AXIS NO_INPUT_QUANTITY CM_IDENTITY 5 0 4 FIX_AXIS_PAR_DIST 0 1 5 /end AXIS_DESCR
/end CHARACTERISTIC
/begin CHARACTERISTIC KFTVTEV "podtverzhdena damos addr 0x198FC | characteristic map for CVP delay time" MAP 0x198FC RL_GRID_UBYTE 0 CM_0p5_0_ms 0 127.5
 /begin AXIS_DESCR FIX_AXIS NO_INPUT_QUANTITY CM_IDENTITY 3 0 2 FIX_AXIS_PAR_DIST 0 1 3 /end AXIS_DESCR
 /begin AXIS_DESCR FIX_AXIS NO_INPUT_QUANTITY CM_IDENTITY 6 0 5 FIX_AXIS_PAR_DIST 0 1 6 /end AXIS_DESCR
/end CHARACTERISTIC
/begin CHARACTERISTIC KFDETATE "podtverzhdena damos-tochno addr 0x19923 | correction of ignition angle effectiveness for diagnosis of PCV" MAP 0x19923 RL_GRID_UBYTE 0 CM_0p5_0 0 127.5
 /begin AXIS_DESCR FIX_AXIS NO_INPUT_QUANTITY CM_IDENTITY 6 0 5 FIX_AXIS_PAR_DIST 0 1 6 /end AXIS_DESCR
 /begin AXIS_DESCR FIX_AXIS NO_INPUT_QUANTITY CM_IDENTITY 4 0 3 FIX_AXIS_PAR_DIST 0 1 4 /end AXIS_DESCR
/end CHARACTERISTIC
/begin CHARACTERISTIC MAP_537_19950_14 "adres podtverzhden mapscan addr 0x19950 | IMYA NE PODTVERZHDENO, adres: kod: mov r12, #0x1950 @0x858182" CURVE 0x19950 RL_2D_A8_UBYTE 0 CM_IDENTITY 0 255 /begin AXIS_DESCR STD_AXIS NO_INPUT_QUANTITY CM_IDENTITY 14 0 255 /end AXIS_DESCR /end CHARACTERISTIC
/begin CHARACTERISTIC KFMDDAGR "podtverzhdena damos-tochno addr 0x199A7 | Map torque reserve at tester demand of EGR-short test" MAP 0x199A7 RL_GRID_UBYTE 0 CM_0p390625_0 0 99.6094
 /begin AXIS_DESCR FIX_AXIS NO_INPUT_QUANTITY CM_IDENTITY 8 0 7 FIX_AXIS_PAR_DIST 0 1 8 /end AXIS_DESCR
 /begin AXIS_DESCR FIX_AXIS NO_INPUT_QUANTITY CM_IDENTITY 8 0 7 FIX_AXIS_PAR_DIST 0 1 8 /end AXIS_DESCR
/end CHARACTERISTIC
/begin CHARACTERISTIC DTLRTML "adres podtverzhden damos-veroyatno addr 0x19A1B | IMYA NE PODTVERZHDENO, adres: kod: mov r12, #0x1a1a @0x8572A2 | proportion factor to decrease waiting time up to tmot-threshold for closed loop" CURVE 0x19A1B RL_GRID_UBYTE 0 CM_0p390625_0 0 99.6094
 /begin AXIS_DESCR FIX_AXIS NO_INPUT_QUANTITY CM_IDENTITY 7 0 6 FIX_AXIS_PAR_DIST 0 1 7 /end AXIS_DESCR
/end CHARACTERISTIC
/begin CHARACTERISTIC TMLRTMS "adres podtverzhden damos-veroyatno addr 0x19A26 | IMYA NE PODTVERZHDENO, adres: kod: mov r12, #0x1a25 @0x8604D6 | engine temp. threshold for lambda control depending on cranking temp. tmst" CURVE 0x19A26 RL_GRID_SBYTE 0 CM_0p75_48_GradC -144 47.25
 /begin AXIS_DESCR FIX_AXIS NO_INPUT_QUANTITY CM_IDENTITY 4 0 3 FIX_AXIS_PAR_DIST 0 1 4 /end AXIS_DESCR
/end CHARACTERISTIC
/begin CHARACTERISTIC MAP_541_19A2F_20 "adres podtverzhden mapscan addr 0x19A2F | IMYA NE PODTVERZHDENO, adres: kod: mov r12, #0x1a2f @0x860424" CURVE 0x19A2F RL_2D_A8_UBYTE 0 CM_IDENTITY 0 255 /begin AXIS_DESCR STD_AXIS NO_INPUT_QUANTITY CM_IDENTITY 20 0 255 /end AXIS_DESCR /end CHARACTERISTIC
/begin CHARACTERISTIC TWLRTMS "adres podtverzhden damos-veroyatno addr 0x19A5A | IMYA NE PODTVERZHDENO, adres: kod: mov r12, #0x1a59 @0x860534 | waiting time up to check engine temp. signal exceeding threshold for closed loop" CURVE 0x19A5A RL_GRID_UBYTE 0 CM_20_0_s 0 5100
 /begin AXIS_DESCR FIX_AXIS NO_INPUT_QUANTITY CM_IDENTITY 4 0 3 FIX_AXIS_PAR_DIST 0 1 4 /end AXIS_DESCR
/end CHARACTERISTIC
/begin CHARACTERISTIC MAP_543_19A6B_20 "adres podtverzhden mapscan addr 0x19A6B | IMYA NE PODTVERZHDENO, adres: kod: mov r12, #0x1a6b @0x860EC2" CURVE 0x19A6B RL_2D_A8_UBYTE 0 CM_IDENTITY 0 255 /begin AXIS_DESCR STD_AXIS NO_INPUT_QUANTITY CM_IDENTITY 20 0 255 /end AXIS_DESCR /end CHARACTERISTIC
/begin CHARACTERISTIC MAP_544_19AAC_4 "adres podtverzhden mapscan addr 0x19AAC | IMYA NE PODTVERZHDENO, adres: kod: mov r12, #0x1aab @0x8616A0" CURVE 0x19AAC RL_2D_A8_UBYTE 0 CM_IDENTITY 0 255 /begin AXIS_DESCR STD_AXIS NO_INPUT_QUANTITY CM_IDENTITY 4 0 255 /end AXIS_DESCR /end CHARACTERISTIC
/begin CHARACTERISTIC KFIDTHM "podtverzhdena damos-tochno addr 0x19AB5 | Map value for threshold of integrated air mass for thermostat error detection" MAP 0x19AB5 RL_GRID_UBYTE 0 CM_0p09103840683_0_kg 0 23.2148
 /begin AXIS_DESCR FIX_AXIS NO_INPUT_QUANTITY CM_IDENTITY 4 0 3 FIX_AXIS_PAR_DIST 0 1 4 /end AXIS_DESCR
 /begin AXIS_DESCR FIX_AXIS NO_INPUT_QUANTITY CM_IDENTITY 4 0 3 FIX_AXIS_PAR_DIST 0 1 4 /end AXIS_DESCR
/end CHARACTERISTIC
/begin CHARACTERISTIC LURKH "adres podtverzhden damos-veroyatno addr 0x19AD3 | IMYA NE PODTVERZHDENO, adres: kod: mov r12, #0x1ad2 @0x8666FA | dmrkh-depen. engine roughness reference correction value, during cat heating" CURVE 0x19AD3 RL_GRID_UBYTE 0 CM_0p0078125_0 0 1.99219
 /begin AXIS_DESCR FIX_AXIS NO_INPUT_QUANTITY CM_IDENTITY 4 0 3 FIX_AXIS_PAR_DIST 0 1 4 /end AXIS_DESCR
/end CHARACTERISTIC
/begin CHARACTERISTIC AINTKAN "adres podtverzhden damos-veroyatno addr 0x19ADB | IMYA NE PODTVERZHDENO, adres: kod: mov r12, #0x1adb @0x868828 | number of interval misfire frequency at which ti- cutoff" CURVE 0x19ADB RL_GRID_UBYTE 0 CM_IDENTITY 0 255
 /begin AXIS_DESCR FIX_AXIS NO_INPUT_QUANTITY CM_IDENTITY 8 0 7 FIX_AXIS_PAR_DIST 0 1 8 /end AXIS_DESCR
/end CHARACTERISTIC
/begin CHARACTERISTIC SLX06TMUW "adres podtverzhden damos-veroyatno addr 0x19BE8 | IMYA NE PODTVERZHDENO, adres: kod: mov r12, #0x1be6 @0x834F66 | lamsbg dependet basic point (number 6)" CURVE 0x19BE8 RL_GRID_UBYTE 0 CM_0p000244140625_0 0 0.0622559
 /begin AXIS_DESCR FIX_AXIS NO_INPUT_QUANTITY CM_IDENTITY 6 0 5 FIX_AXIS_PAR_DIST 0 1 6 /end AXIS_DESCR
/end CHARACTERISTIC
/begin CHARACTERISTIC SML07TMUW "adres podtverzhden damos-veroyatno addr 0x19BF6 | IMYA NE PODTVERZHDENO, adres: kod: mov r12, #0x1bf4 @0x834F4E | ml dependet basic point (number 7)" CURVE 0x19BF6 RL_GRID_UBYTE 0 CM_0p1_0_kgh 0 25.5
 /begin AXIS_DESCR FIX_AXIS NO_INPUT_QUANTITY CM_IDENTITY 7 0 6 FIX_AXIS_PAR_DIST 0 1 7 /end AXIS_DESCR
/end CHARACTERISTIC
/begin CHARACTERISTIC SRL04DYUB "adres podtverzhden damos-veroyatno addr 0x19C04 | IMYA NE PODTVERZHDENO, adres: kod: mov r12, #0x1c04 @0x834B2C | basepoint distribution of rl, 4 basepoints" CURVE 0x19C04 RL_GRID_UBYTE 0 CM_IDENTITY 0 255
 /begin AXIS_DESCR FIX_AXIS NO_INPUT_QUANTITY CM_IDENTITY 4 0 3 FIX_AXIS_PAR_DIST 0 1 4 /end AXIS_DESCR
/end CHARACTERISTIC
/begin CHARACTERISTIC KFDMDARO "podtverzhdena damos-tochno addr 0x1A54E | Upper threshold for torque intervension" MAP 0x1A54E RL_GRID_SBYTE 0 CM_0p003051757812_0 -0.390625 0.387573
 /begin AXIS_DESCR FIX_AXIS NO_INPUT_QUANTITY CM_IDENTITY 6 0 5 FIX_AXIS_PAR_DIST 0 1 6 /end AXIS_DESCR
 /begin AXIS_DESCR FIX_AXIS NO_INPUT_QUANTITY CM_IDENTITY 8 0 7 FIX_AXIS_PAR_DIST 0 1 8 /end AXIS_DESCR
/end CHARACTERISTIC
/begin CHARACTERISTIC KFDMDARU "podtverzhdena damos-tochno addr 0x1A5C6 | Lower threshold for torque intervension" MAP 0x1A5C6 RL_GRID_SBYTE 0 CM_0p003051757812_0 -0.390625 0.387573
 /begin AXIS_DESCR FIX_AXIS NO_INPUT_QUANTITY CM_IDENTITY 6 0 5 FIX_AXIS_PAR_DIST 0 1 6 /end AXIS_DESCR
 /begin AXIS_DESCR FIX_AXIS NO_INPUT_QUANTITY CM_IDENTITY 8 0 7 FIX_AXIS_PAR_DIST 0 1 8 /end AXIS_DESCR
/end CHARACTERISTIC
/begin CHARACTERISTIC MKLWON "adres podtverzhden damos-veroyatno addr 0x1A652 | IMYA NE PODTVERZHDENO, adres: kod: mov r12, #0x2652 @0x83BB30 | upper clutch torque threshold for antijerking function" CURVE 0x1A652 RL_GRID_SBYTE 0 CM_0p003051757812_0 -0.390625 0.387573
 /begin AXIS_DESCR FIX_AXIS NO_INPUT_QUANTITY CM_IDENTITY 6 0 5 FIX_AXIS_PAR_DIST 0 1 6 /end AXIS_DESCR
/end CHARACTERISTIC
/begin CHARACTERISTIC MKLWOWKN "adres podtverzhden damos-veroyatno addr 0x1A65E | IMYA NE PODTVERZHDENO, adres: kod: mov r12, #0x265e @0x83BB12 | upper clutch torque threshold for antijerking on an openned lockup clutch" CURVE 0x1A65E RL_GRID_SBYTE 0 CM_0p003051757812_0 -0.390625 0.387573
 /begin AXIS_DESCR FIX_AXIS NO_INPUT_QUANTITY CM_IDENTITY 6 0 5 FIX_AXIS_PAR_DIST 0 1 6 /end AXIS_DESCR
/end CHARACTERISTIC
/begin CHARACTERISTIC MKLWSAN "adres podtverzhden damos-veroyatno addr 0x1A66A | IMYA NE PODTVERZHDENO, adres: kod: mov r12, #0x266a @0x83BB80 | lower clutch torque threshold for antijerking on fuell cutoff restart" CURVE 0x1A66A RL_GRID_SBYTE 0 CM_0p003051757812_0 -0.390625 0.387573
 /begin AXIS_DESCR FIX_AXIS NO_INPUT_QUANTITY CM_IDENTITY 6 0 5 FIX_AXIS_PAR_DIST 0 1 6 /end AXIS_DESCR
/end CHARACTERISTIC
/begin CHARACTERISTIC MKLWUN "adres podtverzhden damos-veroyatno addr 0x1A676 | IMYA NE PODTVERZHDENO, adres: kod: mov r12, #0x2676 @0x83BB9E | lower clutch torque threshold for antijerking" CURVE 0x1A676 RL_GRID_SBYTE 0 CM_0p003051757812_0 -0.390625 0.387573
 /begin AXIS_DESCR FIX_AXIS NO_INPUT_QUANTITY CM_IDENTITY 6 0 5 FIX_AXIS_PAR_DIST 0 1 6 /end AXIS_DESCR
/end CHARACTERISTIC
/begin CHARACTERISTIC MKLWUWKN "adres podtverzhden damos-veroyatno addr 0x1A682 | IMYA NE PODTVERZHDENO, adres: kod: mov r12, #0x2682 @0x83BB5A | lower clutch torque threshold for antijerking on an openned lockup clutch" CURVE 0x1A682 RL_GRID_SBYTE 0 CM_0p003051757812_0 -0.390625 0.387573
 /begin AXIS_DESCR FIX_AXIS NO_INPUT_QUANTITY CM_IDENTITY 6 0 5 FIX_AXIS_PAR_DIST 0 1 6 /end AXIS_DESCR
/end CHARACTERISTIC
/begin CHARACTERISTIC MAP_561_1A692_12 "adres podtverzhden mapscan addr 0x1A692 | IMYA NE PODTVERZHDENO, adres: kod: mov r4, #0x269f @0x83E348" CURVE 0x1A692 RL_2D_A8_UWORD 0 CM_IDENTITY 0 65535 /begin AXIS_DESCR STD_AXIS NO_INPUT_QUANTITY CM_IDENTITY 12 0 255 /end AXIS_DESCR /end CHARACTERISTIC
/begin CHARACTERISTIC KFDZWKG "podtverzhdena damos-tochno addr 0x1A6BB | ignition angle correction due to knock limit shift" MAP 0x1A6BB RL_GRID_SBYTE 0 CM_0p75_0_gradKW -96 95.25
 /begin AXIS_DESCR FIX_AXIS NO_INPUT_QUANTITY CM_IDENTITY 5 0 4 FIX_AXIS_PAR_DIST 0 1 5 /end AXIS_DESCR
 /begin AXIS_DESCR FIX_AXIS NO_INPUT_QUANTITY CM_IDENTITY 8 0 7 FIX_AXIS_PAR_DIST 0 1 8 /end AXIS_DESCR
/end CHARACTERISTIC
/begin CHARACTERISTIC KFZWNWSUE "podtverzhdena damos addr 0x1A700 | Delta ignition angle dependent on the camshaft overlap" MAP 0x1A700 RL_GRID_SBYTE 0 CM_0p75_0_gradKW -96 95.25
 /begin AXIS_DESCR FIX_AXIS NO_INPUT_QUANTITY CM_IDENTITY 16 0 15 FIX_AXIS_PAR_DIST 0 1 16 /end AXIS_DESCR
 /begin AXIS_DESCR FIX_AXIS NO_INPUT_QUANTITY CM_IDENTITY 10 0 9 FIX_AXIS_PAR_DIST 0 1 10 /end AXIS_DESCR
/end CHARACTERISTIC
/begin CHARACTERISTIC KFZWWLTM "podtverzhdena damos-tochno addr 0x1A7BA | Delta ignition sparc advance during engine warm up phase" MAP 0x1A7BA RL_GRID_SBYTE 0 CM_0p75_0_gradKW -96 95.25
 /begin AXIS_DESCR FIX_AXIS NO_INPUT_QUANTITY CM_IDENTITY 12 0 11 FIX_AXIS_PAR_DIST 0 1 12 /end AXIS_DESCR
 /begin AXIS_DESCR FIX_AXIS NO_INPUT_QUANTITY CM_IDENTITY 12 0 11 FIX_AXIS_PAR_DIST 0 1 12 /end AXIS_DESCR
/end CHARACTERISTIC
/begin CHARACTERISTIC MAP_565_1A84A_6 "adres podtverzhden mapscan addr 0x1A84A | IMYA NE PODTVERZHDENO, adres: kod: mov r4, #0x2851 @0x83E50E" CURVE 0x1A84A RL_2D_A8_UWORD 0 CM_IDENTITY 0 65535 /begin AXIS_DESCR STD_AXIS NO_INPUT_QUANTITY CM_IDENTITY 6 0 255 /end AXIS_DESCR /end CHARACTERISTIC
/begin CHARACTERISTIC MAP_566_1A88A_6 "adres podtverzhden mapscan addr 0x1A88A | IMYA NE PODTVERZHDENO, adres: kod: mov r4, #0x2891 @0x840358" CURVE 0x1A88A RL_2D_A8_UWORD 0 CM_IDENTITY 0 65535 /begin AXIS_DESCR STD_AXIS NO_INPUT_QUANTITY CM_IDENTITY 6 0 255 /end AXIS_DESCR /end CHARACTERISTIC
/begin CHARACTERISTIC KFPSDMX "podtverzhdena damos-tochno addr 0x1A8F7 | pressure threshold for B_nplm failure (check DS-S)" MAP 0x1A8F7 RL_GRID_UBYTE 0 CM_0p0390625_0_hPa 0 9.96094
 /begin AXIS_DESCR FIX_AXIS NO_INPUT_QUANTITY CM_IDENTITY 8 0 7 FIX_AXIS_PAR_DIST 0 1 8 /end AXIS_DESCR
 /begin AXIS_DESCR FIX_AXIS NO_INPUT_QUANTITY CM_IDENTITY 8 0 7 FIX_AXIS_PAR_DIST 0 1 8 /end AXIS_DESCR
/end CHARACTERISTIC
/begin CHARACTERISTIC FPVMXN2 "podtverzhdena damos addr 0x1A9A0 | factor for pressure ratio maximum with secondary last sensor" CURVE 0x1A9A0 RL_GRID_UWORD 0 CM_3p051757812En05_0 0 1.99997
 /begin AXIS_DESCR FIX_AXIS NO_INPUT_QUANTITY CM_IDENTITY 6 0 5 FIX_AXIS_PAR_DIST 0 1 6 /end AXIS_DESCR
/end CHARACTERISTIC
/begin CHARACTERISTIC MAP_575_1ADDB_5 "adres podtverzhden mapscan addr 0x1ADDB | IMYA NE PODTVERZHDENO, adres: kod: mov r4, #0x2de6 @0x84428C" CURVE 0x1ADDB RL_2D_A16_UWORD 0 CM_IDENTITY 0 65535 /begin AXIS_DESCR STD_AXIS NO_INPUT_QUANTITY CM_IDENTITY 5 0 65535 /end AXIS_DESCR /end CHARACTERISTIC
/begin CHARACTERISTIC MAP_576_1AEC3_6 "adres podtverzhden mapscan addr 0x1AEC3 | IMYA NE PODTVERZHDENO, adres: kod: mov r12, #0x2ec2 @0x84519C" CURVE 0x1AEC3 RL_2D_A8_UBYTE 0 CM_IDENTITY 0 255 /begin AXIS_DESCR STD_AXIS NO_INPUT_QUANTITY CM_IDENTITY 6 0 255 /end AXIS_DESCR /end CHARACTERISTIC
/begin CHARACTERISTIC MAP_577_1AF14_6 "adres podtverzhden mapscan addr 0x1AF14 | IMYA NE PODTVERZHDENO, adres: kod: mov r12, #0x2f14 @0x845476" CURVE 0x1AF14 RL_2D_A16_UWORD 0 CM_IDENTITY 0 65535 /begin AXIS_DESCR STD_AXIS NO_INPUT_QUANTITY CM_IDENTITY 6 0 65535 /end AXIS_DESCR /end CHARACTERISTIC
/begin CHARACTERISTIC KFRLW_1B3F3 "podtverzhdena damos-tochno addr 0x1B3F3 | rlw-map from throttle valve angle" MAP 0x1B3F3 RL_GRID_UBYTE 0 CM_0p0234375_0 0 5.97656
 /begin AXIS_DESCR FIX_AXIS NO_INPUT_QUANTITY CM_IDENTITY 12 0 11 FIX_AXIS_PAR_DIST 0 1 12 /end AXIS_DESCR
 /begin AXIS_DESCR FIX_AXIS NO_INPUT_QUANTITY CM_IDENTITY 12 0 11 FIX_AXIS_PAR_DIST 0 1 12 /end AXIS_DESCR
/end CHARACTERISTIC
/begin CHARACTERISTIC MAP_585_1B497_8 "adres podtverzhden mapscan addr 0x1B497 | IMYA NE PODTVERZHDENO, adres: kod: mov r4, #0x34a8 @0x851CB2" CURVE 0x1B497 RL_2D_A16_UBYTE 0 CM_IDENTITY 0 255 /begin AXIS_DESCR STD_AXIS NO_INPUT_QUANTITY CM_IDENTITY 8 0 65535 /end AXIS_DESCR /end CHARACTERISTIC
/begin CHARACTERISTIC KFZKPUA "podtverzhdena damos-tochno addr 0x1B53F | time constant for ambient pressure" MAP 0x1B53F RL_GRID_UBYTE 0 CM_IDENTITY 0 255
 /begin AXIS_DESCR FIX_AXIS NO_INPUT_QUANTITY CM_IDENTITY 8 0 7 FIX_AXIS_PAR_DIST 0 1 8 /end AXIS_DESCR
 /begin AXIS_DESCR FIX_AXIS NO_INPUT_QUANTITY CM_IDENTITY 12 0 11 FIX_AXIS_PAR_DIST 0 1 12 /end AXIS_DESCR
/end CHARACTERISTIC
/begin CHARACTERISTIC MAP_587_1B5E1_6 "adres podtverzhden mapscan addr 0x1B5E1 | IMYA NE PODTVERZHDENO, adres: kod: mov r4, #0x35e8 @0x8548B4" CURVE 0x1B5E1 RL_2D_A8_UWORD 0 CM_IDENTITY 0 65535 /begin AXIS_DESCR STD_AXIS NO_INPUT_QUANTITY CM_IDENTITY 6 0 255 /end AXIS_DESCR /end CHARACTERISTIC
/begin CHARACTERISTIC MAP_588_1B612_5 "adres podtverzhden mapscan addr 0x1B612 | IMYA NE PODTVERZHDENO, adres: kod: mov r4, #0x3618 @0x8548E8" CURVE 0x1B612 RL_2D_A8_UWORD 0 CM_IDENTITY 0 65535 /begin AXIS_DESCR STD_AXIS NO_INPUT_QUANTITY CM_IDENTITY 5 0 255 /end AXIS_DESCR /end CHARACTERISTIC
/begin CHARACTERISTIC ATMTANS "podtverzhdena damos addr 0x1B67A | temperature correction of the exhaust model temperature" CURVE 0x1B67A RL_GRID_SBYTE 0 CM_5_0_GradC -640 635
 /begin AXIS_DESCR FIX_AXIS NO_INPUT_QUANTITY CM_IDENTITY 3 0 2 FIX_AXIS_PAR_DIST 0 1 3 /end AXIS_DESCR
/end CHARACTERISTIC
/begin CHARACTERISTIC MAP_602_1B8C0_5 "adres podtverzhden mapscan addr 0x1B8C0 | IMYA NE PODTVERZHDENO, adres: kod: mov r12, #0x38c0 @0x8574BA" CURVE 0x1B8C0 RL_2D_A8_UBYTE 0 CM_IDENTITY 0 255 /begin AXIS_DESCR STD_AXIS NO_INPUT_QUANTITY CM_IDENTITY 5 0 255 /end AXIS_DESCR /end CHARACTERISTIC
/begin CHARACTERISTIC MAP_603_1B91F_5 "adres podtverzhden mapscan addr 0x1B91F | IMYA NE PODTVERZHDENO, adres: kod: mov r4, #0x3925 @0x85748A" CURVE 0x1B91F RL_2D_A8_UBYTE 0 CM_IDENTITY 0 255 /begin AXIS_DESCR STD_AXIS NO_INPUT_QUANTITY CM_IDENTITY 5 0 255 /end AXIS_DESCR /end CHARACTERISTIC
/begin CHARACTERISTIC FKHLA "podtverzhdena damos addr 0x1B950 | Weighting factor Lambda nominal for catalyzer heating" CURVE 0x1B950 RL_GRID_UWORD 0 CM_1p525878906En05_0 0 0.999985
 /begin AXIS_DESCR FIX_AXIS NO_INPUT_QUANTITY CM_IDENTITY 8 0 7 FIX_AXIS_PAR_DIST 0 1 8 /end AXIS_DESCR
/end CHARACTERISTIC
/begin CHARACTERISTIC FKHMD "podtverzhdena damos addr 0x1B96C | Weighting factor torque reserve for catalyzer heating" CURVE 0x1B96C RL_GRID_UWORD 0 CM_1p525878906En05_0 0 0.999985
 /begin AXIS_DESCR FIX_AXIS NO_INPUT_QUANTITY CM_IDENTITY 8 0 7 FIX_AXIS_PAR_DIST 0 1 8 /end AXIS_DESCR
/end CHARACTERISTIC
/begin CHARACTERISTIC MAP_608_1B9EC_4 "adres podtverzhden mapscan addr 0x1B9EC | IMYA NE PODTVERZHDENO, adres: kod: mov r13, #0x39ec @0x860A7C" CURVE 0x1B9EC RL_2D_A8_UBYTE 0 CM_IDENTITY 0 255 /begin AXIS_DESCR STD_AXIS NO_INPUT_QUANTITY CM_IDENTITY 4 0 255 /end AXIS_DESCR /end CHARACTERISTIC
/begin CHARACTERISTIC KLESUKKO "podtverzhdena damos addr 0x1BD89 | Characteristic line transient compensation at A/C on" CURVE 0x1BD89 RL_GRID_UWORD 0 CM_3p051757812En05_0 0 1.99997
 /begin AXIS_DESCR FIX_AXIS NO_INPUT_QUANTITY CM_IDENTITY 5 0 4 FIX_AXIS_PAR_DIST 0 1 5 /end AXIS_DESCR
/end CHARACTERISTIC
/begin CHARACTERISTIC FQTEPT "podtverzhdena damos addr 0x1BE3F | characteristic line: for fuel-tank underpressure limitation" CURVE 0x1BE3F RL_GRID_SBYTE 0 CM_0p125_0 -16 15.875
 /begin AXIS_DESCR FIX_AXIS NO_INPUT_QUANTITY CM_IDENTITY 6 0 5 FIX_AXIS_PAR_DIST 0 1 6 /end AXIS_DESCR
/end CHARACTERISTIC
/begin CHARACTERISTIC DIAG_FLAGS "podtverzhdena | Tablica flagov diagnostiki (znacheniya 0/1). V proshivke csok chast edinic zamenena nulyami otnositelno stoka -- otklyucheny proverki." VALUE 0x10009 RL_GRID_UBYTE 0 CM_IDENTITY -0 255 /end CHARACTERISTIC
/begin CHARACTERISTIC DNMAXH "podtverzhdena | Gisterezis zhestkogo ogranicheniya: toplivo vozvraschaetsya na NMAX minus 120 ob/min. Odinakov vo vseh vosmi proshivkah." VALUE 0x14BB2 RL_GRID_UWORD 0 CM_0p25_0_obmin -0 16383.8 /end CHARACTERISTIC
/begin CHARACTERISTIC NMAX "podtverzhdena | Otsechka. Znacheniya sovpali s tem, chto nazyval kalibrovschik (6800 protiv 7700)." VALUE 0x14BB4 RL_GRID_UWORD 0 CM_0p25_0_obmin -0 16383.8 /end CHARACTERISTIC
/begin CHARACTERISTIC NMAXDV "podtverzhdena | Ogranichenie oborotov pri neispravnom signale skorosti, a ne vtoroy porog obychnoy otsechki. Kosvennoe podtverzhdenie: L podnyal NMAX do 7084 i ostavil zdes 6000 -- bud eto rabochiy pr" VALUE 0x14BB6 RL_GRID_UWORD 0 CM_0p25_0_obmin -0 16383.8 /end CHARACTERISTIC
/begin CHARACTERISTIC NMXDKPU "podtverzhdena | Predel pri neizvestnom ili oshibochnom polozhenii drosselya, limp-houm. 1200 vo vseh proshivkah." VALUE 0x14BB8 RL_GRID_UWORD 0 CM_0p25_0_obmin -0 16383.8 /end CHARACTERISTIC
/begin CHARACTERISTIC TNMAXDV "podtverzhdena | Zaderzhka vklyucheniya ogranicheniya po NMAXDV. 3 s vo vseh proshivkah." VALUE 0x14BBA RL_GRID_UWORD 0 CM_0p01_0_s -0 655.35 /end CHARACTERISTIC
/begin CHARACTERISTIC DTC_CODES "adres podtverzhden | fault code table, 144 words, four entries per code" CURVE 0x1653A RL_GRID_UWORD 0 CM_IDENTITY -0 65535
 /begin AXIS_DESCR FIX_AXIS NO_INPUT_QUANTITY CM_IDENTITY 144 0 143 FIX_AXIS_PAR_DIST 0 1 144 /end AXIS_DESCR
/end CHARACTERISTIC
/begin CHARACTERISTIC WDKSLN "podtverzhdena | Throttle valve angle threshold for idle detection" CURVE 0x18FD1 RL_GRID_UBYTE 0 CM_0p392157_0 -0 100
 /begin AXIS_DESCR COM_AXIS NO_INPUT_QUANTITY CM_40_0_rpm 6 0 10200 AXIS_PTS_REF AX_18FCB_Y /end AXIS_DESCR
/end CHARACTERISTIC
/begin CHARACTERISTIC WDKVLN_0 "podtverzhdena | Throttle valve angle threshold for full load detection, variant 0" CURVE 0x18FDE RL_GRID_UBYTE 0 CM_0p392157_0 -0 100
 /begin AXIS_DESCR COM_AXIS NO_INPUT_QUANTITY CM_40_0_rpm 6 0 10200 AXIS_PTS_REF AX_18FD8_Y /end AXIS_DESCR
/end CHARACTERISTIC
/begin CHARACTERISTIC WDKVLN_1 "podtverzhdena | Throttle valve angle threshold for full load detection, variant 1" CURVE 0x18FEB RL_GRID_UBYTE 0 CM_0p392157_0 -0 100
 /begin AXIS_DESCR COM_AXIS NO_INPUT_QUANTITY CM_40_0_rpm 6 0 10200 AXIS_PTS_REF AX_18FE5_Y /end AXIS_DESCR
/end CHARACTERISTIC
/begin CHARACTERISTIC KLLAMFA_0 "podtverzhdena | full load enrichment, variant 0" CURVE 0x19562 RL_GRID_UBYTE 0 CM_0p0078125_0 -0 1.99219
 /begin AXIS_DESCR COM_AXIS NO_INPUT_QUANTITY CM_40_0_rpm 6 0 10200 AXIS_PTS_REF AX_1955C_Y /end AXIS_DESCR
/end CHARACTERISTIC
/begin CHARACTERISTIC KLLAMFA_1 "podtverzhdena | full load enrichment, variant 1" CURVE 0x1956F RL_GRID_UBYTE 0 CM_0p0078125_0 -0 1.99219
 /begin AXIS_DESCR COM_AXIS NO_INPUT_QUANTITY CM_40_0_rpm 6 0 10200 AXIS_PTS_REF AX_19569_Y /end AXIS_DESCR
/end CHARACTERISTIC
/begin CHARACTERISTIC TV_LAMFA "adres podtverzhden | delay before full load enrichment, per variant (imya nashe: damos etu paru ne nazyvaet)" CURVE 0x1B894 RL_GRID_UBYTE 0 CM_IDENTITY -0 255
 /begin AXIS_DESCR FIX_AXIS NO_INPUT_QUANTITY CM_IDENTITY 2 0 1 FIX_AXIS_PAR_DIST 0 1 2 /end AXIS_DESCR
/end CHARACTERISTIC
/begin CHARACTERISTIC RLLRTMO "podtverzhdena | char. line on tmot, upper rl control threshold for upstream lambda" CURVE 0x18AC9 RL_GRID_UBYTE 0 CM_0p75_0 -0 191.25
 /begin AXIS_DESCR COM_AXIS NO_INPUT_QUANTITY CM_0p75_48_GradC 8 0 143.25 AXIS_PTS_REF AX_18AC1_Y /end AXIS_DESCR
/end CHARACTERISTIC
/begin CHARACTERISTIC RLLRUN "podtverzhdena | char.line above nmot, lower rL control limit" CURVE 0x18ADA RL_GRID_UBYTE 0 CM_0p75_0 -0 191.25
 /begin AXIS_DESCR COM_AXIS NO_INPUT_QUANTITY CM_40_0_rpm 8 0 10200 AXIS_PTS_REF AX_18AD2_Y /end AXIS_DESCR
/end CHARACTERISTIC
/begin CHARACTERISTIC TARAU "podtverzhdena | air temperature threshold for closed loop lambda switch" VALUE 0x18AE2 RL_GRID_UBYTE 0 CM_0p75_48_GradC -48 143.25 /end CHARACTERISTIC
/begin CHARACTERISTIC TASHS "podtverzhdena | intake air temp threshold triggering TLRHS blocking time" VALUE 0x18AE3 RL_GRID_UBYTE 0 CM_0p75_48_GradC -48 143.25 /end CHARACTERISTIC
/begin CHARACTERISTIC TLRHS "podtverzhdena | blocking time of lambda control during hot start" VALUE 0x18AE4 RL_GRID_UBYTE 0 CM_0p1_0_s -0 25.5 /end CHARACTERISTIC
/begin CHARACTERISTIC TMRA1 "podtverzhdena | cut-out condition, idle-speed switch = 0" VALUE 0x18AE5 RL_GRID_UBYTE 0 CM_0p75_48_GradC -48 143.25 /end CHARACTERISTIC
/begin CHARACTERISTIC TMRA2 "adres podtverzhden | cut-out condition, idle-speed switch = 1" VALUE 0x18AE6 RL_GRID_UBYTE 0 CM_0p75_48_GradC -48 143.25 /end CHARACTERISTIC
/begin CHARACTERISTIC TATELL "podtverzhdena | tans-threshold for canister purge control with B_ll = 1" VALUE 0x19535 RL_GRID_UBYTE 0 CM_0p75_48_GradC -48 143.25 /end CHARACTERISTIC
/begin CHARACTERISTIC TMSKLH "podtverzhdena | engine temperature threshold for short initial phase LRA when engin hot" VALUE 0x19536 RL_GRID_UBYTE 0 CM_0p75_48_GradC -48 143.25 /end CHARACTERISTIC
/begin CHARACTERISTIC TMSNOGA "podtverzhdena | threshold tms for endless purge control, if mixture adaptation without error" VALUE 0x19537 RL_GRID_UBYTE 0 CM_0p75_48_GradC -48 143.25 /end CHARACTERISTIC
/begin CHARACTERISTIC FRAOMN "podtverzhdena | lower limit of correction factor frao" VALUE 0x19543 RL_GRID_UBYTE 0 CM_0p0078125_0 -0 1.99219 /end CHARACTERISTIC
/begin CHARACTERISTIC FRAOMX "podtverzhdena | upper limit of correction factor frao" VALUE 0x19544 RL_GRID_UBYTE 0 CM_0p0078125_0 -0 1.99219 /end CHARACTERISTIC
/begin CHARACTERISTIC FRAORN "podtverzhdena | reduced lower threshold for frao correction" VALUE 0x19545 RL_GRID_UBYTE 0 CM_0p0078125_0 -0 1.99219 /end CHARACTERISTIC
/begin CHARACTERISTIC FRAORX "podtverzhdena | reduced upper threshold for trao correction" VALUE 0x19546 RL_GRID_UBYTE 0 CM_0p0078125_0 -0 1.99219 /end CHARACTERISTIC
/begin CHARACTERISTIC FRATMN "podtverzhdena | lower limit of correction factor frat" VALUE 0x19547 RL_GRID_UBYTE 0 CM_0p0078125_0 -0 1.99219 /end CHARACTERISTIC
/begin CHARACTERISTIC FRATMX "podtverzhdena | upper limit of correction factor frat" VALUE 0x19548 RL_GRID_UBYTE 0 CM_0p0078125_0 -0 1.99219 /end CHARACTERISTIC
/begin CHARACTERISTIC FRAUMN "podtverzhdena | lower limit of correction factor frau" VALUE 0x19549 RL_GRID_UBYTE 0 CM_0p0078125_0 -0 1.99219 /end CHARACTERISTIC
/begin CHARACTERISTIC FRAUMX "podtverzhdena | upper limit of correction factor frau" VALUE 0x1954A RL_GRID_UBYTE 0 CM_0p0078125_0 -0 1.99219 /end CHARACTERISTIC
/begin CHARACTERISTIC FRAURN "podtverzhdena | reduced lower threshold for frau correction" VALUE 0x1954B RL_GRID_UBYTE 0 CM_0p0078125_0 -0 1.99219 /end CHARACTERISTIC
/begin CHARACTERISTIC FRAURX "podtverzhdena | reduced upper threshold fpr frau correction" VALUE 0x1954C RL_GRID_UBYTE 0 CM_0p0078125_0 -0 1.99219 /end CHARACTERISTIC
/begin CHARACTERISTIC NO1 "podtverzhdena | upper engine-speed threshold range 1" VALUE 0x1954D RL_GRID_UBYTE 0 CM_40_0_Upm -0 10200 /end CHARACTERISTIC
/begin CHARACTERISTIC NOLRA "podtverzhdena | codeword for release of adaptation" VALUE 0x1954E RL_GRID_UBYTE 0 CM_IDENTITY -0 255 /end CHARACTERISTIC
/begin CHARACTERISTIC NU3 "podtverzhdena | lower engine-speed threshold range 3" VALUE 0x1954F RL_GRID_UBYTE 0 CM_40_0_Upm -0 10200 /end CHARACTERISTIC
/begin CHARACTERISTIC RLO2 "podtverzhdena | upper load threshold of range 2" VALUE 0x19550 RL_GRID_UBYTE 0 CM_0p75_0 -0 191.25 /end CHARACTERISTIC
/begin CHARACTERISTIC RLO3 "podtverzhdena | upper load-signal threshold range 3" VALUE 0x19551 RL_GRID_UBYTE 0 CM_0p75_0 -0 191.25 /end CHARACTERISTIC
/begin CHARACTERISTIC RLO3AC "podtverzhdena | upper load-signal threshold range 3 with compressor" VALUE 0x19552 RL_GRID_UBYTE 0 CM_0p75_0 -0 191.25 /end CHARACTERISTIC
/begin CHARACTERISTIC RLU2 "podtverzhdena | lower load-signal threshold range 2" VALUE 0x19553 RL_GRID_UBYTE 0 CM_0p75_0 -0 191.25 /end CHARACTERISTIC
/begin CHARACTERISTIC RLU2AC "podtverzhdena | lower load-signal threshold range 2 with compressor" VALUE 0x19554 RL_GRID_UBYTE 0 CM_0p75_0 -0 191.25 /end CHARACTERISTIC
/begin CHARACTERISTIC RLU3 "podtverzhdena | lower load-signal threshold range 3" VALUE 0x19555 RL_GRID_UBYTE 0 CM_0p75_0 -0 191.25 /end CHARACTERISTIC
/begin CHARACTERISTIC RLU4 "podtverzhdena | lower load threshold of the upper multiplicative section" VALUE 0x19556 RL_GRID_UBYTE 0 CM_0p75_0 -0 191.25 /end CHARACTERISTIC
/begin CHARACTERISTIC TMFRATMN "podtverzhdena | minimum temperature at it ftklra_w is one" VALUE 0x19557 RL_GRID_UBYTE 0 CM_0p75_48_GradC -48 143.25 /end CHARACTERISTIC
/begin CHARACTERISTIC TMFRATUB "podtverzhdena | upper temperature threshold at it ftklra_w is constant" VALUE 0x19558 RL_GRID_UBYTE 0 CM_0p75_48_GradC -48 143.25 /end CHARACTERISTIC
/begin CHARACTERISTIC CWPKAPP "podtverzhdena | code word application of reference pressure for fuel-pressure controller" VALUE 0x19559 RL_GRID_UBYTE 0 CM_IDENTITY -0 255 /end CHARACTERISTIC
/begin CHARACTERISTIC KRKTE "podtverzhdena | conversion from relative fuel mass rk into effective injection time te" VALUE 0x1955A RL_GRID_UBYTE 0 CM_0p001779359431_0_ms -0 0.453737 /end CHARACTERISTIC
/begin CHARACTERISTIC CWLAMBTS "podtverzhdena | code word: lambda component protection" VALUE 0x19575 RL_GRID_UBYTE 0 CM_IDENTITY -0 255 /end CHARACTERISTIC
/begin CHARACTERISTIC KFFDLBTS__kandidat "podtverzhdena |" MAP 0x19576 RL_GRID_UBYTE 0 CM_0p0078125_0 -0 1.99219
 /begin AXIS_DESCR FIX_AXIS NO_INPUT_QUANTITY CM_IDENTITY 12 0 11 FIX_AXIS_PAR_DIST 0 1 12 /end AXIS_DESCR
 /begin AXIS_DESCR FIX_AXIS NO_INPUT_QUANTITY CM_IDENTITY 16 0 15 FIX_AXIS_PAR_DIST 0 1 16 /end AXIS_DESCR
/end CHARACTERISTIC
/begin CHARACTERISTIC TVLBTS "podtverzhdena | 0 vo vseh vosmi proshivkah, dopolnitelnoy zaderzhki net" VALUE 0x196F6 RL_GRID_UBYTE 0 CM_IDENTITY -0 255 /end CHARACTERISTIC
/begin CHARACTERISTIC DKROKMX "podtverzhdena | maximum offset-compensation value" VALUE 0x1163B RL_GRID_UBYTE 0 CM_0p01953125_0_V -0 4.98047 /end CHARACTERISTIC
/begin CHARACTERISTIC FKEFMC "podtverzhdena | correction factor for knock detection thresh. in case of change of filter frequ." VALUE 0x1163C RL_GRID_UBYTE 0 CM_0p0625_0 -0 15.9375 /end CHARACTERISTIC
/begin CHARACTERISTIC FKELDY "podtverzhdena | correction factor for knock detection threshold during load dynamics" VALUE 0x1163D RL_GRID_UBYTE 0 CM_0p0625_0 -0 15.9375 /end CHARACTERISTIC
/begin CHARACTERISTIC FKENDY "podtverzhdena | correction factor for knock detection threshold with engine-speed dynamics" VALUE 0x1163E RL_GRID_UBYTE 0 CM_0p0625_0 -0 15.9375 /end CHARACTERISTIC
/begin CHARACTERISTIC FKRFTPFMC "podtverzhdena | correction factor of low pass characteristic at switch of filter mean frequency" VALUE 0x1163F RL_GRID_UBYTE 0 CM_0p0078125_0 -0 1.99219 /end CHARACTERISTIC
/begin CHARACTERISTIC KRFTP1 "podtverzhdena | low pass characteristic normal" VALUE 0x11640 RL_GRID_UBYTE 0 CM_IDENTITY -0 255 /end CHARACTERISTIC
/begin CHARACTERISTIC KRFTP2 "podtverzhdena | low pass characteristic at engine speed dynamics" VALUE 0x11641 RL_GRID_UBYTE 0 CM_IDENTITY -0 255 /end CHARACTERISTIC
/begin CHARACTERISTIC KRFTP3 "podtverzhdena | low pass characteristic at load dynamic" VALUE 0x11642 RL_GRID_UBYTE 0 CM_IDENTITY -0 255 /end CHARACTERISTIC
/begin CHARACTERISTIC KRKFKS "podtverzhdena | selected knock detection threshold, if missing cylinder one detection" VALUE 0x11643 RL_GRID_UBYTE 0 CM_IDENTITY -0 255 /end CHARACTERISTIC
/begin CHARACTERISTIC KRVST "podtverzhdena | gain after cranking" VALUE 0x11644 RL_GRID_UBYTE 0 CM_IDENTITY -0 255 /end CHARACTERISTIC
/begin CHARACTERISTIC REFINI "podtverzhdena | initial value for reference level if knock control enabled" VALUE 0x11645 RL_GRID_UBYTE 0 CM_0p01953125_0_V -0 4.98047 /end CHARACTERISTIC
/begin CHARACTERISTIC KRDWA "podtverzhdena | knock control difference current ignition angle to adaption map" VALUE 0x1164D RL_GRID_UBYTE 0 CM_0p75_0_GradKW -0 191.25 /end CHARACTERISTIC
/begin CHARACTERISTIC KRDWKLA "podtverzhdena | The SV-learning value for KR adaption after knocking detected" VALUE 0x1164E RL_GRID_UBYTE 0 CM_n0p75_0_gradKW -191.25 -0 /end CHARACTERISTIC
/begin CHARACTERISTIC KRDWSA "podtverzhdena | The FV-learning value for KR adation when wkra-wkr > KRDWA" VALUE 0x1164F RL_GRID_UBYTE 0 CM_0p75_0_GradKW -0 191.25 /end CHARACTERISTIC
/begin CHARACTERISTIC KRLMDY "podtverzhdena | Read if change of load range: always or only if dynamic active" VALUE 0x11650 RL_GRID_UBYTE 0 CM_IDENTITY -0 255 /end CHARACTERISTIC
/begin CHARACTERISTIC KRNMDY "podtverzhdena | Read if change of speed range: allways or only if dynamic active" VALUE 0x11651 RL_GRID_UBYTE 0 CM_IDENTITY -0 255 /end CHARACTERISTIC
/begin CHARACTERISTIC KSZA "podtverzhdena | number of knock sensor" VALUE 0x11652 RL_GRID_UBYTE 0 CM_IDENTITY -0 255 /end CHARACTERISTIC
/begin CHARACTERISTIC DYADS "podtverzhdena | add. retarding per cycle through adapt. dynamics" VALUE 0x11663 RL_GRID_UBYTE 0 CM_n0p75_0_gradKW -191.25 -0 /end CHARACTERISTIC
/begin CHARACTERISTIC DYAFVS "podtverzhdena | advance step for deactivation of dynamic response" VALUE 0x11664 RL_GRID_UBYTE 0 CM_0p75_0_GradKW -0 191.25 /end CHARACTERISTIC
/begin CHARACTERISTIC DYAVF "podtverzhdena | deactivation period for dynamics retardation" VALUE 0x11665 RL_GRID_UBYTE 0 CM_IDENTITY -0 255 /end CHARACTERISTIC
/begin CHARACTERISTIC FKELDYA "podtverzhdena | Corrective factor for knock detection threshold for adaptation of load dynamic" VALUE 0x11666 RL_GRID_UBYTE 0 CM_0p0625_0 -0 15.9375 /end CHARACTERISTIC
/begin CHARACTERISTIC PZWKRA "podtverzhdena | percentage frequency of ignition angle output by KC during dyn. adaption" VALUE 0x11667 RL_GRID_UBYTE 0 CM_0p390625_0 -0 99.6094 /end CHARACTERISTIC
/begin CHARACTERISTIC TMDYNA "podtverzhdena | engine temperature threshold to enable load dynamic adaptation" VALUE 0x11668 RL_GRID_UBYTE 0 CM_0p75_48_GradC -48 143.25 /end CHARACTERISTIC
/begin CHARACTERISTIC CWDKRNT "podtverzhdena | code word: kc-diagnosis integrator gradient" VALUE 0x11669 RL_GRID_UBYTE 0 CM_IDENTITY -0 255 /end CHARACTERISTIC
/begin CHARACTERISTIC CWDKROF "podtverzhdena | code word: kc-diagnosis reset value" VALUE 0x1166A RL_GRID_UBYTE 0 CM_IDENTITY -0 255 /end CHARACTERISTIC
/begin CHARACTERISTIC DKROKU "podtverzhdena | lower rpm-limit for determination of offset-compensation-value" VALUE 0x1166B RL_GRID_UBYTE 0 CM_40_0_Upm -0 10200 /end CHARACTERISTIC
/begin CHARACTERISTIC KRFHT "podtverzhdena | error frequency, test pulse" VALUE 0x1166C RL_GRID_UBYTE 0 CM_IDENTITY -0 255 /end CHARACTERISTIC
/begin CHARACTERISTIC UDKRGOFS "podtverzhdena | voltage threshold for DIA/KR basic offset amplifier" VALUE 0x1166D RL_GRID_UBYTE 0 CM_0p01953125_0_V -0 4.98047 /end CHARACTERISTIC
/begin CHARACTERISTIC CWDKRTP "podtverzhdena | code word: kc-diagnosis testpulse" VALUE 0x1166E RL_GRID_UBYTE 0 CM_IDENTITY -0 255 /end CHARACTERISTIC
/begin CHARACTERISTIC UDKRTP "podtverzhdena | integr.volt.thresh. f.diagn. knock eval.circ. test pulse" VALUE 0x1166F RL_GRID_UBYTE 0 CM_0p01953125_0_V -0 4.98047 /end CHARACTERISTIC
/begin CHARACTERISTIC NDSVL "podtverzhdena | full-load switch error detection / n threshold minimum" VALUE 0x11670 RL_GRID_UBYTE 0 CM_40_0_Upm -0 10200 /end CHARACTERISTIC
/begin CHARACTERISTIC QDPSLL "podtverzhdena | maximum rate of air flow for plausibility test of idle-speed switch" VALUE 0x11671 RL_GRID_UBYTE 0 CM_4_0_kgh -0 1020 /end CHARACTERISTIC
/begin CHARACTERISTIC RLDSVL "podtverzhdena | full-load switch error detection / load-signal threshold maximal" VALUE 0x11672 RL_GRID_UBYTE 0 CM_0p75_0 -0 191.25 /end CHARACTERISTIC
/begin CHARACTERISTIC KFABAK "podtverzhdena | dolya plenki dlya obogascheniya na razgone" MAP 0x193F3 RL_GRID_UBYTE 0 CM_0p00390625_0 -0 0.996094
 /begin AXIS_DESCR FIX_AXIS NO_INPUT_QUANTITY CM_IDENTITY 9 0 8 FIX_AXIS_PAR_DIST 0 1 9 /end AXIS_DESCR
 /begin AXIS_DESCR FIX_AXIS NO_INPUT_QUANTITY CM_IDENTITY 7 0 6 FIX_AXIS_PAR_DIST 0 1 7 /end AXIS_DESCR
/end CHARACTERISTIC
/begin CHARACTERISTIC KFAVAK "podtverzhdena | dolya plenki dlya obedneniya na sbrose" MAP 0x19432 RL_GRID_UBYTE 0 CM_0p00390625_0 -0 0.996094
 /begin AXIS_DESCR FIX_AXIS NO_INPUT_QUANTITY CM_IDENTITY 9 0 8 FIX_AXIS_PAR_DIST 0 1 9 /end AXIS_DESCR
 /begin AXIS_DESCR FIX_AXIS NO_INPUT_QUANTITY CM_IDENTITY 7 0 6 FIX_AXIS_PAR_DIST 0 1 7 /end AXIS_DESCR
/end CHARACTERISTIC
/begin CHARACTERISTIC KFBAKL "podtverzhdena | faktor obogascheniya na razgone, korotkaya i dlinnaya sostavlyayuschie" MAP 0x19471 RL_GRID_UBYTE 0 CM_0p0625_0 -0 15.9375
 /begin AXIS_DESCR FIX_AXIS NO_INPUT_QUANTITY CM_IDENTITY 9 0 8 FIX_AXIS_PAR_DIST 0 1 9 /end AXIS_DESCR
 /begin AXIS_DESCR FIX_AXIS NO_INPUT_QUANTITY CM_IDENTITY 7 0 6 FIX_AXIS_PAR_DIST 0 1 7 /end AXIS_DESCR
/end CHARACTERISTIC
/begin CHARACTERISTIC KFVAKL "podtverzhdena | faktor obedneniya na sbrose" MAP 0x194B0 RL_GRID_UBYTE 0 CM_0p0625_0 -0 15.9375
 /begin AXIS_DESCR FIX_AXIS NO_INPUT_QUANTITY CM_IDENTITY 9 0 8 FIX_AXIS_PAR_DIST 0 1 9 /end AXIS_DESCR
 /begin AXIS_DESCR FIX_AXIS NO_INPUT_QUANTITY CM_IDENTITY 7 0 6 FIX_AXIS_PAR_DIST 0 1 7 /end AXIS_DESCR
/end CHARACTERISTIC
/begin CHARACTERISTIC KFMIOP "podtverzhdena |" MAP 0x14A10 RL_GRID_UWORD 0 CM_0p00152588_0_otopornogomoment -0 99.9985
 /begin AXIS_DESCR COM_AXIS NO_INPUT_QUANTITY CM_0p0234375_0 11 0 1535.98 AXIS_PTS_REF SRL11_OP /end AXIS_DESCR
 /begin AXIS_DESCR COM_AXIS NO_INPUT_QUANTITY CM_40_0_rpm 16 0 10200 AXIS_PTS_REF SNM16_OP /end AXIS_DESCR
/end CHARACTERISTIC
/begin CHARACTERISTIC SRL11OPUW "podtverzhdena | ta zhe os, chto u KFZWOP" CURVE 0x14B70 RL_GRID_UWORD 0 CM_0p0234375_0 -0 1535.98
 /begin AXIS_DESCR FIX_AXIS NO_INPUT_QUANTITY CM_IDENTITY 11 0 10 FIX_AXIS_PAR_DIST 0 1 11 /end AXIS_DESCR
/end CHARACTERISTIC
/begin CHARACTERISTIC KFMIRL "podtverzhdena | trebuemoe napolnenie iz trebuemogo momenta: oboroty x moment v % daet napolnenie v %" MAP 0x14BF8 RL_GRID_UWORD 0 CM_0p0234375_0_napolneniya -0 1535.98
 /begin AXIS_DESCR COM_AXIS NO_INPUT_QUANTITY CM_0p001525878906_0_momenta 12 0 99.9985 AXIS_PTS_REF AX_14BE0_X /end AXIS_DESCR
 /begin AXIS_DESCR COM_AXIS NO_INPUT_QUANTITY CM_0p25_0_obmin 16 0 16383.8 AXIS_PTS_REF AX_14BC0_Y /end AXIS_DESCR
/end CHARACTERISTIC
/begin CHARACTERISTIC KFMDS "podtverzhdena | moment mehanicheskih poter: oboroty x napolnenie" MAP 0x15142 RL_GRID_UWORD 0 CM_0p001525878906_0_otopornogomo -0 99.9985
 /begin AXIS_DESCR COM_AXIS NO_INPUT_QUANTITY CM_0p0234375_0_napolneniya 12 0 1535.98 AXIS_PTS_REF AX_1512A_X /end AXIS_DESCR
 /begin AXIS_DESCR COM_AXIS NO_INPUT_QUANTITY CM_0p25_0_obmin 10 0 16383.8 AXIS_PTS_REF AX_15116_Y /end AXIS_DESCR
/end CHARACTERISTIC
/begin CHARACTERISTIC MDIMX "podtverzhdena | verhniy predel indicirovannogo momenta" VALUE 0x105D9 RL_GRID_UBYTE 0 CM_0p390625_0 -0 99.6094 /end CHARACTERISTIC
/begin CHARACTERISTIC CWMDAPP "podtverzhdena | kodovoe slovo: kalibrovka bez momentnoy struktury" VALUE 0x10024 RL_GRID_UBYTE 0 CM_IDENTITY -0 255 /end CHARACTERISTIC
/begin CHARACTERISTIC ETALAM "podtverzhdena | KPD po sostavu smesi: moment v zavisimosti ot lyambdy" CURVE 0x1051F RL_GRID_UBYTE 0 CM_0p5_0 -0 127.5
 /begin AXIS_DESCR FIX_AXIS NO_INPUT_QUANTITY CM_IDENTITY 10 0 9 FIX_AXIS_PAR_DIST 0 1 10 /end AXIS_DESCR
/end CHARACTERISTIC
/begin CHARACTERISTIC MDLF1 "podtverzhdena | moment na privod ventilyatora ohlazhdeniya 1" VALUE 0x10FB3 RL_GRID_UBYTE 0 CM_0p1960784314_0 -0 50 /end CHARACTERISTIC
/begin CHARACTERISTIC MDLF2 "podtverzhdena | to zhe, ventilyator 2" VALUE 0x10FB4 RL_GRID_UBYTE 0 CM_0p1960784314_0 -0 50 /end CHARACTERISTIC
/begin CHARACTERISTIC MDLFE1 "podtverzhdena | dobavka momenta pri vklyuchenii ventilyatora 1" VALUE 0x10FB5 RL_GRID_UBYTE 0 CM_0p1960784314_0 -0 50 /end CHARACTERISTIC
/begin CHARACTERISTIC MDLFE2 "podtverzhdena | dobavka momenta pri vklyuchenii ventilyatora 2" VALUE 0x10FB6 RL_GRID_UBYTE 0 CM_0p1960784314_0 -0 50 /end CHARACTERISTIC
/begin CHARACTERISTIC KSZWE "podtverzhdena | ugol zaschity ot detonacii" VALUE 0x10ED8 RL_GRID_UBYTE 0 CM_n0p75_0_KV -191.25 -0 /end CHARACTERISTIC
/begin CHARACTERISTIC CWSAWE "podtverzhdena | kodovoe slovo: otsechka topliva -- vozvrat" VALUE 0x10ED9 RL_GRID_UBYTE 0 CM_IDENTITY -0 255 /end CHARACTERISTIC
/begin CHARACTERISTIC DNSAH "podtverzhdena | delta oborotov otsechki, verhnyaya, otnositelno oborotov vozvrata" VALUE 0x10EDA RL_GRID_UBYTE 0 CM_40_0_obmin -0 10200 /end CHARACTERISTIC
/begin CHARACTERISTIC DNSAL "podtverzhdena | delta oborotov otsechki, nizhnyaya, otnositelno oborotov vozvrata" VALUE 0x10EDB RL_GRID_UBYTE 0 CM_40_0_obmin -0 10200 /end CHARACTERISTIC
/begin CHARACTERISTIC DNSATIP "podtverzhdena | podem oborotov otsechki pri tychke gazom" VALUE 0x10EDC RL_GRID_UBYTE 0 CM_40_0_obmin -0 10200 /end CHARACTERISTIC
/begin CHARACTERISTIC DNSLL "podtverzhdena | gisterezis vozvrata topliva na holostom" VALUE 0x10EDD RL_GRID_UBYTE 0 CM_40_0_obmin -0 10200 /end CHARACTERISTIC
/begin CHARACTERISTIC DNVSA "podtverzhdena | podem oborotov otsechki na maloy skorosti" VALUE 0x10EDE RL_GRID_UBYTE 0 CM_40_0_obmin -0 10200 /end CHARACTERISTIC
/begin CHARACTERISTIC DNWEELLS "podtverzhdena | delta vozvrata pri otkaze klapana HH" VALUE 0x10EDF RL_GRID_UBYTE 0 CM_40_0_obmin -0 10200 /end CHARACTERISTIC
/begin CHARACTERISTIC DNWEK "podtverzhdena | delta vozvrata pri vklyuchennom kondicionere" VALUE 0x10EE0 RL_GRID_UBYTE 0 CM_40_0_obmin -0 10200 /end CHARACTERISTIC
/begin CHARACTERISTIC DVSA "podtverzhdena | delta skorosti dlya podema oborotov otsechki" VALUE 0x10EE1 RL_GRID_UBYTE 0 CM_IDENTITY -0 255 /end CHARACTERISTIC
/begin CHARACTERISTIC ENSAKHG "podtverzhdena | razreshenie otsechki po peredache pri progreve katalizatora" VALUE 0x10EE2 RL_GRID_UBYTE 0 CM_IDENTITY -0 255 /end CHARACTERISTIC
/begin CHARACTERISTIC TKATSA "podtverzhdena | porog temperatury katalizatora dlya otsechki" VALUE 0x10EE3 RL_GRID_UBYTE 0 CM_5_n50_C 50 1325 /end CHARACTERISTIC
/begin CHARACTERISTIC VSAA "podtverzhdena | porog skorosti dlya podema oborotov otsechki" VALUE 0x10EE4 RL_GRID_UBYTE 0 CM_IDENTITY -0 255 /end CHARACTERISTIC
/begin CHARACTERISTIC FRKAP "podtverzhdena | globalnyy mnozhitel otnositelnoy massy topliva" VALUE 0x190CD RL_GRID_UBYTE 0 CM_0p0078125_0 -0 1.99219 /end CHARACTERISTIC
/begin CHARACTERISTIC TSTEAA "podtverzhdena | inhibit time after condition B_te (canister purge active)" VALUE 0x1893F RL_GRID_UBYTE 0 CM_0p1_0_s -0 25.5 /end CHARACTERISTIC
/begin CHARACTERISTIC TVLRHMN "podtverzhdena | lower limit for tv-correction" VALUE 0x18940 RL_GRID_UBYTE 0 CM_0p01_0_s -0 2.55 /end CHARACTERISTIC
/begin CHARACTERISTIC TVLRHMX "podtverzhdena | upper limit for tv-correction" VALUE 0x18941 RL_GRID_UBYTE 0 CM_0p01_0_s -0 2.55 /end CHARACTERISTIC
/begin CHARACTERISTIC ANZDYNSH "podtverzhdena | Amount of dynamic measurement for swinging check of sensor post cat" VALUE 0x18942 RL_GRID_UBYTE 0 CM_IDENTITY -0 255 /end CHARACTERISTIC
/begin CHARACTERISTIC CWDLSAHK "podtverzhdena | code word for test aging of O2-sensor post cat" VALUE 0x18943 RL_GRID_UBYTE 0 CM_IDENTITY -0 255 /end CHARACTERISTIC
/begin CHARACTERISTIC TABGSTG "podtverzhdena | threshold for exhaust temperature dynamic-measuring" VALUE 0x18944 RL_GRID_UBYTE 0 CM_5_50_GradC -50 1225 /end CHARACTERISTIC
/begin CHARACTERISTIC TFRMB "podtverzhdena | time delay for detect. the mean value of lamda control factor within thresholds" VALUE 0x18945 RL_GRID_UBYTE 0 CM_0p1_0_s -0 25.5 /end CHARACTERISTIC
/begin CHARACTERISTIC TLLASH "podtverzhdena | time delay for reset lamlash_w if lamsons_w is not lamlash_w" VALUE 0x18946 RL_GRID_UBYTE 0 CM_0p1_0_s -0 25.5 /end CHARACTERISTIC
/begin CHARACTERISTIC TSALASH "podtverzhdena | Time after fuel cut-off for the checking of the sensor downstream catalyst" VALUE 0x18947 RL_GRID_UBYTE 0 CM_0p1_0_s -0 25.5 /end CHARACTERISTIC
/begin CHARACTERISTIC TUSCHUB "podtverzhdena | Delay time for interference peaks at thrust detection of the rear oxygen sensor" VALUE 0x18948 RL_GRID_UBYTE 0 CM_0p1_0_s -0 25.5 /end CHARACTERISTIC
/begin CHARACTERISTIC TUSHSMIN "podtverzhdena | Minimum time for measuring the gradient for enable filter" VALUE 0x18949 RL_GRID_UBYTE 0 CM_0p1_0_s -0 25.5 /end CHARACTERISTIC
/begin CHARACTERISTIC TUSSA "podtverzhdena | delay time after crossing the control threshold downstream cat" VALUE 0x1894A RL_GRID_UBYTE 0 CM_0p1_0_s -0 25.5 /end CHARACTERISTIC
/begin CHARACTERISTIC USHLEAN "podtverzhdena | Threshold for lean volt. for reset dynamic measurement of sensor downstream cat." VALUE 0x1894B RL_GRID_UBYTE 0 CM_0p005215686275_0p2_V -0.2 1.13 /end CHARACTERISTIC
/begin CHARACTERISTIC USHRICH "podtverzhdena | Threshold for rich volt. for valid dyn. measurement of sensor downstream cat." VALUE 0x1894C RL_GRID_UBYTE 0 CM_0p005215686275_0p2_V -0.2 1.13 /end CHARACTERISTIC
/begin CHARACTERISTIC USHSTGMX "podtverzhdena | Value for maximum gradient for initial value of filter" VALUE 0x1894D RL_GRID_UBYTE 0 CM_0p52_0_mVms -0 132.6 /end CHARACTERISTIC
/begin CHARACTERISTIC USHSTSOLL "podtverzhdena | Threshold for permitted gradient of the sensor voltage downstream catalyst" VALUE 0x1894E RL_GRID_UBYTE 0 CM_0p52_0_mVms -0 132.6 /end CHARACTERISTIC
/begin CHARACTERISTIC USSCHUB "podtverzhdena | Threshold for sensor voltage downstream catalyst after fuel cut-off" VALUE 0x1894F RL_GRID_UBYTE 0 CM_0p005215686275_0p2_V -0.2 1.13 /end CHARACTERISTIC
/begin CHARACTERISTIC CWGGLSV "podtverzhdena | Code word for Ri-measurement for O2sensor pre cat (not fully heated)" VALUE 0x18950 RL_GRID_UBYTE 0 CM_IDENTITY -0 255 /end CHARACTERISTIC
/begin CHARACTERISTIC ADKATNF "podtverzhdena | scaling factor for signal amplitude of the sensor resp. of the catalyst stress" VALUE 0x18951 RL_GRID_UBYTE 0 CM_0p09362_0_1V -0 23.8731 /end CHARACTERISTIC
/begin CHARACTERISTIC AHKATMN "podtverzhdena | threshold value catalyst good, AHKAT < AHKATMN" VALUE 0x18952 RL_GRID_UBYTE 0 CM_0p00390625_0 -0 0.996094 /end CHARACTERISTIC
/begin CHARACTERISTIC AHKATS "podtverzhdena | threshold value for sum AHKAT,AHKAT2 (stereo)" VALUE 0x18953 RL_GRID_UBYTE 0 CM_0p0078125_0 -0 1.99219 /end CHARACTERISTIC
/begin CHARACTERISTIC AHKATSB "podtverzhdena | threshold value for error of adding range (stereo)" VALUE 0x18954 RL_GRID_UBYTE 0 CM_0p00390625_0 -0 0.996094 /end CHARACTERISTIC
/begin CHARACTERISTIC AHKTMXT "podtverzhdena | threshold value catalyst defect at tester's request" VALUE 0x18955 RL_GRID_UBYTE 0 CM_0p00390625_0 -0 0.996094 /end CHARACTERISTIC
/begin CHARACTERISTIC APEKTDX "podtverzhdena | max. number of tests with error result" VALUE 0x18956 RL_GRID_UBYTE 0 CM_IDENTITY -0 255 /end CHARACTERISTIC
/begin CHARACTERISTIC AVKATFS "podtverzhdena | setting value for AVKATF in case of powerfail" VALUE 0x18957 RL_GRID_UBYTE 0 CM_0p00390625_0 -0 0.996094 /end CHARACTERISTIC
/begin CHARACTERISTIC CDKATLK "podtverzhdena | code word for B_lrka active" VALUE 0x18958 RL_GRID_UBYTE 0 CM_IDENTITY -0 255 /end CHARACTERISTIC
/begin CHARACTERISTIC DKATCW "podtverzhdena | single run resp. initialization of the DKAT function" VALUE 0x18959 RL_GRID_UBYTE 0 CM_IDENTITY -0 255 /end CHARACTERISTIC
/begin CHARACTERISTIC DRLKTDP "podtverzhdena | Threshold for engine load change" VALUE 0x1895A RL_GRID_UBYTE 0 CM_0p75_0 -0 191.25 /end CHARACTERISTIC
/begin CHARACTERISTIC DRLKTDPT "podtverzhdena | Threshold for engine load change at tester's request" VALUE 0x1895B RL_GRID_UBYTE 0 CM_0p75_0 -0 191.25 /end CHARACTERISTIC
/begin CHARACTERISTIC FALRKTD "podtverzhdena | amplification factor for amplitude of lambda controller" VALUE 0x1895C RL_GRID_UBYTE 0 CM_0p03125_0 -0 7.96875 /end CHARACTERISTIC
/begin CHARACTERISTIC FALRKTT "podtverzhdena | amplification factor for amplitude of lambda controller at tester mode" VALUE 0x1895D RL_GRID_UBYTE 0 CM_0p03125_0 -0 7.96875 /end CHARACTERISTIC
/begin CHARACTERISTIC KATBFMNT "podtverzhdena | threshold value for small catalyst stress at tester's request" VALUE 0x1895E RL_GRID_UBYTE 0 CM_0p00390625_0 -0 0.996094 /end CHARACTERISTIC
/begin CHARACTERISTIC KATBFN "podtverzhdena | standardized mean value of the sensor amplitude" VALUE 0x1895F RL_GRID_UBYTE 0 CM_0p00390625_0 -0 0.996094 /end CHARACTERISTIC
/begin CHARACTERISTIC KATBFNM "podtverzhdena | scaling factor multiplicative for catalyst stress" VALUE 0x18960 RL_GRID_UBYTE 0 CM_0p005215686275_0_V -0 1.33 /end CHARACTERISTIC
/begin CHARACTERISTIC KATBFNP "podtverzhdena | scaling factor additive for catalyst stress" VALUE 0x18961 RL_GRID_UBYTE 0 CM_0p005215686275_0_V -0 1.33 /end CHARACTERISTIC
/begin CHARACTERISTIC KATBFSX "podtverzhdena | maximum integrator value for stop condition" VALUE 0x18962 RL_GRID_UBYTE 0 CM_0p0078125_0 -0 1.99219 /end CHARACTERISTIC
/begin CHARACTERISTIC KATBSG "podtverzhdena | catalyst storage value for catalyst stress" VALUE 0x18963 RL_GRID_UBYTE 0 CM_0p8695652174_0_mg -0 221.739 /end CHARACTERISTIC
/begin CHARACTERISTIC KATBSH "podtverzhdena | offset for lambda control slightly in the rich area" VALUE 0x18964 RL_GRID_UBYTE 0 CM_0p8695652174_0_mgs -0 221.739 /end CHARACTERISTIC
/begin CHARACTERISTIC KATBSHG "podtverzhdena | limitation factor of model lambda-offset due to sensor mean values" VALUE 0x18965 RL_GRID_UBYTE 0 CM_0p00390625_0 -0 0.996094 /end CHARACTERISTIC
/begin CHARACTERISTIC NDKTSOT "podtverzhdena | upper engine speed limit for function request" VALUE 0x18966 RL_GRID_UBYTE 0 CM_40_0_Upm -0 10200 /end CHARACTERISTIC
/begin CHARACTERISTIC NDKTSUT "podtverzhdena | lower engine speed limit for function request" VALUE 0x18967 RL_GRID_UBYTE 0 CM_40_0_Upm -0 10200 /end CHARACTERISTIC
/begin CHARACTERISTIC NKTDX "podtverzhdena | Maximum speed for DKAT calculation" VALUE 0x18968 RL_GRID_UBYTE 0 CM_40_0_Upm -0 10200 /end CHARACTERISTIC
/begin CHARACTERISTIC RLDKTOT "podtverzhdena | upper load limit for function request" VALUE 0x18969 RL_GRID_UBYTE 0 CM_0p75_0 -0 191.25 /end CHARACTERISTIC
/begin CHARACTERISTIC RLDKTUT "podtverzhdena | lower load limit for function request" VALUE 0x1896A RL_GRID_UBYTE 0 CM_0p75_0 -0 191.25 /end CHARACTERISTIC
/begin CHARACTERISTIC TMAXKAT "podtverzhdena | maximum catalyst temp. for active diagnosis" VALUE 0x1896B RL_GRID_UBYTE 0 CM_5_50_GradC -50 1225 /end CHARACTERISTIC
/begin CHARACTERISTIC TMINKAT "podtverzhdena | minimum catalyst temperature for monitoring" VALUE 0x1896C RL_GRID_UBYTE 0 CM_5_50_GradC -50 1225 /end CHARACTERISTIC
/begin CHARACTERISTIC TMNKATT "podtverzhdena | minimum catalyst temperature for monitoring during tester mode" VALUE 0x1896D RL_GRID_UBYTE 0 CM_5_50_GradC -50 1225 /end CHARACTERISTIC
/begin CHARACTERISTIC TMSUKTD "podtverzhdena | minimum engine start temp. for monitoring" VALUE 0x1896E RL_GRID_UBYTE 0 CM_0p75_48_GradC -48 143.25 /end CHARACTERISTIC
/begin CHARACTERISTIC TWDKATST "podtverzhdena | waiting time after stop condition for filter and integrator" VALUE 0x1896F RL_GRID_UBYTE 0 CM_0p05_0_s -0 12.75 /end CHARACTERISTIC
/begin CHARACTERISTIC TWKTDLP "podtverzhdena | delay time after parameter switch over in lambda control" VALUE 0x18970 RL_GRID_UBYTE 0 CM_0p05_0_s -0 12.75 /end CHARACTERISTIC
/begin CHARACTERISTIC ZDKATAD "podtverzhdena | filter time constant of the differentiator for signal amplitude" VALUE 0x18971 RL_GRID_UBYTE 0 CM_IDENTITY -0 255 /end CHARACTERISTIC
/begin CHARACTERISTIC ZDKATAF "podtverzhdena | time constant 'absolute value filter' for signal amplitude" VALUE 0x18972 RL_GRID_UBYTE 0 CM_IDENTITY -0 255 /end CHARACTERISTIC
/begin CHARACTERISTIC ZDKATSH "podtverzhdena | time constant low pass filter, mean sensor values" VALUE 0x18973 RL_GRID_UBYTE 0 CM_IDENTITY -0 255 /end CHARACTERISTIC
/begin CHARACTERISTIC ZDKTBD "podtverzhdena | time constant of the differentiator for RF-alternating component" VALUE 0x18974 RL_GRID_UBYTE 0 CM_IDENTITY -0 255 /end CHARACTERISTIC
/begin CHARACTERISTIC ZDKTBF "podtverzhdena | time constant for gas mixing procedure in front of catalyst" VALUE 0x18975 RL_GRID_UBYTE 0 CM_IDENTITY -0 255 /end CHARACTERISTIC
/begin CHARACTERISTIC ZKTDRL "podtverzhdena | time constant low pass filter, engine load" VALUE 0x18976 RL_GRID_UBYTE 0 CM_IDENTITY -0 255 /end CHARACTERISTIC
/begin CHARACTERISTIC PHLSNVMN "podtverzhdena | minimal normalised heating-power-diagnosis sensor pre catalyst" VALUE 0x18977 RL_GRID_UBYTE 0 CM_0p01_0 -0 2.55 /end CHARACTERISTIC
/begin CHARACTERISTIC TABGMSVU "podtverzhdena | temp. threshold from exhaust temp. modell for diagn. sensor upstream" VALUE 0x18978 RL_GRID_UBYTE 0 CM_5_50_GradC -50 1225 /end CHARACTERISTIC
/begin CHARACTERISTIC TMASO "podtverzhdena | time after fuel cut off for commen open sensor ground" VALUE 0x18979 RL_GRID_UBYTE 0 CM_0p1_0_s -0 25.5 /end CHARACTERISTIC
/begin CHARACTERISTIC TMNEB "podtverzhdena | Engine temprerature threshold for measurement of sensor shunt pre cat" VALUE 0x1897A RL_GRID_UBYTE 0 CM_0p75_48_GradC -48 143.25 /end CHARACTERISTIC
/begin CHARACTERISTIC TMSV "podtverzhdena | engine temp. threshold for recognition cold start for measuring sensor upstream" VALUE 0x1897B RL_GRID_UBYTE 0 CM_0p75_48_GradC -48 143.25 /end CHARACTERISTIC
/begin CHARACTERISTIC TMSVA "podtverzhdena | threshold for engine switch-off temp. for measuring cooling sensor upstream cat" VALUE 0x1897C RL_GRID_UBYTE 0 CM_0p75_48_GradC -48 143.25 /end CHARACTERISTIC
/begin CHARACTERISTIC TRSA "podtverzhdena | monitoring time closed-loop control (upstream CAT) -> sensor off" VALUE 0x1897D RL_GRID_UBYTE 0 CM_0p1_0_s -0 25.5 /end CHARACTERISTIC
/begin CHARACTERISTIC TUSEINV "podtverzhdena | Delay time for condition Lambda sensor ready bit" VALUE 0x1897E RL_GRID_UBYTE 0 CM_IDENTITY -0 255 /end CHARACTERISTIC
/begin CHARACTERISTIC PHLSNHMN "podtverzhdena | Heating power for adequate sensor heating" VALUE 0x1897F RL_GRID_UBYTE 0 CM_0p01_0 -0 2.55 /end CHARACTERISTIC
/begin CHARACTERISTIC THHA "podtverzhdena | off time to reduce heater power of oxygen sensor downstream cat at 13Volt" VALUE 0x18980 RL_GRID_UBYTE 0 CM_0p01_0p05_s -0.05 2.5 /end CHARACTERISTIC
/begin CHARACTERISTIC THHA2 "podtverzhdena | off time to reduce heater power of oxygen sensor2 downstream cat at 13Volt" VALUE 0x18981 RL_GRID_UBYTE 0 CM_0p01_0p05_s -0.05 2.5 /end CHARACTERISTIC
/begin CHARACTERISTIC THHAWU "podtverzhdena | Switch OFF time during power reduction of sensor heating post cat" VALUE 0x18982 RL_GRID_UBYTE 0 CM_0p01_0_s -0 2.55 /end CHARACTERISTIC
/begin CHARACTERISTIC THSHA "podtverzhdena | Verz gerungszeit f r Sonde ausreichend beheizt" VALUE 0x18983 RL_GRID_UBYTE 0 CM_0p1_0_s -0 25.5 /end CHARACTERISTIC
/begin CHARACTERISTIC THVA "podtverzhdena | off time to reduce heater power of oxygen sensor upstream cat at 13 Volt" VALUE 0x18984 RL_GRID_UBYTE 0 CM_0p01_0p05_s -0.05 2.5 /end CHARACTERISTIC
/begin CHARACTERISTIC THVA2 "podtverzhdena | off time to reduce heater power of oxygen sensor2 upstream cat at 13 Volt" VALUE 0x18985 RL_GRID_UBYTE 0 CM_0p01_0p05_s -0.05 2.5 /end CHARACTERISTIC
/begin CHARACTERISTIC THVAWU "podtverzhdena | Switch OFF time during power reduction of sensor heating pre cat" VALUE 0x18986 RL_GRID_UBYTE 0 CM_0p01_0_s -0 2.55 /end CHARACTERISTIC
/begin CHARACTERISTIC TMOHSMN "podtverzhdena | Minimum engine temperature for lambda sensor heating" VALUE 0x18987 RL_GRID_UBYTE 0 CM_0p75_48_GradC -48 143.25 /end CHARACTERISTIC
/begin CHARACTERISTIC TREHS "podtverzhdena | time for restart sensor heating" VALUE 0x18988 RL_GRID_UBYTE 0 CM_0p1_0_s -0 25.5 /end CHARACTERISTIC
/begin CHARACTERISTIC TVHSH "podtverzhdena | delay time for sensor heater downstream cut" VALUE 0x18989 RL_GRID_UBYTE 0 CM_0p1_0_s -0 25.5 /end CHARACTERISTIC
/begin CHARACTERISTIC TVHSV "podtverzhdena | delay time for sensor heater upstream cut" VALUE 0x1898A RL_GRID_UBYTE 0 CM_0p1_0_s -0 25.5 /end CHARACTERISTIC
/begin CHARACTERISTIC TVHSVMX "podtverzhdena | delay time for maximum sensor heater upstream cut" VALUE 0x1898B RL_GRID_UBYTE 0 CM_0p1_0_s -0 25.5 /end CHARACTERISTIC
/begin CHARACTERISTIC UBHS "podtverzhdena | battery voltage threshold for switching off oxygen sensor heater" VALUE 0x1898C RL_GRID_UBYTE 0 CM_0p0704_0_V -0 17.952 /end CHARACTERISTIC
/begin CHARACTERISTIC UHSN "podtverzhdena | Nominal battery voltage for lambda sensor heating" VALUE 0x1898D RL_GRID_UBYTE 0 CM_0p0704_0_V -0 17.952 /end CHARACTERISTIC
/begin CHARACTERISTIC TMTE "podtverzhdena | engine-temperature threshold for canister purge" VALUE 0x1976C RL_GRID_UBYTE 0 CM_0p75_48_GradC -48 143.25 /end CHARACTERISTIC
/begin CHARACTERISTIC FRHB "podtverzhdena | limit for lambda controller to reset Bit 'High HC-canister charge'" VALUE 0x197AB RL_GRID_UBYTE 0 CM_0p0078125_0 -0 1.99219 /end CHARACTERISTIC
/begin CHARACTERISTIC FTEADAB "podtverzhdena | Canister charge threshold for interruption of the purge phase" VALUE 0x197AC RL_GRID_UBYTE 0 CM_0p5_0 -0 127.5 /end CHARACTERISTIC
/begin CHARACTERISTIC FTEADMX "podtverzhdena | Maximum value of the canister charge (ftead)" VALUE 0x197AD RL_GRID_UBYTE 0 CM_0p5_0 -0 127.5 /end CHARACTERISTIC
/begin CHARACTERISTIC FTEFHB "podtverzhdena | Limit for flow rate of purge system to detect high concentration" VALUE 0x197AE RL_GRID_UBYTE 0 CM_0p001953125_0 -0 0.498047 /end CHARACTERISTIC
/begin CHARACTERISTIC FTEHB "podtverzhdena | Limit for purge factor to detect high concentration" VALUE 0x197AF RL_GRID_UBYTE 0 CM_0p5_0 -0 127.5 /end CHARACTERISTIC
/begin CHARACTERISTIC FUMRBRK "podtverzhdena | factor calculation of canister charge (ftead) from HC-concentration" VALUE 0x197BB RL_GRID_UBYTE 0 CM_0p125_0 -0 31.875 /end CHARACTERISTIC
/begin CHARACTERISTIC KHCTEMN "podtverzhdena | minimum value of HC concentration in purge flow" VALUE 0x198AB RL_GRID_UBYTE 0 CM_0p015625_0 -0 3.98438 /end CHARACTERISTIC
/begin CHARACTERISTIC KHCTEMX "podtverzhdena | maximum value of HC concentration in purge flow" VALUE 0x198AC RL_GRID_UBYTE 0 CM_0p015625_0 -0 3.98438 /end CHARACTERISTIC
/begin CHARACTERISTIC ZBTEML "podtverzhdena | integration speed for canister charge adaptation" VALUE 0x198AD RL_GRID_UBYTE 0 CM_0p02392578125_0_1s -0 6.10107 /end CHARACTERISTIC
/begin CHARACTERISTIC DNDTEO "podtverzhdena | upper Nsoll-Nist threshold for abortion diagnosis CPV" VALUE 0x19912 RL_GRID_UBYTE 0 CM_10_0_Umin -0 2550 /end CHARACTERISTIC
/begin CHARACTERISTIC DNDTEU "podtverzhdena | lower Nsoll-Nist threshold for abortion diagnosis CPV" VALUE 0x19913 RL_GRID_UBYTE 0 CM_10_0_Umin -0 2550 /end CHARACTERISTIC
/begin CHARACTERISTIC ETAZWTEN "podtverzhdena | minimum threschold of ignition angle efficiency for diagnosis of PCV" VALUE 0x19914 RL_GRID_UBYTE 0 CM_0p5_0 -0 127.5 /end CHARACTERISTIC
/begin CHARACTERISTIC FKADPMN "podtverzhdena | minimum feul part via CPV for passive O.K. testing." VALUE 0x19915 RL_GRID_UBYTE 0 CM_0p0078125_0 -0 1.99219 /end CHARACTERISTIC
/begin CHARACTERISTIC IMSDTEVA "podtverzhdena | thershold for integral of purge mass flow after a long purge stop" VALUE 0x19916 RL_GRID_UBYTE 0 CM_0p0444_0_g -0 11.322 /end CHARACTERISTIC
/begin CHARACTERISTIC TC6TECI "podtverzhdena | mode 6 code word for O.K. check of CPV form DLDP" VALUE 0x1996E RL_GRID_UBYTE 0 CM_IDENTITY -0 255 /end CHARACTERISTIC
/begin CHARACTERISTIC TC6TECL "podtverzhdena | mode 6 code word for O.K. check of CPV from air-test" VALUE 0x1996F RL_GRID_UBYTE 0 CM_IDENTITY -0 255 /end CHARACTERISTIC
/begin CHARACTERISTIC TC6TECNL "podtverzhdena | mode 6 code word for NOT O.K. check of CPV from air-test" VALUE 0x19970 RL_GRID_UBYTE 0 CM_IDENTITY -0 255 /end CHARACTERISTIC
/begin CHARACTERISTIC TC6TECP "podtverzhdena | mode 6 code word for passive O.K. check of CPV" VALUE 0x19971 RL_GRID_UBYTE 0 CM_IDENTITY -0 255 /end CHARACTERISTIC
/begin CHARACTERISTIC TC6TECRF "podtverzhdena | mode 6 code word for O.K. check of CPV from FR-deviation dircetion rich" VALUE 0x19972 RL_GRID_UBYTE 0 CM_IDENTITY -0 255 /end CHARACTERISTIC
/begin CHARACTERISTIC TC6TECRM "podtverzhdena | mode 6 code word for O.K. check of CPV from FR-deviation dircetion lean" VALUE 0x19973 RL_GRID_UBYTE 0 CM_IDENTITY -0 255 /end CHARACTERISTIC
/begin CHARACTERISTIC TC6TECT "podtverzhdena | mode 6 code word for O.K. check of CPV form DLDP" VALUE 0x19974 RL_GRID_UBYTE 0 CM_IDENTITY -0 255 /end CHARACTERISTIC
/begin CHARACTERISTIC TTEVAZ "podtverzhdena | duration of stay for CPV opening with not successful frm" VALUE 0x19978 RL_GRID_UBYTE 0 CM_0p1_0_s -0 25.5 /end CHARACTERISTIC
/begin CHARACTERISTIC TVDTEB "podtverzhdena | delay time for statement TEV o.k./defect in diagnosis DTEV" VALUE 0x1997A RL_GRID_UBYTE 0 CM_0p1_0_s -0 25.5 /end CHARACTERISTIC
/begin CHARACTERISTIC TVDTEE "podtverzhdena | Duration as of PCV open for checking of DTEV" VALUE 0x1997B RL_GRID_UBYTE 0 CM_0p1_0_s -0 25.5 /end CHARACTERISTIC
/begin CHARACTERISTIC TVDTEVP "podtverzhdena | delay time for setting of the flip flop 'Passive Diagnosis CPV o.k.'" VALUE 0x1997D RL_GRID_UBYTE 0 CM_0p1_0_s -0 25.5 /end CHARACTERISTIC
/begin CHARACTERISTIC TVDTEVZ "podtverzhdena | delay time for closing CPV for active DTEV" VALUE 0x1997F RL_GRID_UBYTE 0 CM_0p1_0_s -0 25.5 /end CHARACTERISTIC
/begin CHARACTERISTIC CURVE_19509 "adres podtverzhden | curve, input 0x90AC; length taken from the start of the next curve" CURVE 0x19509 RL_GRID_UBYTE 0 CM_0p0078125_0 -0 1.99219
 /begin AXIS_DESCR FIX_AXIS NO_INPUT_QUANTITY CM_IDENTITY 12 0 11 FIX_AXIS_PAR_DIST 0 1 12 /end AXIS_DESCR
/end CHARACTERISTIC
/begin CHARACTERISTIC CURVE_19515 "adres podtverzhden | curve over engine speed, input 0xF89E" CURVE 0x19520 RL_GRID_UBYTE 0 CM_0p0078125_0 -0 1.99219
 /begin AXIS_DESCR COM_AXIS NO_INPUT_QUANTITY CM_40_0_rpm 10 0 10200 AXIS_PTS_REF AX_19516_Y /end AXIS_DESCR
/end CHARACTERISTIC
/begin CHARACTERISTIC LIMTKOA "podtverzhdena | Time threshold to switch off the AC-compressor indefinitly" VALUE 0x119D8 RL_GRID_UBYTE 0 CM_0p2_0_s -0 51 /end CHARACTERISTIC
/begin CHARACTERISTIC TKOAMNN "podtverzhdena | minimum shutdown time for air-conditioning compressor" CURVE 0x119E2 RL_GRID_UBYTE 0 CM_0p2_0_s -0 51
 /begin AXIS_DESCR COM_AXIS NO_INPUT_QUANTITY CM_40_0_rpm 8 0 10200 AXIS_PTS_REF SNM08_KO /end AXIS_DESCR
/end CHARACTERISTIC
/begin CHARACTERISTIC TKOAMXN "podtverzhdena | maximum shutdown time for air-conditioning compressor" CURVE 0x119EA RL_GRID_UBYTE 0 CM_0p2_0_s -0 51
 /begin AXIS_DESCR COM_AXIS NO_INPUT_QUANTITY CM_40_0_rpm 8 0 10200 AXIS_PTS_REF SNM08_KO /end AXIS_DESCR
/end CHARACTERISTIC
/begin CHARACTERISTIC TKOEMNN "podtverzhdena | minimal time of air-condition compressor beeing swiched on" CURVE 0x119F2 RL_GRID_UBYTE 0 CM_0p2_0_s -0 51
 /begin AXIS_DESCR COM_AXIS NO_INPUT_QUANTITY CM_40_0_rpm 8 0 10200 AXIS_PTS_REF SNM08_KO /end AXIS_DESCR
/end CHARACTERISTIC
/begin CHARACTERISTIC TMKOAO "podtverzhdena | Upper coolant temperature for swichting off the AC-compressor" VALUE 0x119FA RL_GRID_UBYTE 0 CM_0p75_48_GradC -48 143.25 /end CHARACTERISTIC
/begin CHARACTERISTIC TMKOAU "podtverzhdena | Lower coolant temperature for swichting off the AC-compressor" VALUE 0x119FB RL_GRID_UBYTE 0 CM_0p75_48_GradC -48 143.25 /end CHARACTERISTIC
/begin CHARACTERISTIC TNACMX "podtverzhdena | maximal time for engine speed nac after S_ko = 0" VALUE 0x119FC RL_GRID_UBYTE 0 CM_0p2_0_s -0 51 /end CHARACTERISTIC
/begin CHARACTERISTIC TVKOA "podtverzhdena | delay time for compressor OFF" VALUE 0x119FD RL_GRID_UBYTE 0 CM_0p02_0_s -0 5.1 /end CHARACTERISTIC
/begin CHARACTERISTIC TVKOE "podtverzhdena | delay time for compressor ON" VALUE 0x119FE RL_GRID_UBYTE 0 CM_0p02_0_s -0 5.1 /end CHARACTERISTIC
/begin CHARACTERISTIC VKOAO "podtverzhdena | Upper vehicle speed threshold to inhibit the AC-compressor" VALUE 0x119FF RL_GRID_UBYTE 0 CM_1p25_0_kmh -0 318.75 /end CHARACTERISTIC
/begin CHARACTERISTIC VKOAU "podtverzhdena | low vehicle speed threshold to inhibit the AC-compressor" VALUE 0x11A00 RL_GRID_UBYTE 0 CM_1p25_0_kmh -0 318.75 /end CHARACTERISTIC
/begin CHARACTERISTIC WDKKOAN_0 "podtverzhdena | wdk threshold for A/C compressor cut off, variant 0" CURVE 0x11A01 RL_GRID_UBYTE 0 CM_0p390625_0 -0 99.6094
 /begin AXIS_DESCR COM_AXIS NO_INPUT_QUANTITY CM_40_0_rpm 8 0 10200 AXIS_PTS_REF SNM08_KO /end AXIS_DESCR
/end CHARACTERISTIC
/begin CHARACTERISTIC WDKKOAN_1 "podtverzhdena | wdk threshold for A/C compressor cut off, variant 1" CURVE 0x11A09 RL_GRID_UBYTE 0 CM_0p390625_0 -0 99.6094
 /begin AXIS_DESCR COM_AXIS NO_INPUT_QUANTITY CM_40_0_rpm 8 0 10200 AXIS_PTS_REF SNM08_KO /end AXIS_DESCR
/end CHARACTERISTIC
/begin CHARACTERISTIC WDKKOEN "podtverzhdena | wdk threshold for air-condition compressor authorisation" CURVE 0x11A11 RL_GRID_UBYTE 0 CM_0p390625_0 -0 99.6094
 /begin AXIS_DESCR COM_AXIS NO_INPUT_QUANTITY CM_40_0_rpm 8 0 10200 AXIS_PTS_REF SNM08_KO /end AXIS_DESCR
/end CHARACTERISTIC
/begin CHARACTERISTIC KUMSRL "podtverzhdena | konstanta perescheta rashoda vozduha v otnositelnoe napolnenie" VALUE 0x1157C RL_GRID_UBYTE 0 CM_7p8125En06_0_kgh1min -0 0.00199219 /end CHARACTERISTIC
/begin CHARACTERISTIC CWFKMSDKA "podtverzhdena | kodovoe slovo: adaptaciya rashoda vklyuchena" VALUE 0x1157A RL_GRID_UBYTE 0 CM_IDENTITY -0 255 /end CHARACTERISTIC
/begin CHARACTERISTIC KIMSALL "podtverzhdena | popravka integratora vozduha holostogo hoda" VALUE 0x1157B RL_GRID_UBYTE 0 CM_0p00078125_0 -0 0.199219 /end CHARACTERISTIC
/begin CHARACTERISTIC MSALLMN "podtverzhdena | nizhniy predel adaptacii vozduha HH" VALUE 0x1157D RL_GRID_UBYTE 0 CM_0p1_0_kgh -0 25.5 /end CHARACTERISTIC
/begin CHARACTERISTIC MSALLMX "podtverzhdena | verhniy predel adaptacii vozduha HH" VALUE 0x1157E RL_GRID_UBYTE 0 CM_0p1_0_kgh -0 25.5 /end CHARACTERISTIC
/begin CHARACTERISTIC MSLG "podtverzhdena | rashod summarnogo podsosa (utechki) vozduha" VALUE 0x1157F RL_GRID_UBYTE 0 CM_0p1_0_kgh -0 25.5 /end CHARACTERISTIC
/begin CHARACTERISTIC RLNOT "podtverzhdena | Podmena napolneniya pri otkaze. Imenno etot mehanizm sposoben derzhat nevernoe napolnenie skolko ugodno dolgo, v otlichie ot oshibki prognoza, zhivuschey 2-5 ciklov." CURVE 0x11587 RL_GRID_UBYTE 0 CM_0p75_0 -0 191.25
 /begin AXIS_DESCR COM_AXIS NO_INPUT_QUANTITY CM_40_0_rpm 6 0 10200 AXIS_PTS_REF AX_11581_Y /end AXIS_DESCR
/end CHARACTERISTIC
/begin CHARACTERISTIC KLAF "podtverzhdena | funkciya istecheniya Sen-Venana dlya drosselya" CURVE 0x15754 RL_GRID_UWORD 0 CM_IDENTITY -0 65535
 /begin AXIS_DESCR FIX_AXIS NO_INPUT_QUANTITY CM_IDENTITY 501 0 500 FIX_AXIS_PAR_DIST 0 1 501 /end AXIS_DESCR
/end CHARACTERISTIC
/begin CHARACTERISTIC KFMSNWDK "podtverzhdena | bazovyy rashod cherez drossel, vhod wdkba (ugol) i pspvdk (otnoshenie davleniy)" MAP 0x15694 RL_GRID_UWORD 0 CM_0p1_0_kgh -0 6553.5
 /begin AXIS_DESCR COM_AXIS NO_INPUT_QUANTITY CM_IDENTITY 6 0 65535 AXIS_PTS_REF AX_15688_X /end AXIS_DESCR
 /begin AXIS_DESCR COM_AXIS NO_INPUT_QUANTITY CM_IDENTITY 16 0 65535 AXIS_PTS_REF AX_15668_Y /end AXIS_DESCR
/end CHARACTERISTIC
/begin CHARACTERISTIC WDKUGDN "podtverzhdena | ugol drosselya, pri kotorom dostigaetsya 95 % maksimalno vozmozhnogo napolneniya" CURVE 0x15B40 RL_GRID_UWORD 0 CM_0p001525878906_0_ugladrossely -0 99.9985
 /begin AXIS_DESCR FIX_AXIS NO_INPUT_QUANTITY CM_IDENTITY 12 0 11 FIX_AXIS_PAR_DIST 0 1 12 /end AXIS_DESCR
/end CHARACTERISTIC
/begin CHARACTERISTIC KFRLW "podtverzhdena | rezervnyy signal napolneniya ot ugla drosselya i oborotov (auxiliary load signal). Imenno na nego EBU pereklyuchaetsya, kogda osnovnoy signal po DMRV priznan negodnym -- tot samyy seco" MAP 0x1ACAA RL_GRID_UWORD 0 CM_0p0234375_0_napolneniya -0 1535.98
 /begin AXIS_DESCR COM_AXIS NO_INPUT_QUANTITY CM_0p25_0_obmin 12 0 16383.8 AXIS_PTS_REF AX_1AC92_X /end AXIS_DESCR
 /begin AXIS_DESCR COM_AXIS NO_INPUT_QUANTITY CM_0p01219512195_0_ugoldrosselya 12 0 799.207 AXIS_PTS_REF AX_1AC7A_Y /end AXIS_DESCR
/end CHARACTERISTIC
/begin CHARACTERISTIC KFPU "podtverzhdena | korrekciya pulsaciy potoka, oboroty x ugol drosselya" MAP 0x114A3 RL_GRID_UBYTE 0 CM_0p0078125_0 -0 1.99219
 /begin AXIS_DESCR FIX_AXIS NO_INPUT_QUANTITY CM_IDENTITY 14 0 13 FIX_AXIS_PAR_DIST 0 1 14 /end AXIS_DESCR
 /begin AXIS_DESCR FIX_AXIS NO_INPUT_QUANTITY CM_IDENTITY 14 0 13 FIX_AXIS_PAR_DIST 0 1 14 /end AXIS_DESCR
/end CHARACTERISTIC
/begin CHARACTERISTIC KFPUSU "podtverzhdena | to zhe pri izmenyaemoy geometrii vpuska (rezhim 1)" MAP 0x111FD RL_GRID_UBYTE 0 CM_0p0078125_0 -0 1.99219
 /begin AXIS_DESCR FIX_AXIS NO_INPUT_QUANTITY CM_IDENTITY 14 0 13 FIX_AXIS_PAR_DIST 0 1 14 /end AXIS_DESCR
 /begin AXIS_DESCR FIX_AXIS NO_INPUT_QUANTITY CM_IDENTITY 14 0 13 FIX_AXIS_PAR_DIST 0 1 14 /end AXIS_DESCR
/end CHARACTERISTIC
/begin CHARACTERISTIC KFPUNW "podtverzhdena | to zhe pri upravlenii fazami (rezhim 2) -- vsya v edinicah, fazovraschatelya tut net" MAP 0x112DF RL_GRID_UBYTE 0 CM_0p0078125_0 -0 1.99219
 /begin AXIS_DESCR FIX_AXIS NO_INPUT_QUANTITY CM_IDENTITY 14 0 13 FIX_AXIS_PAR_DIST 0 1 14 /end AXIS_DESCR
 /begin AXIS_DESCR FIX_AXIS NO_INPUT_QUANTITY CM_IDENTITY 14 0 13 FIX_AXIS_PAR_DIST 0 1 14 /end AXIS_DESCR
/end CHARACTERISTIC
/begin CHARACTERISTIC KFPUSUNW "podtverzhdena | to zhe pri oboih (rezhim 3) -- vsya v edinicah" MAP 0x113C1 RL_GRID_UBYTE 0 CM_0p0078125_0 -0 1.99219
 /begin AXIS_DESCR FIX_AXIS NO_INPUT_QUANTITY CM_IDENTITY 14 0 13 FIX_AXIS_PAR_DIST 0 1 14 /end AXIS_DESCR
 /begin AXIS_DESCR FIX_AXIS NO_INPUT_QUANTITY CM_IDENTITY 14 0 13 FIX_AXIS_PAR_DIST 0 1 14 /end AXIS_DESCR
/end CHARACTERISTIC
/begin CHARACTERISTIC KFKHFM "podtverzhdena | korrekciya harakteristiki DMRV, oboroty x napolnenie" MAP 0x1111B RL_GRID_UBYTE 0 CM_0p0078125_0 -0 1.99219
 /begin AXIS_DESCR FIX_AXIS NO_INPUT_QUANTITY CM_IDENTITY 14 0 13 FIX_AXIS_PAR_DIST 0 1 14 /end AXIS_DESCR
 /begin AXIS_DESCR FIX_AXIS NO_INPUT_QUANTITY CM_IDENTITY 14 0 13 FIX_AXIS_PAR_DIST 0 1 14 /end AXIS_DESCR
/end CHARACTERISTIC
/begin CHARACTERISTIC PUKANS "podtverzhdena | popravka korrekcii pulsaciy po temperature vozduha na vpuske" CURVE 0x11568 RL_GRID_UBYTE 0 CM_0p0078125_0_mnozhitel -0 1.99219
 /begin AXIS_DESCR FIX_AXIS NO_INPUT_QUANTITY CM_IDENTITY 8 0 7 FIX_AXIS_PAR_DIST 0 1 8 /end AXIS_DESCR
/end CHARACTERISTIC
/begin CHARACTERISTIC CURVE_11A2E "adres podtverzhden | curve over coolant temperature, result to 0x9910" CURVE 0x11A35 RL_GRID_UBYTE 0 CM_IDENTITY -0 255
 /begin AXIS_DESCR COM_AXIS NO_INPUT_QUANTITY CM_0p75_48_GradC 6 0 143.25 AXIS_PTS_REF AX_11A2F_Y /end AXIS_DESCR
/end CHARACTERISTIC
/begin GROUP G_ALL "??? ?????" ROOT
 /begin SUB_GROUP G_scanner_adres_podtverzhden G_scanner_podtverzhdena G_lambda_cat_diag_block G_knock_control G_canister_purge G_mixture_adaptation G_ac_compressor G_overrun_fuel_cut G_torque_model G_lambda_control_thresholds G_maps G_cyclic_charge G_full_load_enrichment G_hfm_path G_scalars G_transient_fuel G_throttle_air_model G_cpv_curves G_fuel_path G_full_load_lambda G_axes_resolved_from_code G_code_found G_dtc_table G_other_regions G_saint_venant /end SUB_GROUP
/end GROUP
/begin GROUP G_scanner_adres_podtverzhden "scanner:adres podtverzhden"
 /begin REF_CHARACTERISTIC SNG06LLSB NARASTG RLMNN RLMNSAN KFMIRED FSWALUV FUGKUE ZDSH1GS ZDSHGS SNS06LLSB ZNSMST DMLLRIMXN DMLLRLMNN DMLLRLMXN DMLLRMNN DMLLRMXN DVNG DVNGV FDDN GFDLDN IVDN IVDNDTE PVDN PVLDN PVLDNV SDN06LLSB SNS206LLSB TVFSAM TVFSAMR TVFSEM TVFSEMR UEVERG ZKMDWAM FZN0 FZN1 FZN2 FZN3 FZN4 FZNWN0 FZNWN1 FZNWN2 FZNWN3 MAP_115_112C2_14 MAP_120_11567_8 MAP_123_11595_8 MAP_124_115EC_7 MAP_127_11616_8 MAP_128_11673_6 MAP_129_1168B_6 MAP_130_11698_12 MAP_131_116B2_6x6 MAP_132_116E5_4 MAP_134_11986_5x6 MAP_137_11A1A_6 MAP_139_11A40_10x10 FFTEV6 FFTFRAO FFTFRAU FFTFRST FFTGE FFTHSH FFTHSHE FFTHSV FFTHSVE FFTKAT FFTKOSE FFTKPE MAP_152_11AD4_16x12 ANALUN MAP_171_124D4_6 MAP_172_128BD_21 NDFILOG MAP_183_149D8_10 SRL03MFUW MAP_211_14FF7_5 MAP_221_15261_6 WFRL KLAFTE MAP_261_15F88_12 CDCDK CDCLSH MAP_309_16156_5 CDCTES CDCTEVE FLRAG FLRAWG FLRHG FRARAG FRARAWG FRARHG DFAUWKN DFAWKN ZFAUWKN ZFAWKN WPHN DZWSPM KFTVSA NWECVTM TVSATM NFSM NLLM LIMXDNS LIMXVDNS LISTM MAP_399_18613_10x8 WDKHKN MAP_407_18768_6 MAP_409_1879A_6 ATMABKA ATMABKK FATMRML KATMEXML KLATMLAE KLATMZWE MAP_422_188CA_5 DTVKAML2 FTMLAKH MAP_446_18BBA_4 NFSKHM FMDKHFH FMDKHTM MAP_454_18CCE_4 MAP_456_18CE9_8 MAP_458_18D3B_8 SENZZYL DWKRMSN KRAL1N KRAL2N MAP_476_18E8E_4 KRFKN KRMXN KRNLZAR KRVFN MAP_482_18F3D_4 LKRN MAP_485_18F71_4 MAP_486_18FA2_4 SNM08GKUB WEAN WEEM WEEMRFAN WEESTM ZZWEETM FSTHO FNSA FNSHO MAP_512_193E0_9 MAP_521_196F8_5 MAP_523_19719_8 MAP_525_1976E_6 MAP_527_1979E_6 MAP_533_198B4_5 MAP_537_19950_14 DTLRTML TMLRTMS MAP_541_19A2F_20 TWLRTMS MAP_543_19A6B_20 MAP_544_19AAC_4 LURKH AINTKAN SLX06TMUW SML07TMUW SRL04DYUB MKLWON MKLWOWKN MKLWSAN MKLWUN MKLWUWKN MAP_561_1A692_12 MAP_565_1A84A_6 MAP_566_1A88A_6 MAP_575_1ADDB_5 MAP_576_1AEC3_6 MAP_577_1AF14_6 MAP_585_1B497_8 MAP_587_1B5E1_6 MAP_588_1B612_5 MAP_602_1B8C0_5 MAP_603_1B91F_5 MAP_608_1B9EC_4 /end REF_CHARACTERISTIC
/end GROUP
/begin GROUP G_scanner_podtverzhdena "Skaner: podtverzhdennye"
 /begin REF_CHARACTERISTIC SGA08MDUB SML05DKUB SML05LKUB SML08LHUB SNM05DKUB SNM06LLUB SNM07LRUB SNM08DMUB SNM08LHUB SNM08__UB SNM10FEUB SNM12ESUB SNM12FEUB_100D5 SNM16CIUB SNM16OPUB SNM16ZUUB SNM24ZUUB SQM05TEUB SRL06LHUB SRL06LRUB SRL08DMUB SRL12ESUB SRL12ZUUB SRL16ZUUB STM12ESUB KFMPED ETALAM_10515 NMAXPRL NMXDAEF ZINMAXRL SBF02MFSB FKODASH FVDASHM KFMIDSH0 KFMIDSH1 KFMIDSH2 KFMIDSH3 FSZTM KFSZT KLMDLOAD2 FABMDWA KFAGRS KFDLURZ KFLURM1 KFFWK_0_A KFZWMNST KFZWWLNM KFWK_0_A MDST FNSTABNV KFDYES_0_A TVUB TVCO DMSTES AGREDRLS MSNTATE NNSTA NSTNM SDK10TEUB SEZ06TMUB SFR05TEUB SGA06MFUB SKS06ESUB SML06TEUB SML06TMUB SNM06LHUB SNM06MFUB SNM07ESUB SNM10TEUB SNM16GKUB_181F8 SNM16KRUB SRL04KRUB SRL12GKUB_1821F ST107TMUB ST307TMUB STA06ESUB STM04__UB STM05SAUB STM05TMUB STM06LLUB STM06__UB STM08DMUB STM08LEUB STM09ESUB STS12ESUB STW06MDUB RLVMXN_182B7 RLVSMXN_182CE KFDMDFA KFDMDFAS KFDMDFAU KFZMDFA KFZMDFAS KFZMDFAU REDZEM DNEVTMOD DNLBZ FNSSTM NSLPP NSLPPFS NTANS DMDKOE KFMDKO EVTMODO FDVANS FWFTBRTA FZPUSA WDKHKDN WPUAVLN WPUAVLSN KFFTAGRV KFFTDAG KFSU KFSU2 TVSUM KFATMLA KFATMZW KFTATM FRINH1 KFTPKOR FFRITMS KFRI KFRP KFFTV FNSKHLL KFNLLKHM MLSUS KFEKWTMP KFLMSKH KFWEE KFWEEK WEESTN KFFWL FUKNSTM KFTKONS KFFTEAX KFTATX KFTEVP KFTVTEV KFDETATE KFMDDAGR KFIDTHM KFDMDARO KFDMDARU KFDZWKG KFZWNWSUE KFZWWLTM KFPSDMX FPVMXN2 KFRLW_1B3F3 KFZKPUA ATMTANS FKHLA FKHMD KLESUKKO FQTEPT /end REF_CHARACTERISTIC
/end GROUP
/begin GROUP G_lambda_cat_diag_block "Diagnostika katalizatora"
 /begin REF_CHARACTERISTIC TSTEAA TVLRHMN TVLRHMX ANZDYNSH CWDLSAHK TABGSTG TFRMB TLLASH TSALASH TUSCHUB TUSHSMIN TUSSA USHLEAN USHRICH USHSTGMX USHSTSOLL USSCHUB CWGGLSV ADKATNF AHKATMN AHKATS AHKATSB AHKTMXT APEKTDX AVKATFS CDKATLK DKATCW DRLKTDP DRLKTDPT FALRKTD FALRKTT KATBFMNT KATBFN KATBFNM KATBFNP KATBFSX KATBSG KATBSH KATBSHG NDKTSOT NDKTSUT NKTDX RLDKTOT RLDKTUT TMAXKAT TMINKAT TMNKATT TMSUKTD TWDKATST TWKTDLP ZDKATAD ZDKATAF ZDKATSH ZDKTBD ZDKTBF ZKTDRL PHLSNVMN TABGMSVU TMASO TMNEB TMSV TMSVA TRSA TUSEINV PHLSNHMN THHA THHA2 THHAWU THSHA THVA THVA2 THVAWU TMOHSMN TREHS TVHSH TVHSV TVHSVMX UBHS UHSN /end REF_CHARACTERISTIC
/end GROUP
/begin GROUP G_knock_control "Kontur detonacii"
 /begin REF_CHARACTERISTIC DKROKMX FKEFMC FKELDY FKENDY FKRFTPFMC KRFTP1 KRFTP2 KRFTP3 KRKFKS KRVST REFINI KRDWA KRDWKLA KRDWSA KRLMDY KRNMDY KSZA DYADS DYAFVS DYAVF FKELDYA PZWKRA TMDYNA CWDKRNT CWDKROF DKROKU KRFHT UDKRGOFS CWDKRTP UDKRTP NDSVL QDPSLL RLDSVL /end REF_CHARACTERISTIC
/end GROUP
/begin GROUP G_canister_purge "Adsorber"
 /begin REF_CHARACTERISTIC GRID_528_197BC_10x10 KFQTE TMTE FRHB FTEADAB FTEADMX FTEFHB FTEHB FUMRBRK KHCTEMN KHCTEMX ZBTEML DNDTEO DNDTEU ETAZWTEN FKADPMN IMSDTEVA TC6TECI TC6TECL TC6TECNL TC6TECP TC6TECRF TC6TECRM TC6TECT TTEVAZ TVDTEB TVDTEE TVDTEVP TVDTEVZ /end REF_CHARACTERISTIC
/end GROUP
/begin GROUP G_mixture_adaptation "mixture_adaptation"
 /begin REF_CHARACTERISTIC TATELL TMSKLH TMSNOGA FRAOMN FRAOMX FRAORN FRAORX FRATMN FRATMX FRAUMN FRAUMX FRAURN FRAURX NO1 NOLRA NU3 RLO2 RLO3 RLO3AC RLU2 RLU2AC RLU3 RLU4 TMFRATMN TMFRATUB CWPKAPP KRKTE CWLAMBTS /end REF_CHARACTERISTIC
/end GROUP
/begin GROUP G_ac_compressor "Kondicioner"
 /begin REF_CHARACTERISTIC LIMTKOA TKOAMNN TKOAMXN TKOEMNN TMKOAO TMKOAU TNACMX TVKOA TVKOE VKOAO VKOAU WDKKOAN_0 WDKKOAN_1 WDKKOEN /end REF_CHARACTERISTIC
/end GROUP
/begin GROUP G_overrun_fuel_cut "Otsechka na prinuditelnom holostom"
 /begin REF_CHARACTERISTIC KSZWE CWSAWE DNSAH DNSAL DNSATIP DNSLL DNVSA DNWEELLS DNWEK DVSA ENSAKHG TKATSA VSAA /end REF_CHARACTERISTIC
/end GROUP
/begin GROUP G_torque_model "Momentnaya model"
 /begin REF_CHARACTERISTIC ETADZW DZWETA KFMIOP KFMIRL KFMDS MDIMX CWMDAPP ETALAM MDLF1 MDLF2 MDLFE1 MDLFE2 /end REF_CHARACTERISTIC
/end GROUP
/begin GROUP G_lambda_control_thresholds "lambda_control_thresholds" /begin REF_CHARACTERISTIC RLLRUN_18AD2 RLLRTMO RLLRUN TARAU TASHS TLRHS TMRA1 TMRA2 /end REF_CHARACTERISTIC /end GROUP
/begin GROUP G_maps "Karty iz opisi" /begin REF_CHARACTERISTIC KFETAZW KFETAZWN KFZWOP KFZWMS KFZW KFZW2 KFZWMN KFLBTS /end REF_CHARACTERISTIC /end GROUP
/begin GROUP G_cyclic_charge "Ciklovoe napolnenie" /begin REF_CHARACTERISTIC KUMSRL CWFKMSDKA KIMSALL MSALLMN MSALLMX MSLG RLNOT /end REF_CHARACTERISTIC /end GROUP
/begin GROUP G_full_load_enrichment "full_load_enrichment"
 /begin REF_CHARACTERISTIC WDKSLN_18FCB WDKSLN WDKVLN_0 WDKVLN_1 KLLAMFA_0 KLLAMFA_1 TV_LAMFA /end REF_CHARACTERISTIC
/end GROUP
/begin GROUP G_hfm_path "Vozdushnyy trakt, DMRV" /begin REF_CHARACTERISTIC KFPU KFPUSU KFPUNW KFPUSUNW KFKHFM PUKANS /end REF_CHARACTERISTIC /end GROUP
/begin GROUP G_scalars "Odinochnye velichiny" /begin REF_CHARACTERISTIC DNMAXH NMAX NMAXDV NMXDKPU TNMAXDV /end REF_CHARACTERISTIC /end GROUP
/begin GROUP G_transient_fuel "Perehodnye rezhimy, plenka" /begin REF_CHARACTERISTIC KFABAK KFAVAK KFBAKL KFVAKL /end REF_CHARACTERISTIC /end GROUP
/begin GROUP G_throttle_air_model "Drossel, model vozduha" /begin REF_CHARACTERISTIC KFMSNWDK WDKUGDN KFRLW /end REF_CHARACTERISTIC /end GROUP
/begin GROUP G_cpv_curves "cpv_curves" /begin REF_CHARACTERISTIC CURVE_19509 CURVE_19515 /end REF_CHARACTERISTIC /end GROUP
/begin GROUP G_fuel_path "Toplivopodacha" /begin REF_CHARACTERISTIC KFLF FRKAP /end REF_CHARACTERISTIC /end GROUP
/begin GROUP G_full_load_lambda "Lyambda polnoy nagruzki" /begin REF_CHARACTERISTIC KFFDLBTS__kandidat TVLBTS /end REF_CHARACTERISTIC /end GROUP
/begin GROUP G_axes_resolved_from_code "Osi, vosstanovlennye po kodu" /begin REF_CHARACTERISTIC SRL11OPUW /end REF_CHARACTERISTIC /end GROUP
/begin GROUP G_code_found "code_found" /begin REF_CHARACTERISTIC CURVE_11A2E /end REF_CHARACTERISTIC /end GROUP
/begin GROUP G_dtc_table "dtc_table" /begin REF_CHARACTERISTIC DTC_CODES /end REF_CHARACTERISTIC /end GROUP
/begin GROUP G_other_regions "Prochie oblasti" /begin REF_CHARACTERISTIC DIAG_FLAGS /end REF_CHARACTERISTIC /end GROUP
/begin GROUP G_saint_venant "Sen-Venan, rashod cherez drossel" /begin REF_CHARACTERISTIC KLAF /end REF_CHARACTERISTIC /end GROUP
/end MODULE
/end PROJECT
