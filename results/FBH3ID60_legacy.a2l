ASAP2_VERSION 1 51
/begin PROJECT FBH3ID60 "Bosch M7.9.7 C167"
/begin HEADER "Kia Spectra 1.6 FBH3ID60" VERSION "1.0" /end HEADER
/begin MODULE FBH3ID60_MOD "Bosch M7.9.7"
/begin MOD_COMMON "little endian, alignment 1" BYTE_ORDER MSB_LAST ALIGNMENT_BYTE 1 ALIGNMENT_WORD 1 ALIGNMENT_LONG 1 /end MOD_COMMON
/begin COMPU_METHOD CM_IDENTITY "raw values" RAT_FUNC "%.3f" "" COEFFS 0 1 0 0 0 1 /end COMPU_METHOD
/begin COMPU_METHOD CM_0p75_0 "scale 0.75" RAT_FUNC "%.3f" "%" COEFFS 0 1 0 0 0 0.75 /end COMPU_METHOD
/begin COMPU_METHOD CM_40_0_Upm "scale 40" RAT_FUNC "%.1f" "Upm" COEFFS 0 1 0 0 0 40 /end COMPU_METHOD
/begin COMPU_METHOD CM_0p390625_0 "scale 0.390625" RAT_FUNC "%.3f" "%" COEFFS 0 1 0 0 0 0.390625 /end COMPU_METHOD
/begin COMPU_METHOD CM_0p75_0_gradKW "scale 0.75" RAT_FUNC "%.3f" "grad KW" COEFFS 0 1 0 0 0 0.75 /end COMPU_METHOD
/begin COMPU_METHOD CM_0p09803921569_0 "scale 0.0980392" RAT_FUNC "%.3f" "" COEFFS 0 1 0 0 0 0.09803921569 /end COMPU_METHOD
/begin COMPU_METHOD CM_0p03125_0 "scale 0.03125" RAT_FUNC "%.3f" "-" COEFFS 0 1 0 0 0 0.03125 /end COMPU_METHOD
/begin COMPU_METHOD CM_0p0078125_0 "scale 0.0078125" RAT_FUNC "%.3f" "-" COEFFS 0 1 0 0 0 0.0078125 /end COMPU_METHOD
/begin COMPU_METHOD CM_0p3906_0 "scale 0.3906" RAT_FUNC "%.3f" "%" COEFFS 0 1 0 0 0 0.3906 /end COMPU_METHOD
/begin COMPU_METHOD CM_n0p00048828125_0_sUmin "scale -0.000488281" RAT_FUNC "%.3f" "(%*s)/(U/min)" COEFFS 0 1 0 0 0 -0.00048828125 /end COMPU_METHOD
/begin COMPU_METHOD CM_0p00390625_0 "scale 0.00390625" RAT_FUNC "%.3f" "-" COEFFS 0 1 0 0 0 0.00390625 /end COMPU_METHOD
/begin COMPU_METHOD CM_0p0023828125_0_sUmin "scale 0.00238281" RAT_FUNC "%.3f" "%/(s*U/min)" COEFFS 0 1 0 0 0 0.0023828125 /end COMPU_METHOD
/begin COMPU_METHOD CM_0p001525878906_0 "scale 0.00152588" RAT_FUNC "%.3f" "-" COEFFS 0 1 0 0 0 0.001525878906 /end COMPU_METHOD
/begin COMPU_METHOD CM_0p02_0_s "scale 0.02" RAT_FUNC "%.3f" "s" COEFFS 0 1 0 0 0 0.02 /end COMPU_METHOD
/begin COMPU_METHOD CM_0p0625_0 "scale 0.0625" RAT_FUNC "%.3f" "-" COEFFS 0 1 0 0 0 0.0625 /end COMPU_METHOD
/begin COMPU_METHOD CM_0p001953125_n0p75 "scale 0.00195312" RAT_FUNC "%.3f" "" COEFFS 0 1 -0.75 0 0 0.001953125 /end COMPU_METHOD
/begin COMPU_METHOD CM_n0p75_0_gradKW "scale -0.75" RAT_FUNC "%.3f" "grad KW" COEFFS 0 1 0 0 0 -0.75 /end COMPU_METHOD
/begin COMPU_METHOD CM_0p3921568627_0_DK "scale 0.392157" RAT_FUNC "%.3f" "% DK" COEFFS 0 1 0 0 0 0.3921568627 /end COMPU_METHOD
/begin COMPU_METHOD CM_0p25_0 "scale 0.25" RAT_FUNC "%.3f" "-" COEFFS 0 1 0 0 0 0.25 /end COMPU_METHOD
/begin COMPU_METHOD CM_0p2_0_s "scale 0.2" RAT_FUNC "%.3f" "s" COEFFS 0 1 0 0 0 0.2 /end COMPU_METHOD
/begin COMPU_METHOD CM_0p25_0_Umin "scale 0.25" RAT_FUNC "%.3f" "U/min" COEFFS 0 1 0 0 0 0.25 /end COMPU_METHOD
/begin COMPU_METHOD CM_0p01_0_s "scale 0.01" RAT_FUNC "%.3f" "s" COEFFS 0 1 0 0 0 0.01 /end COMPU_METHOD
/begin COMPU_METHOD CM_0p001953125_0 "scale 0.00195312" RAT_FUNC "%.3f" "%" COEFFS 0 1 0 0 0 0.001953125 /end COMPU_METHOD
/begin COMPU_METHOD CM_0p1960784314_0 "scale 0.196078" RAT_FUNC "%.3f" "%" COEFFS 0 1 0 0 0 0.1960784314 /end COMPU_METHOD
/begin COMPU_METHOD CM_0p003051757812_0 "scale 0.00305176" RAT_FUNC "%.3f" "%" COEFFS 0 1 0 0 0 0.003051757812 /end COMPU_METHOD
/begin COMPU_METHOD CM_0p0030515625_0_Umin "scale 0.00305156" RAT_FUNC "%.3f" "%/(U/min)" COEFFS 0 1 0 0 0 0.0030515625 /end COMPU_METHOD
/begin COMPU_METHOD CM_0p000244140625_0 "scale 0.000244141" RAT_FUNC "%.3f" "-" COEFFS 0 1 0 0 0 0.000244140625 /end COMPU_METHOD
/begin COMPU_METHOD CM_0p0015625_0_kgh "scale 0.0015625" RAT_FUNC "%.3f" "kg/h" COEFFS 0 1 0 0 0 0.0015625 /end COMPU_METHOD
/begin COMPU_METHOD CM_0p39063_0_Umins "scale 0.39063" RAT_FUNC "%.3f" "U/min/s" COEFFS 0 1 0 0 0 0.39063 /end COMPU_METHOD
/begin COMPU_METHOD CM_0p015625_0 "scale 0.015625" RAT_FUNC "%.3f" "-" COEFFS 0 1 0 0 0 0.015625 /end COMPU_METHOD
/begin COMPU_METHOD CM_0p09375_0 "scale 0.09375" RAT_FUNC "%.3f" "%" COEFFS 0 1 0 0 0 0.09375 /end COMPU_METHOD
/begin COMPU_METHOD CM_5p96En08_0_Min "scale 5.96e-08" RAT_FUNC "%.3f" "Min" COEFFS 0 1 0 0 0 5.96e-08 /end COMPU_METHOD
/begin COMPU_METHOD CM_3p051757812En05_0 "scale 3.05176e-05" RAT_FUNC "%.3f" "-" COEFFS 0 1 0 0 0 3.051757812e-05 /end COMPU_METHOD
/begin COMPU_METHOD CM_0p01220703125_0_Upm "scale 0.012207" RAT_FUNC "%.3f" "%/Upm" COEFFS 0 1 0 0 0 0.01220703125 /end COMPU_METHOD
/begin COMPU_METHOD CM_10_0_Umin "scale 10" RAT_FUNC "%.1f" "U/min" COEFFS 0 1 0 0 0 10 /end COMPU_METHOD
/begin COMPU_METHOD CM_0p09764705882_0 "scale 0.0976471" RAT_FUNC "%.3f" "%" COEFFS 0 1 0 0 0 0.09764705882 /end COMPU_METHOD
/begin COMPU_METHOD CM_0p75_48_GradC "scale 0.75" RAT_FUNC "%.3f" "Grad C" COEFFS 0 1 48 0 0 0.75 /end COMPU_METHOD
/begin COMPU_METHOD CM_5_0_GradC "scale 5" RAT_FUNC "%.1f" "Grad C" COEFFS 0 1 0 0 0 5 /end COMPU_METHOD
/begin COMPU_METHOD CM_0p3058103976_0_s "scale 0.30581" RAT_FUNC "%.3f" "%/s" COEFFS 0 1 0 0 0 0.3058103976 /end COMPU_METHOD
/begin COMPU_METHOD CM_0p005215686275_0p2_V "scale 0.00521569" RAT_FUNC "%.3f" "V" COEFFS 0 1 0.2 0 0 0.005215686275 /end COMPU_METHOD
/begin COMPU_METHOD CM_0p0390625_0_mss "scale 0.0390625" RAT_FUNC "%.3f" "ms/s" COEFFS 0 1 0 0 0 0.0390625 /end COMPU_METHOD
/begin COMPU_METHOD CM_0p75_0_GradKW "scale 0.75" RAT_FUNC "%.3f" "Grad KW" COEFFS 0 1 0 0 0 0.75 /end COMPU_METHOD
/begin COMPU_METHOD CM_1_n1 "scale 1" RAT_FUNC "%.1f" "-" COEFFS 0 1 -1 0 0 1 /end COMPU_METHOD
/begin COMPU_METHOD CM_1p25_0_V "scale 1.25" RAT_FUNC "%.1f" "V" COEFFS 0 1 0 0 0 1.25 /end COMPU_METHOD
/begin COMPU_METHOD CM_6_0_GradKW "scale 6" RAT_FUNC "%.1f" "Grad KW" COEFFS 0 1 0 0 0 6 /end COMPU_METHOD
/begin COMPU_METHOD CM_0p00048828125_0 "scale 0.000488281" RAT_FUNC "%.3f" "-" COEFFS 0 1 0 0 0 0.00048828125 /end COMPU_METHOD
/begin COMPU_METHOD CM_20_0_s "scale 20" RAT_FUNC "%.1f" "s" COEFFS 0 1 0 0 0 20 /end COMPU_METHOD
/begin COMPU_METHOD CM_0p07421875_0 "scale 0.0742188" RAT_FUNC "%.3f" "-" COEFFS 0 1 0 0 0 0.07421875 /end COMPU_METHOD
/begin COMPU_METHOD CM_0p0390625_0_hPa "scale 0.0390625" RAT_FUNC "%.3f" "hPa" COEFFS 0 1 0 0 0 0.0390625 /end COMPU_METHOD
/begin COMPU_METHOD CM_4p577636719En06_0_hPa "scale 4.57764e-06" RAT_FUNC "%.3f" "%/hPa" COEFFS 0 1 0 0 0 4.577636719e-06 /end COMPU_METHOD
/begin COMPU_METHOD CM_0p75_0_GradC "scale 0.75" RAT_FUNC "%.3f" "Grad C" COEFFS 0 1 0 0 0 0.75 /end COMPU_METHOD
/begin COMPU_METHOD CM_6p103515625En05_0 "scale 6.10352e-05" RAT_FUNC "%.3f" "-" COEFFS 0 1 0 0 0 6.103515625e-05 /end COMPU_METHOD
/begin COMPU_METHOD CM_0p05664148928_0_kJ "scale 0.0566415" RAT_FUNC "%.3f" "kJ" COEFFS 0 1 0 0 0 0.05664148928 /end COMPU_METHOD
/begin COMPU_METHOD CM_3p9062En05_0p05_s "scale 3.9062e-05" RAT_FUNC "%.3f" "s" COEFFS 0 1 0.05 0 0 3.9062e-05 /end COMPU_METHOD
/begin COMPU_METHOD CM_0p0195313_0_V "scale 0.0195313" RAT_FUNC "%.3f" "V" COEFFS 0 1 0 0 0 0.0195313 /end COMPU_METHOD
/begin COMPU_METHOD CM_0p1875_0 "scale 0.1875" RAT_FUNC "%.3f" "%" COEFFS 0 1 0 0 0 0.1875 /end COMPU_METHOD
/begin COMPU_METHOD CM_7p629394531En05_0_1s "scale 7.62939e-05" RAT_FUNC "%.3f" "1/s" COEFFS 0 1 0 0 0 7.629394531e-05 /end COMPU_METHOD
/begin COMPU_METHOD CM_0p0146484375_0_s "scale 0.0146484" RAT_FUNC "%.3f" "%/s" COEFFS 0 1 0 0 0 0.0146484375 /end COMPU_METHOD
/begin COMPU_METHOD CM_0p000732421875_0_GradC "scale 0.000732422" RAT_FUNC "%.3f" "Grad C" COEFFS 0 1 0 0 0 0.000732421875 /end COMPU_METHOD
/begin RECORD_LAYOUT RL_GRID_UBYTE FNC_VALUES 1 UBYTE ROW_DIR DIRECT /end RECORD_LAYOUT
/begin RECORD_LAYOUT RL_3D_A8_UBYTE NO_AXIS_PTS_Y 1 UBYTE NO_AXIS_PTS_X 2 UBYTE AXIS_PTS_Y 3 UBYTE INDEX_INCR DIRECT AXIS_PTS_X 4 UBYTE INDEX_INCR DIRECT FNC_VALUES 5 UBYTE ROW_DIR DIRECT /end RECORD_LAYOUT
/begin RECORD_LAYOUT RL_GRID_SBYTE FNC_VALUES 1 SBYTE ROW_DIR DIRECT /end RECORD_LAYOUT
/begin RECORD_LAYOUT RL_2D_A16_UWORD NO_AXIS_PTS_X 1 UBYTE AXIS_PTS_X 2 UWORD INDEX_INCR DIRECT FNC_VALUES 3 UWORD ROW_DIR DIRECT /end RECORD_LAYOUT
/begin RECORD_LAYOUT RL_2D_A8_UBYTE NO_AXIS_PTS_X 1 UBYTE AXIS_PTS_X 2 UBYTE INDEX_INCR DIRECT FNC_VALUES 3 UBYTE ROW_DIR DIRECT /end RECORD_LAYOUT
/begin RECORD_LAYOUT RL_3D_A8_UWORD NO_AXIS_PTS_Y 1 UBYTE NO_AXIS_PTS_X 2 UBYTE AXIS_PTS_Y 3 UBYTE INDEX_INCR DIRECT AXIS_PTS_X 4 UBYTE INDEX_INCR DIRECT FNC_VALUES 5 UWORD ROW_DIR DIRECT /end RECORD_LAYOUT
/begin RECORD_LAYOUT RL_2D_A8_UWORD NO_AXIS_PTS_X 1 UBYTE AXIS_PTS_X 2 UBYTE INDEX_INCR DIRECT FNC_VALUES 3 UWORD ROW_DIR DIRECT /end RECORD_LAYOUT
/begin RECORD_LAYOUT RL_GRID_UWORD FNC_VALUES 1 UWORD ROW_DIR DIRECT /end RECORD_LAYOUT
/begin RECORD_LAYOUT RL_3D_A16_UWORD NO_AXIS_PTS_Y 1 UBYTE NO_AXIS_PTS_X 2 UBYTE AXIS_PTS_Y 3 UWORD INDEX_INCR DIRECT AXIS_PTS_X 4 UWORD INDEX_INCR DIRECT FNC_VALUES 5 UWORD ROW_DIR DIRECT /end RECORD_LAYOUT
/begin RECORD_LAYOUT RL_GRID_SWORD FNC_VALUES 1 SWORD ROW_DIR DIRECT /end RECORD_LAYOUT
/begin RECORD_LAYOUT RL_2D_A16_UBYTE NO_AXIS_PTS_X 1 UBYTE AXIS_PTS_X 2 UWORD INDEX_INCR DIRECT FNC_VALUES 3 UBYTE ROW_DIR DIRECT /end RECORD_LAYOUT
/begin CHARACTERISTIC SNG06LLSB "veroyatnaya damos-veroyatno addr 0x10085 | Datapoint distribution, speed gradient, 6 datapoints" CURVE 0x10085 RL_GRID_UBYTE 0 CM_IDENTITY 0 255
 /begin AXIS_DESCR FIX_AXIS NO_INPUT_QUANTITY CM_IDENTITY 6 0 5 FIX_AXIS_PAR_DIST 0 1 6 /end AXIS_DESCR
/end CHARACTERISTIC
/begin CHARACTERISTIC NARASTG "veroyatnaya damos-veroyatno addr 0x101E9 | RPM threshold in higher gear for AR active" CURVE 0x101E9 RL_GRID_UBYTE 0 CM_40_0_Upm 0 10200
 /begin AXIS_DESCR FIX_AXIS NO_INPUT_QUANTITY CM_IDENTITY 6 0 5 FIX_AXIS_PAR_DIST 0 1 6 /end AXIS_DESCR
/end CHARACTERISTIC
/begin CHARACTERISTIC RLMNN "veroyatnaya damos-veroyatno addr 0x1060D | characteristic minimum charge" CURVE 0x1060D RL_GRID_UBYTE 0 CM_0p75_0 0 191.25
 /begin AXIS_DESCR FIX_AXIS NO_INPUT_QUANTITY CM_IDENTITY 10 0 9 FIX_AXIS_PAR_DIST 0 1 10 /end AXIS_DESCR
/end CHARACTERISTIC
/begin CHARACTERISTIC RLMNSAN "veroyatnaya damos-veroyatno addr 0x10617 | characteristic minimum charge in overrun" CURVE 0x10617 RL_GRID_UBYTE 0 CM_0p75_0 0 191.25
 /begin AXIS_DESCR FIX_AXIS NO_INPUT_QUANTITY CM_IDENTITY 10 0 9 FIX_AXIS_PAR_DIST 0 1 10 /end AXIS_DESCR
/end CHARACTERISTIC
/begin CHARACTERISTIC KFMIRED "veroyatnaya damos-veroyatno addr 0x10622 | Map of decreasing control torque for VMAX control" MAP 0x10622 RL_GRID_UBYTE 0 CM_0p390625_0 0 99.6094
 /begin AXIS_DESCR FIX_AXIS NO_INPUT_QUANTITY CM_IDENTITY 3 0 2 FIX_AXIS_PAR_DIST 0 1 3 /end AXIS_DESCR
 /begin AXIS_DESCR FIX_AXIS NO_INPUT_QUANTITY CM_IDENTITY 2 0 1 FIX_AXIS_PAR_DIST 0 1 2 /end AXIS_DESCR
/end CHARACTERISTIC
/begin CHARACTERISTIC FSWALUV "veroyatnaya damos-veroyatno addr 0x10631 | rough road detection threshold = f (vehicle speed)" CURVE 0x10631 RL_GRID_UBYTE 0 CM_0p09803921569_0 0 25
 /begin AXIS_DESCR FIX_AXIS NO_INPUT_QUANTITY CM_IDENTITY 4 0 3 FIX_AXIS_PAR_DIST 0 1 4 /end AXIS_DESCR
/end CHARACTERISTIC
/begin CHARACTERISTIC FUGKUE "veroyatnaya damos-veroyatno addr 0x10639 | Gear box ratio detection" CURVE 0x10639 RL_GRID_UBYTE 0 CM_IDENTITY 0 255
 /begin AXIS_DESCR FIX_AXIS NO_INPUT_QUANTITY CM_IDENTITY 255 0 254 FIX_AXIS_PAR_DIST 0 1 255 /end AXIS_DESCR
/end CHARACTERISTIC
/begin CHARACTERISTIC ZDSH1GS "veroyatnaya damos-veroyatno addr 0x1085C | time constant for dash pot decay speed (geardependent)" CURVE 0x1085C RL_GRID_UBYTE 0 CM_IDENTITY 0 255
 /begin AXIS_DESCR FIX_AXIS NO_INPUT_QUANTITY CM_IDENTITY 6 0 5 FIX_AXIS_PAR_DIST 0 1 6 /end AXIS_DESCR
/end CHARACTERISTIC
/begin CHARACTERISTIC ZDSHGS "veroyatnaya damos-veroyatno addr 0x10862 | time constant for dash pot decay speed (geardependent)" CURVE 0x10862 RL_GRID_UBYTE 0 CM_IDENTITY 0 255
 /begin AXIS_DESCR FIX_AXIS NO_INPUT_QUANTITY CM_IDENTITY 6 0 5 FIX_AXIS_PAR_DIST 0 1 6 /end AXIS_DESCR
/end CHARACTERISTIC
/begin CHARACTERISTIC MAP_056_10D9A_6 "veroyatnaya mapscan addr 0x10D9A" CURVE 0x10D9A RL_2D_A16_UWORD 0 CM_IDENTITY 0 65535 /begin AXIS_DESCR STD_AXIS NO_INPUT_QUANTITY CM_IDENTITY 6 0 65535 /end AXIS_DESCR /end CHARACTERISTIC
/begin CHARACTERISTIC SNS06LLSB "veroyatnaya damos-veroyatno addr 0x10F01 | Datapoint distribution, set-speed deviation, 06 datapoints., idle-speed control." CURVE 0x10F01 RL_GRID_UBYTE 0 CM_IDENTITY 0 255
 /begin AXIS_DESCR FIX_AXIS NO_INPUT_QUANTITY CM_IDENTITY 6 0 5 FIX_AXIS_PAR_DIST 0 1 6 /end AXIS_DESCR
/end CHARACTERISTIC
/begin CHARACTERISTIC ZNSMST "veroyatnaya damos-veroyatno addr 0x10F14 | time constant for decay of reference speed at start" CURVE 0x10F14 RL_GRID_UBYTE 0 CM_IDENTITY 0 255
 /begin AXIS_DESCR FIX_AXIS NO_INPUT_QUANTITY CM_IDENTITY 6 0 5 FIX_AXIS_PAR_DIST 0 1 6 /end AXIS_DESCR
/end CHARACTERISTIC
/begin CHARACTERISTIC DMLLRIMXN "veroyatnaya damos-veroyatno addr 0x10F1B | Safety concept: upper limit for dmllri" CURVE 0x10F1B RL_GRID_UBYTE 0 CM_0p390625_0 0 99.6094
 /begin AXIS_DESCR FIX_AXIS NO_INPUT_QUANTITY CM_IDENTITY 6 0 5 FIX_AXIS_PAR_DIST 0 1 6 /end AXIS_DESCR
/end CHARACTERISTIC
/begin CHARACTERISTIC DMLLRLMNN "veroyatnaya damos-veroyatno addr 0x10F21 | Lower limit for dmllrl" CURVE 0x10F21 RL_GRID_SBYTE 0 CM_0p3906_0 -49.9968 49.6062
 /begin AXIS_DESCR FIX_AXIS NO_INPUT_QUANTITY CM_IDENTITY 6 0 5 FIX_AXIS_PAR_DIST 0 1 6 /end AXIS_DESCR
/end CHARACTERISTIC
/begin CHARACTERISTIC DMLLRLMXN "veroyatnaya damos-veroyatno addr 0x10F27 | Safety concept: upper limit for dmllrl" CURVE 0x10F27 RL_GRID_UBYTE 0 CM_0p390625_0 0 99.6094
 /begin AXIS_DESCR FIX_AXIS NO_INPUT_QUANTITY CM_IDENTITY 6 0 5 FIX_AXIS_PAR_DIST 0 1 6 /end AXIS_DESCR
/end CHARACTERISTIC
/begin CHARACTERISTIC DMLLRMNN "veroyatnaya damos-veroyatno addr 0x10F2D | Lower limit for dmllr_w" CURVE 0x10F2D RL_GRID_SBYTE 0 CM_0p3906_0 -49.9968 49.6062
 /begin AXIS_DESCR FIX_AXIS NO_INPUT_QUANTITY CM_IDENTITY 6 0 5 FIX_AXIS_PAR_DIST 0 1 6 /end AXIS_DESCR
/end CHARACTERISTIC
/begin CHARACTERISTIC DMLLRMXN "veroyatnaya damos-veroyatno addr 0x10F33 | Safety concept: upper limit for dmllr" CURVE 0x10F33 RL_GRID_UBYTE 0 CM_0p390625_0 0 99.6094
 /begin AXIS_DESCR FIX_AXIS NO_INPUT_QUANTITY CM_IDENTITY 6 0 5 FIX_AXIS_PAR_DIST 0 1 6 /end AXIS_DESCR
/end CHARACTERISTIC
/begin CHARACTERISTIC DVNG "veroyatnaya damos-veroyatno addr 0x10F3B | LLR: D-gain depending of ngfil for vehicle at rest" CURVE 0x10F3B RL_GRID_SBYTE 0 CM_n0p00048828125_0_sUmin -0.0620117 0.0625
 /begin AXIS_DESCR FIX_AXIS NO_INPUT_QUANTITY CM_IDENTITY 6 0 5 FIX_AXIS_PAR_DIST 0 1 6 /end AXIS_DESCR
/end CHARACTERISTIC
/begin CHARACTERISTIC DVNGV "veroyatnaya damos-veroyatno addr 0x10F41 | LLR: D-gain depending of ngfil for vehicle rolling" CURVE 0x10F41 RL_GRID_SBYTE 0 CM_n0p00048828125_0_sUmin -0.0620117 0.0625
 /begin AXIS_DESCR FIX_AXIS NO_INPUT_QUANTITY CM_IDENTITY 6 0 5 FIX_AXIS_PAR_DIST 0 1 6 /end AXIS_DESCR
/end CHARACTERISTIC
/begin CHARACTERISTIC FDDN "veroyatnaya damos-veroyatno addr 0x10F47 | LLR: weightning factor for D-amplification" CURVE 0x10F47 RL_GRID_UBYTE 0 CM_0p00390625_0 0 0.996094
 /begin AXIS_DESCR FIX_AXIS NO_INPUT_QUANTITY CM_IDENTITY 6 0 5 FIX_AXIS_PAR_DIST 0 1 6 /end AXIS_DESCR
/end CHARACTERISTIC
/begin CHARACTERISTIC GFDLDN "veroyatnaya damos-veroyatno addr 0x10F4E | LLR: weightning factor for D-amplification on the air path" CURVE 0x10F4E RL_GRID_UBYTE 0 CM_0p00390625_0 0 0.996094
 /begin AXIS_DESCR FIX_AXIS NO_INPUT_QUANTITY CM_IDENTITY 6 0 5 FIX_AXIS_PAR_DIST 0 1 6 /end AXIS_DESCR
/end CHARACTERISTIC
/begin CHARACTERISTIC IVDN "veroyatnaya damos-veroyatno addr 0x10F54 | LLR: I-gain for vehicle at rest" CURVE 0x10F54 RL_GRID_UBYTE 0 CM_0p0023828125_0_sUmin 0 0.607617
 /begin AXIS_DESCR FIX_AXIS NO_INPUT_QUANTITY CM_IDENTITY 6 0 5 FIX_AXIS_PAR_DIST 0 1 6 /end AXIS_DESCR
/end CHARACTERISTIC
/begin CHARACTERISTIC IVDNDTE "veroyatnaya damos-veroyatno addr 0x10F5A | LLR: I-gain at DTEV" CURVE 0x10F5A RL_GRID_UBYTE 0 CM_0p0023828125_0_sUmin 0 0.607617
 /begin AXIS_DESCR FIX_AXIS NO_INPUT_QUANTITY CM_IDENTITY 6 0 5 FIX_AXIS_PAR_DIST 0 1 6 /end AXIS_DESCR
/end CHARACTERISTIC
/begin CHARACTERISTIC PVDN "veroyatnaya damos-veroyatno addr 0x10F71 | LLR: P-gain for vehicle at rest" CURVE 0x10F71 RL_GRID_UBYTE 0 CM_0p001525878906_0 0 0.389099
 /begin AXIS_DESCR FIX_AXIS NO_INPUT_QUANTITY CM_IDENTITY 6 0 5 FIX_AXIS_PAR_DIST 0 1 6 /end AXIS_DESCR
/end CHARACTERISTIC
/begin CHARACTERISTIC PVLDN "veroyatnaya damos-veroyatno addr 0x10F83 | LLR: P-gain for vehicle at rest (air path)" CURVE 0x10F83 RL_GRID_UBYTE 0 CM_0p001525878906_0 0 0.389099
 /begin AXIS_DESCR FIX_AXIS NO_INPUT_QUANTITY CM_IDENTITY 6 0 5 FIX_AXIS_PAR_DIST 0 1 6 /end AXIS_DESCR
/end CHARACTERISTIC
/begin CHARACTERISTIC PVLDNV "veroyatnaya damos-veroyatno addr 0x10F89 | LLR: P-gain for vehicle at rest (air path)" CURVE 0x10F89 RL_GRID_UBYTE 0 CM_0p001525878906_0 0 0.389099
 /begin AXIS_DESCR FIX_AXIS NO_INPUT_QUANTITY CM_IDENTITY 6 0 5 FIX_AXIS_PAR_DIST 0 1 6 /end AXIS_DESCR
/end CHARACTERISTIC
/begin CHARACTERISTIC SDN06LLSB "veroyatnaya damos-veroyatno addr 0x10F8F | 10 Sst." CURVE 0x10F8F RL_GRID_UBYTE 0 CM_IDENTITY 0 255
 /begin AXIS_DESCR FIX_AXIS NO_INPUT_QUANTITY CM_IDENTITY 6 0 5 FIX_AXIS_PAR_DIST 0 1 6 /end AXIS_DESCR
/end CHARACTERISTIC
/begin CHARACTERISTIC SNS206LLSB "veroyatnaya damos-veroyatno addr 0x10F96" CURVE 0x10F96 RL_GRID_UBYTE 0 CM_IDENTITY 0 255
 /begin AXIS_DESCR FIX_AXIS NO_INPUT_QUANTITY CM_IDENTITY 6 0 5 FIX_AXIS_PAR_DIST 0 1 6 /end AXIS_DESCR
/end CHARACTERISTIC
/begin CHARACTERISTIC TVFSAM "veroyatnaya damos-veroyatno addr 0x10FC9 | Delay time after DRIVE-position switch off" CURVE 0x10FC9 RL_GRID_UBYTE 0 CM_0p02_0_s 0 5.1
 /begin AXIS_DESCR FIX_AXIS NO_INPUT_QUANTITY CM_IDENTITY 6 0 5 FIX_AXIS_PAR_DIST 0 1 6 /end AXIS_DESCR
/end CHARACTERISTIC
/begin CHARACTERISTIC TVFSAMR "veroyatnaya damos-veroyatno addr 0x10FCF | delay time after DRIVE-position switch off (Reverse)" CURVE 0x10FCF RL_GRID_UBYTE 0 CM_0p02_0_s 0 5.1
 /begin AXIS_DESCR FIX_AXIS NO_INPUT_QUANTITY CM_IDENTITY 6 0 5 FIX_AXIS_PAR_DIST 0 1 6 /end AXIS_DESCR
/end CHARACTERISTIC
/begin CHARACTERISTIC TVFSEM "veroyatnaya damos-veroyatno addr 0x10FD5 | delay time after DRIVE-position switch on" CURVE 0x10FD5 RL_GRID_UBYTE 0 CM_0p02_0_s 0 5.1
 /begin AXIS_DESCR FIX_AXIS NO_INPUT_QUANTITY CM_IDENTITY 6 0 5 FIX_AXIS_PAR_DIST 0 1 6 /end AXIS_DESCR
/end CHARACTERISTIC
/begin CHARACTERISTIC TVFSEMR "veroyatnaya damos-veroyatno addr 0x10FDB | delay time after DRIVE-position switch on (Reverse)" CURVE 0x10FDB RL_GRID_UBYTE 0 CM_0p02_0_s 0 5.1
 /begin AXIS_DESCR FIX_AXIS NO_INPUT_QUANTITY CM_IDENTITY 6 0 5 FIX_AXIS_PAR_DIST 0 1 6 /end AXIS_DESCR
/end CHARACTERISTIC
/begin CHARACTERISTIC UEVERG "veroyatnaya damos-veroyatno addr 0x10FE2 | Gear ratio depending of the gear" CURVE 0x10FE2 RL_GRID_UBYTE 0 CM_0p0625_0 0 15.9375
 /begin AXIS_DESCR FIX_AXIS NO_INPUT_QUANTITY CM_IDENTITY 14 0 13 FIX_AXIS_PAR_DIST 0 1 14 /end AXIS_DESCR
/end CHARACTERISTIC
/begin CHARACTERISTIC ZKMDWAM "veroyatnaya damos-veroyatno addr 0x10FF0 | Time constant for converter torque change" CURVE 0x10FF0 RL_GRID_UBYTE 0 CM_IDENTITY 0 255
 /begin AXIS_DESCR FIX_AXIS NO_INPUT_QUANTITY CM_IDENTITY 6 0 5 FIX_AXIS_PAR_DIST 0 1 6 /end AXIS_DESCR
/end CHARACTERISTIC
/begin CHARACTERISTIC FZN0 "veroyatnaya damos-veroyatno addr 0x10FF8 | Cylinder individual factor at neutral camshaft position EV 1" CURVE 0x10FF8 RL_GRID_UBYTE 0 CM_0p001953125_n0p75 0.75 1.24805
 /begin AXIS_DESCR FIX_AXIS NO_INPUT_QUANTITY CM_IDENTITY 16 0 15 FIX_AXIS_PAR_DIST 0 1 16 /end AXIS_DESCR
/end CHARACTERISTIC
/begin CHARACTERISTIC FZN1 "veroyatnaya damos-veroyatno addr 0x11008 | Cylinder individual factor at neutral camshaft position EV 1" CURVE 0x11008 RL_GRID_UBYTE 0 CM_0p001953125_n0p75 0.75 1.24805
 /begin AXIS_DESCR FIX_AXIS NO_INPUT_QUANTITY CM_IDENTITY 16 0 15 FIX_AXIS_PAR_DIST 0 1 16 /end AXIS_DESCR
/end CHARACTERISTIC
/begin CHARACTERISTIC FZN2 "veroyatnaya damos-veroyatno addr 0x11018 | Cylinder individual factor at neutral camshaft position EV 2" CURVE 0x11018 RL_GRID_UBYTE 0 CM_0p001953125_n0p75 0.75 1.24805
 /begin AXIS_DESCR FIX_AXIS NO_INPUT_QUANTITY CM_IDENTITY 16 0 15 FIX_AXIS_PAR_DIST 0 1 16 /end AXIS_DESCR
/end CHARACTERISTIC
/begin CHARACTERISTIC FZN3 "veroyatnaya damos-veroyatno addr 0x11028 | Cylinder individual factor at neutral camshaft position EV 3" CURVE 0x11028 RL_GRID_UBYTE 0 CM_0p001953125_n0p75 0.75 1.24805
 /begin AXIS_DESCR FIX_AXIS NO_INPUT_QUANTITY CM_IDENTITY 16 0 15 FIX_AXIS_PAR_DIST 0 1 16 /end AXIS_DESCR
/end CHARACTERISTIC
/begin CHARACTERISTIC FZN4 "veroyatnaya damos-veroyatno addr 0x11038 | Cylinder individual factor at neutral camshaft position EV 4" CURVE 0x11038 RL_GRID_UBYTE 0 CM_0p001953125_n0p75 0.75 1.24805
 /begin AXIS_DESCR FIX_AXIS NO_INPUT_QUANTITY CM_IDENTITY 16 0 15 FIX_AXIS_PAR_DIST 0 1 16 /end AXIS_DESCR
/end CHARACTERISTIC
/begin CHARACTERISTIC FZN5 "veroyatnaya damos-veroyatno addr 0x11048 | Cylinder individual factor at neutral camshaft position EV 5" CURVE 0x11048 RL_GRID_UBYTE 0 CM_0p001953125_n0p75 0.75 1.24805
 /begin AXIS_DESCR FIX_AXIS NO_INPUT_QUANTITY CM_IDENTITY 16 0 15 FIX_AXIS_PAR_DIST 0 1 16 /end AXIS_DESCR
/end CHARACTERISTIC
/begin CHARACTERISTIC FZN6 "veroyatnaya damos-veroyatno addr 0x11058 | Cylinder individual factor at neutral camshaft position EV 6" CURVE 0x11058 RL_GRID_UBYTE 0 CM_0p001953125_n0p75 0.75 1.24805
 /begin AXIS_DESCR FIX_AXIS NO_INPUT_QUANTITY CM_IDENTITY 16 0 15 FIX_AXIS_PAR_DIST 0 1 16 /end AXIS_DESCR
/end CHARACTERISTIC
/begin CHARACTERISTIC FZN7 "veroyatnaya damos-veroyatno addr 0x11068 | Cylinder individual factor at neutral camshaft position EV 7" CURVE 0x11068 RL_GRID_UBYTE 0 CM_0p001953125_n0p75 0.75 1.24805
 /begin AXIS_DESCR FIX_AXIS NO_INPUT_QUANTITY CM_IDENTITY 16 0 15 FIX_AXIS_PAR_DIST 0 1 16 /end AXIS_DESCR
/end CHARACTERISTIC
/begin CHARACTERISTIC FZNWN0 "veroyatnaya damos-veroyatno addr 0x11078 | Cylinder individual factor at active camshaft position EV 1" CURVE 0x11078 RL_GRID_UBYTE 0 CM_0p001953125_n0p75 0.75 1.24805
 /begin AXIS_DESCR FIX_AXIS NO_INPUT_QUANTITY CM_IDENTITY 16 0 15 FIX_AXIS_PAR_DIST 0 1 16 /end AXIS_DESCR
/end CHARACTERISTIC
/begin CHARACTERISTIC FZNWN1 "veroyatnaya damos-veroyatno addr 0x11088 | Cylinder individual factor at active camshaft position EV 1" CURVE 0x11088 RL_GRID_UBYTE 0 CM_0p001953125_n0p75 0.75 1.24805
 /begin AXIS_DESCR FIX_AXIS NO_INPUT_QUANTITY CM_IDENTITY 16 0 15 FIX_AXIS_PAR_DIST 0 1 16 /end AXIS_DESCR
/end CHARACTERISTIC
/begin CHARACTERISTIC FZNWN2 "veroyatnaya damos-veroyatno addr 0x11098 | Cylinder individual factor at active camshaft position EV 2" CURVE 0x11098 RL_GRID_UBYTE 0 CM_0p001953125_n0p75 0.75 1.24805
 /begin AXIS_DESCR FIX_AXIS NO_INPUT_QUANTITY CM_IDENTITY 16 0 15 FIX_AXIS_PAR_DIST 0 1 16 /end AXIS_DESCR
/end CHARACTERISTIC
/begin CHARACTERISTIC FZNWN3 "veroyatnaya damos-veroyatno addr 0x110A8 | Cylinder individual factor at active camshaft position EV 3" CURVE 0x110A8 RL_GRID_UBYTE 0 CM_0p001953125_n0p75 0.75 1.24805
 /begin AXIS_DESCR FIX_AXIS NO_INPUT_QUANTITY CM_IDENTITY 16 0 15 FIX_AXIS_PAR_DIST 0 1 16 /end AXIS_DESCR
/end CHARACTERISTIC
/begin CHARACTERISTIC FZNWN4 "veroyatnaya damos-veroyatno addr 0x1110C | Cylinder individual factor at active camshaft position EV 4" CURVE 0x1110C RL_GRID_UBYTE 0 CM_0p001953125_n0p75 0.75 1.24805
 /begin AXIS_DESCR FIX_AXIS NO_INPUT_QUANTITY CM_IDENTITY 16 0 15 FIX_AXIS_PAR_DIST 0 1 16 /end AXIS_DESCR
/end CHARACTERISTIC
/begin CHARACTERISTIC FZNWN5 "veroyatnaya damos-veroyatno addr 0x1111C | Cylinder individual factor at active camshaft position EV 5" CURVE 0x1111C RL_GRID_UBYTE 0 CM_0p001953125_n0p75 0.75 1.24805
 /begin AXIS_DESCR FIX_AXIS NO_INPUT_QUANTITY CM_IDENTITY 16 0 15 FIX_AXIS_PAR_DIST 0 1 16 /end AXIS_DESCR
/end CHARACTERISTIC
/begin CHARACTERISTIC FZNWN6 "veroyatnaya damos-veroyatno addr 0x1112C | Cylinder individual factor at active camshaft position EV 6" CURVE 0x1112C RL_GRID_UBYTE 0 CM_0p001953125_n0p75 0.75 1.24805
 /begin AXIS_DESCR FIX_AXIS NO_INPUT_QUANTITY CM_IDENTITY 16 0 15 FIX_AXIS_PAR_DIST 0 1 16 /end AXIS_DESCR
/end CHARACTERISTIC
/begin CHARACTERISTIC FZNWN7 "veroyatnaya damos-veroyatno addr 0x1113C | Cylinder individual factor at active camshaft position EV 7" CURVE 0x1113C RL_GRID_UBYTE 0 CM_0p001953125_n0p75 0.75 1.24805
 /begin AXIS_DESCR FIX_AXIS NO_INPUT_QUANTITY CM_IDENTITY 16 0 15 FIX_AXIS_PAR_DIST 0 1 16 /end AXIS_DESCR
/end CHARACTERISTIC
/begin CHARACTERISTIC KFWHSTT "veroyatnaya damos-veroyatno addr 0x11156 | map weighting of hot start factor" MAP 0x11156 RL_GRID_UBYTE 0 CM_0p0078125_0 0 1.99219
 /begin AXIS_DESCR FIX_AXIS NO_INPUT_QUANTITY CM_IDENTITY 6 0 5 FIX_AXIS_PAR_DIST 0 1 6 /end AXIS_DESCR
 /begin AXIS_DESCR FIX_AXIS NO_INPUT_QUANTITY CM_IDENTITY 6 0 5 FIX_AXIS_PAR_DIST 0 1 6 /end AXIS_DESCR
/end CHARACTERISTIC
/begin CHARACTERISTIC KFWKSTN "veroyatnaya damos-veroyatno addr 0x11184 | map weighting of factor cold start" MAP 0x11184 RL_GRID_UBYTE 0 CM_0p00390625_0 0 0.996094
 /begin AXIS_DESCR FIX_AXIS NO_INPUT_QUANTITY CM_IDENTITY 4 0 3 FIX_AXIS_PAR_DIST 0 1 4 /end AXIS_DESCR
 /begin AXIS_DESCR FIX_AXIS NO_INPUT_QUANTITY CM_IDENTITY 4 0 3 FIX_AXIS_PAR_DIST 0 1 4 /end AXIS_DESCR
/end CHARACTERISTIC
/begin CHARACTERISTIC FWSTAS2 "veroyatnaya damos-veroyatno addr 0x11223 | correction of threshold 2 for afterstart" CURVE 0x11223 RL_GRID_UBYTE 0 CM_0p0078125_0 0 1.99219
 /begin AXIS_DESCR FIX_AXIS NO_INPUT_QUANTITY CM_IDENTITY 6 0 5 FIX_AXIS_PAR_DIST 0 1 6 /end AXIS_DESCR
/end CHARACTERISTIC
/begin CHARACTERISTIC LZFUER "veroyatnaya damos-veroyatno addr 0x1122D | guide cylinder assignment" CURVE 0x1122D RL_GRID_UBYTE 0 CM_IDENTITY 0 255
 /begin AXIS_DESCR FIX_AXIS NO_INPUT_QUANTITY CM_IDENTITY 8 0 7 FIX_AXIS_PAR_DIST 0 1 8 /end AXIS_DESCR
/end CHARACTERISTIC
/begin CHARACTERISTIC WKRLZOF "veroyatnaya damos-veroyatno addr 0x11235 | Bloc of fixed values: ignition reatard offset for guided cylinder" CURVE 0x11235 RL_GRID_SBYTE 0 CM_n0p75_0_gradKW -95.25 96
 /begin AXIS_DESCR FIX_AXIS NO_INPUT_QUANTITY CM_IDENTITY 8 0 7 FIX_AXIS_PAR_DIST 0 1 8 /end AXIS_DESCR
/end CHARACTERISTIC
/begin CHARACTERISTIC WDKNLN "veroyatnaya damos-veroyatno addr 0x1124E | limp home throttle plate angle" CURVE 0x1124E RL_GRID_UBYTE 0 CM_0p3921568627_0_DK 0 100
 /begin AXIS_DESCR FIX_AXIS NO_INPUT_QUANTITY CM_IDENTITY 6 0 5 FIX_AXIS_PAR_DIST 0 1 6 /end AXIS_DESCR
/end CHARACTERISTIC
/begin CHARACTERISTIC FHSTT "veroyatnaya damos-veroyatno addr 0x112BA | factor hot start" CURVE 0x112BA RL_GRID_UBYTE 0 CM_0p25_0 0 63.75
 /begin AXIS_DESCR FIX_AXIS NO_INPUT_QUANTITY CM_IDENTITY 6 0 5 FIX_AXIS_PAR_DIST 0 1 6 /end AXIS_DESCR
/end CHARACTERISTIC
/begin CHARACTERISTIC MAP_115_112C2_14 "veroyatnaya mapscan addr 0x112C2" CURVE 0x112C2 RL_2D_A8_UBYTE 0 CM_IDENTITY 0 255 /begin AXIS_DESCR STD_AXIS NO_INPUT_QUANTITY CM_IDENTITY 14 0 255 /end AXIS_DESCR /end CHARACTERISTIC
/begin CHARACTERISTIC MAP_117_113A3_14x14 "veroyatnaya mapscan addr 0x113A3" MAP 0x113A3 RL_3D_A8_UWORD 0 CM_IDENTITY 0 65535 /begin AXIS_DESCR STD_AXIS NO_INPUT_QUANTITY CM_IDENTITY 14 0 255 /end AXIS_DESCR /begin AXIS_DESCR STD_AXIS NO_INPUT_QUANTITY CM_IDENTITY 14 0 255 /end AXIS_DESCR /end CHARACTERISTIC
/begin CHARACTERISTIC TKOAMXN "veroyatnaya damos-veroyatno addr 0x11550 | maximum shutdown time for air-conditioning compressor" CURVE 0x11550 RL_GRID_UBYTE 0 CM_0p2_0_s 0 51
 /begin AXIS_DESCR FIX_AXIS NO_INPUT_QUANTITY CM_IDENTITY 8 0 7 FIX_AXIS_PAR_DIST 0 1 8 /end AXIS_DESCR
/end CHARACTERISTIC
/begin CHARACTERISTIC TKOEMNN "veroyatnaya damos-veroyatno addr 0x11558 | minimal time of air-condition compressor beeing swiched on" CURVE 0x11558 RL_GRID_UBYTE 0 CM_0p2_0_s 0 51
 /begin AXIS_DESCR FIX_AXIS NO_INPUT_QUANTITY CM_IDENTITY 8 0 7 FIX_AXIS_PAR_DIST 0 1 8 /end AXIS_DESCR
/end CHARACTERISTIC
/begin CHARACTERISTIC MAP_120_11567_8 "veroyatnaya mapscan addr 0x11567" CURVE 0x11567 RL_2D_A8_UBYTE 0 CM_IDENTITY 0 255 /begin AXIS_DESCR STD_AXIS NO_INPUT_QUANTITY CM_IDENTITY 8 0 255 /end AXIS_DESCR /end CHARACTERISTIC
/begin CHARACTERISTIC FVRMDYN "veroyatnaya damos-veroyatno addr 0x11579 | dynamic factor for purge flow in the manifold with fresh air" CURVE 0x11579 RL_GRID_UBYTE 0 CM_0p03125_0 0 7.96875
 /begin AXIS_DESCR FIX_AXIS NO_INPUT_QUANTITY CM_IDENTITY 5 0 4 FIX_AXIS_PAR_DIST 0 1 5 /end AXIS_DESCR
/end CHARACTERISTIC
/begin CHARACTERISTIC MAP_123_11595_8 "veroyatnaya mapscan addr 0x11595" CURVE 0x11595 RL_2D_A8_UBYTE 0 CM_IDENTITY 0 255 /begin AXIS_DESCR STD_AXIS NO_INPUT_QUANTITY CM_IDENTITY 8 0 255 /end AXIS_DESCR /end CHARACTERISTIC
/begin CHARACTERISTIC MAP_124_115EC_7 "veroyatnaya mapscan addr 0x115EC" CURVE 0x115EC RL_2D_A8_UBYTE 0 CM_IDENTITY 0 255 /begin AXIS_DESCR STD_AXIS NO_INPUT_QUANTITY CM_IDENTITY 7 0 255 /end AXIS_DESCR /end CHARACTERISTIC
/begin CHARACTERISTIC MAP_125_115FB_7 "veroyatnaya mapscan addr 0x115FB" CURVE 0x115FB RL_2D_A8_UBYTE 0 CM_IDENTITY 0 255 /begin AXIS_DESCR STD_AXIS NO_INPUT_QUANTITY CM_IDENTITY 7 0 255 /end AXIS_DESCR /end CHARACTERISTIC
/begin CHARACTERISTIC FAGRH "veroyatnaya damos-veroyatno addr 0x11612 | altitude correction of EGR set value" CURVE 0x11612 RL_GRID_UBYTE 0 CM_0p0078125_0 0 1.99219
 /begin AXIS_DESCR FIX_AXIS NO_INPUT_QUANTITY CM_IDENTITY 4 0 3 FIX_AXIS_PAR_DIST 0 1 4 /end AXIS_DESCR
/end CHARACTERISTIC
/begin CHARACTERISTIC MAP_127_11616_8 "veroyatnaya mapscan addr 0x11616" CURVE 0x11616 RL_2D_A8_UBYTE 0 CM_IDENTITY 0 255 /begin AXIS_DESCR STD_AXIS NO_INPUT_QUANTITY CM_IDENTITY 8 0 255 /end AXIS_DESCR /end CHARACTERISTIC
/begin CHARACTERISTIC MAP_128_11673_6 "veroyatnaya mapscan addr 0x11673" CURVE 0x11673 RL_2D_A8_UBYTE 0 CM_IDENTITY 0 255 /begin AXIS_DESCR STD_AXIS NO_INPUT_QUANTITY CM_IDENTITY 6 0 255 /end AXIS_DESCR /end CHARACTERISTIC
/begin CHARACTERISTIC MAP_129_1168B_6 "veroyatnaya mapscan addr 0x1168B" CURVE 0x1168B RL_2D_A8_UBYTE 0 CM_IDENTITY 0 255 /begin AXIS_DESCR STD_AXIS NO_INPUT_QUANTITY CM_IDENTITY 6 0 255 /end AXIS_DESCR /end CHARACTERISTIC
/begin CHARACTERISTIC MAP_130_11698_12 "veroyatnaya mapscan addr 0x11698" CURVE 0x11698 RL_2D_A8_UBYTE 0 CM_IDENTITY 0 255 /begin AXIS_DESCR STD_AXIS NO_INPUT_QUANTITY CM_IDENTITY 12 0 255 /end AXIS_DESCR /end CHARACTERISTIC
/begin CHARACTERISTIC MAP_131_116B2_6x6 "veroyatnaya mapscan addr 0x116B2" MAP 0x116B2 RL_3D_A8_UBYTE 0 CM_IDENTITY 0 255 /begin AXIS_DESCR STD_AXIS NO_INPUT_QUANTITY CM_IDENTITY 6 0 255 /end AXIS_DESCR /begin AXIS_DESCR STD_AXIS NO_INPUT_QUANTITY CM_IDENTITY 6 0 255 /end AXIS_DESCR /end CHARACTERISTIC
/begin CHARACTERISTIC MAP_132_116E5_4 "veroyatnaya mapscan addr 0x116E5" CURVE 0x116E5 RL_2D_A8_UBYTE 0 CM_IDENTITY 0 255 /begin AXIS_DESCR STD_AXIS NO_INPUT_QUANTITY CM_IDENTITY 4 0 255 /end AXIS_DESCR /end CHARACTERISTIC
/begin CHARACTERISTIC MAP_134_11986_5x6 "veroyatnaya mapscan addr 0x11986" MAP 0x11986 RL_3D_A8_UBYTE 0 CM_IDENTITY 0 255 /begin AXIS_DESCR STD_AXIS NO_INPUT_QUANTITY CM_IDENTITY 6 0 255 /end AXIS_DESCR /begin AXIS_DESCR STD_AXIS NO_INPUT_QUANTITY CM_IDENTITY 5 0 255 /end AXIS_DESCR /end CHARACTERISTIC
/begin CHARACTERISTIC MAP_137_11A1A_6 "veroyatnaya mapscan addr 0x11A1A" CURVE 0x11A1A RL_2D_A8_UBYTE 0 CM_IDENTITY 0 255 /begin AXIS_DESCR STD_AXIS NO_INPUT_QUANTITY CM_IDENTITY 6 0 255 /end AXIS_DESCR /end CHARACTERISTIC
/begin CHARACTERISTIC MAP_139_11A40_10x10 "veroyatnaya mapscan addr 0x11A40" MAP 0x11A40 RL_3D_A8_UBYTE 0 CM_IDENTITY 0 255 /begin AXIS_DESCR STD_AXIS NO_INPUT_QUANTITY CM_IDENTITY 10 0 255 /end AXIS_DESCR /begin AXIS_DESCR STD_AXIS NO_INPUT_QUANTITY CM_IDENTITY 10 0 255 /end AXIS_DESCR /end CHARACTERISTIC
/begin CHARACTERISTIC FFTEV6 "veroyatnaya damos-veroyatno addr 0x11ABB | freeze frame table: injector power stage 6" CURVE 0x11ABB RL_GRID_UBYTE 0 CM_IDENTITY 0 255
 /begin AXIS_DESCR FIX_AXIS NO_INPUT_QUANTITY CM_IDENTITY 2 0 1 FIX_AXIS_PAR_DIST 0 1 2 /end AXIS_DESCR
/end CHARACTERISTIC
/begin CHARACTERISTIC FFTFRAO "veroyatnaya damos-veroyatno addr 0x11ABD | freeze frame table: FRAO mixture adaptation" CURVE 0x11ABD RL_GRID_UBYTE 0 CM_IDENTITY 0 255
 /begin AXIS_DESCR FIX_AXIS NO_INPUT_QUANTITY CM_IDENTITY 2 0 1 FIX_AXIS_PAR_DIST 0 1 2 /end AXIS_DESCR
/end CHARACTERISTIC
/begin CHARACTERISTIC FFTFRAU "veroyatnaya damos-veroyatno addr 0x11ABF | freeze frame table: FRAU mixture adaptation" CURVE 0x11ABF RL_GRID_UBYTE 0 CM_IDENTITY 0 255
 /begin AXIS_DESCR FIX_AXIS NO_INPUT_QUANTITY CM_IDENTITY 2 0 1 FIX_AXIS_PAR_DIST 0 1 2 /end AXIS_DESCR
/end CHARACTERISTIC
/begin CHARACTERISTIC FFTFRST "veroyatnaya damos-veroyatno addr 0x11AC1 | freeze frame table: deviation of lambda loop control" CURVE 0x11AC1 RL_GRID_UBYTE 0 CM_IDENTITY 0 255
 /begin AXIS_DESCR FIX_AXIS NO_INPUT_QUANTITY CM_IDENTITY 2 0 1 FIX_AXIS_PAR_DIST 0 1 2 /end AXIS_DESCR
/end CHARACTERISTIC
/begin CHARACTERISTIC FFTGE "veroyatnaya damos-veroyatno addr 0x11AC3 | freeze frame table: transmission intervention" CURVE 0x11AC3 RL_GRID_UBYTE 0 CM_IDENTITY 0 255
 /begin AXIS_DESCR FIX_AXIS NO_INPUT_QUANTITY CM_IDENTITY 2 0 1 FIX_AXIS_PAR_DIST 0 1 2 /end AXIS_DESCR
/end CHARACTERISTIC
/begin CHARACTERISTIC FFTHSH "veroyatnaya damos-veroyatno addr 0x11AC5 | Table of ambient condition for heating O2-sensor post cat" CURVE 0x11AC5 RL_GRID_UBYTE 0 CM_IDENTITY 0 255
 /begin AXIS_DESCR FIX_AXIS NO_INPUT_QUANTITY CM_IDENTITY 2 0 1 FIX_AXIS_PAR_DIST 0 1 2 /end AXIS_DESCR
/end CHARACTERISTIC
/begin CHARACTERISTIC FFTHSHE "veroyatnaya damos-veroyatno addr 0x11AC7 | Table of environmental cond.for output stage heating lambda sens. downstr.of cat" CURVE 0x11AC7 RL_GRID_UBYTE 0 CM_IDENTITY 0 255
 /begin AXIS_DESCR FIX_AXIS NO_INPUT_QUANTITY CM_IDENTITY 2 0 1 FIX_AXIS_PAR_DIST 0 1 2 /end AXIS_DESCR
/end CHARACTERISTIC
/begin CHARACTERISTIC FFTHSV "veroyatnaya damos-veroyatno addr 0x11AC9 | Table of ambient condition for heating O2-sensor pre cat" CURVE 0x11AC9 RL_GRID_UBYTE 0 CM_IDENTITY 0 255
 /begin AXIS_DESCR FIX_AXIS NO_INPUT_QUANTITY CM_IDENTITY 2 0 1 FIX_AXIS_PAR_DIST 0 1 2 /end AXIS_DESCR
/end CHARACTERISTIC
/begin CHARACTERISTIC FFTHSVE "veroyatnaya damos-veroyatno addr 0x11ACB | Freeze frame table: 02 Sensor Heater power stage" CURVE 0x11ACB RL_GRID_UBYTE 0 CM_IDENTITY 0 255
 /begin AXIS_DESCR FIX_AXIS NO_INPUT_QUANTITY CM_IDENTITY 2 0 1 FIX_AXIS_PAR_DIST 0 1 2 /end AXIS_DESCR
/end CHARACTERISTIC
/begin CHARACTERISTIC FFTKAT "veroyatnaya damos-veroyatno addr 0x11ACD | Freeze frame table: catalyst" CURVE 0x11ACD RL_GRID_UBYTE 0 CM_IDENTITY 0 255
 /begin AXIS_DESCR FIX_AXIS NO_INPUT_QUANTITY CM_IDENTITY 2 0 1 FIX_AXIS_PAR_DIST 0 1 2 /end AXIS_DESCR
/end CHARACTERISTIC
/begin CHARACTERISTIC FFTKOSE "veroyatnaya damos-veroyatno addr 0x11ACF | Freeze frame table: A/C compressor control power stage" CURVE 0x11ACF RL_GRID_UBYTE 0 CM_IDENTITY 0 255
 /begin AXIS_DESCR FIX_AXIS NO_INPUT_QUANTITY CM_IDENTITY 2 0 1 FIX_AXIS_PAR_DIST 0 1 2 /end AXIS_DESCR
/end CHARACTERISTIC
/begin CHARACTERISTIC FFTKPE "veroyatnaya damos-veroyatno addr 0x11AD1 | Freeze frame table: fuel pump relay power stage" CURVE 0x11AD1 RL_GRID_UBYTE 0 CM_IDENTITY 0 255
 /begin AXIS_DESCR FIX_AXIS NO_INPUT_QUANTITY CM_IDENTITY 2 0 1 FIX_AXIS_PAR_DIST 0 1 2 /end AXIS_DESCR
/end CHARACTERISTIC
/begin CHARACTERISTIC MAP_152_11AD4_16x12 "veroyatnaya mapscan addr 0x11AD4" MAP 0x11AD4 RL_3D_A8_UWORD 0 CM_IDENTITY 0 65535 /begin AXIS_DESCR STD_AXIS NO_INPUT_QUANTITY CM_IDENTITY 12 0 255 /end AXIS_DESCR /begin AXIS_DESCR STD_AXIS NO_INPUT_QUANTITY CM_IDENTITY 16 0 255 /end AXIS_DESCR /end CHARACTERISTIC
/begin CHARACTERISTIC DLURMIN "veroyatnaya damos-veroyatno addr 0x11D30 | speed dependensy of engine roughness referenz minimum value 1" CURVE 0x11D30 RL_GRID_SBYTE 0 CM_IDENTITY -128 127
 /begin AXIS_DESCR FIX_AXIS NO_INPUT_QUANTITY CM_IDENTITY 8 0 7 FIX_AXIS_PAR_DIST 0 1 8 /end AXIS_DESCR
/end CHARACTERISTIC
/begin CHARACTERISTIC ANALUN "veroyatnaya damos-veroyatno addr 0x11E91 | number of combustions for deactivation after detected misfire" CURVE 0x11E91 RL_GRID_UBYTE 0 CM_IDENTITY 0 255
 /begin AXIS_DESCR FIX_AXIS NO_INPUT_QUANTITY CM_IDENTITY 8 0 7 FIX_AXIS_PAR_DIST 0 1 8 /end AXIS_DESCR
/end CHARACTERISTIC
/begin CHARACTERISTIC MAP_160_11F22_8 "veroyatnaya mapscan addr 0x11F22" CURVE 0x11F22 RL_2D_A8_UBYTE 0 CM_IDENTITY 0 255 /begin AXIS_DESCR STD_AXIS NO_INPUT_QUANTITY CM_IDENTITY 8 0 255 /end AXIS_DESCR /end CHARACTERISTIC
/begin CHARACTERISTIC KFLURB2 "veroyatnaya damos-veroyatno addr 0x1201E | map for engine roughness - reference base value" MAP 0x1201E RL_GRID_SBYTE 0 CM_IDENTITY -128 127
 /begin AXIS_DESCR FIX_AXIS NO_INPUT_QUANTITY CM_IDENTITY 8 0 7 FIX_AXIS_PAR_DIST 0 1 8 /end AXIS_DESCR
 /begin AXIS_DESCR FIX_AXIS NO_INPUT_QUANTITY CM_IDENTITY 8 0 7 FIX_AXIS_PAR_DIST 0 1 8 /end AXIS_DESCR
/end CHARACTERISTIC
/begin CHARACTERISTIC LURKTM "veroyatnaya damos-veroyatno addr 0x1215E | Tmot-dependent engine roughness reference correcting value" CURVE 0x1215E RL_GRID_SBYTE 0 CM_IDENTITY -128 127
 /begin AXIS_DESCR FIX_AXIS NO_INPUT_QUANTITY CM_IDENTITY 8 0 7 FIX_AXIS_PAR_DIST 0 1 8 /end AXIS_DESCR
/end CHARACTERISTIC
/begin CHARACTERISTIC LURMIN1 "veroyatnaya damos-veroyatno addr 0x12166 | speed dependensy of engine roughness referenz minimum value 1" CURVE 0x12166 RL_GRID_SBYTE 0 CM_IDENTITY -128 127
 /begin AXIS_DESCR FIX_AXIS NO_INPUT_QUANTITY CM_IDENTITY 8 0 7 FIX_AXIS_PAR_DIST 0 1 8 /end AXIS_DESCR
/end CHARACTERISTIC
/begin CHARACTERISTIC LURMIN2 "veroyatnaya damos-veroyatno addr 0x1216E | speed dependensy of engine roughness referenz minimum value 2" CURVE 0x1216E RL_GRID_SBYTE 0 CM_IDENTITY -128 127
 /begin AXIS_DESCR FIX_AXIS NO_INPUT_QUANTITY CM_IDENTITY 8 0 7 FIX_AXIS_PAR_DIST 0 1 8 /end AXIS_DESCR
/end CHARACTERISTIC
/begin CHARACTERISTIC LURMIN3 "veroyatnaya damos-veroyatno addr 0x12176 | speed dependensy of engine roughness referenz minimum value 3" CURVE 0x12176 RL_GRID_SBYTE 0 CM_IDENTITY -128 127
 /begin AXIS_DESCR FIX_AXIS NO_INPUT_QUANTITY CM_IDENTITY 8 0 7 FIX_AXIS_PAR_DIST 0 1 8 /end AXIS_DESCR
/end CHARACTERISTIC
/begin CHARACTERISTIC KFKSWF "veroyatnaya damos-veroyatno addr 0x12192 | map for catalyst protection, weighting factors" MAP 0x12192 RL_GRID_UBYTE 0 CM_IDENTITY 0 255
 /begin AXIS_DESCR FIX_AXIS NO_INPUT_QUANTITY CM_IDENTITY 6 0 5 FIX_AXIS_PAR_DIST 0 1 6 /end AXIS_DESCR
 /begin AXIS_DESCR FIX_AXIS NO_INPUT_QUANTITY CM_IDENTITY 6 0 5 FIX_AXIS_PAR_DIST 0 1 6 /end AXIS_DESCR
/end CHARACTERISTIC
/begin CHARACTERISTIC MAP_171_124D4_6 "veroyatnaya mapscan addr 0x124D4" CURVE 0x124D4 RL_2D_A8_UBYTE 0 CM_IDENTITY 0 255 /begin AXIS_DESCR STD_AXIS NO_INPUT_QUANTITY CM_IDENTITY 6 0 255 /end AXIS_DESCR /end CHARACTERISTIC
/begin CHARACTERISTIC MAP_172_128BD_21 "veroyatnaya mapscan addr 0x128BD" CURVE 0x128BD RL_2D_A16_UWORD 0 CM_IDENTITY 0 65535 /begin AXIS_DESCR STD_AXIS NO_INPUT_QUANTITY CM_IDENTITY 21 0 65535 /end AXIS_DESCR /end CHARACTERISTIC
/begin CHARACTERISTIC SAN12ESUW "veroyatnaya damos-veroyatno addr 0x148B8 | Distribution for the limited injection counter anztib_w" CURVE 0x148B8 RL_GRID_UBYTE 0 CM_IDENTITY 0 255
 /begin AXIS_DESCR FIX_AXIS NO_INPUT_QUANTITY CM_IDENTITY 12 0 11 FIX_AXIS_PAR_DIST 0 1 12 /end AXIS_DESCR
/end CHARACTERISTIC
/begin CHARACTERISTIC SNM16OPUW_148D2 "veroyatnaya damos-veroyatno addr 0x148D2 | set point distribution engine speed" CURVE 0x148D2 RL_GRID_UBYTE 0 CM_IDENTITY 0 255
 /begin AXIS_DESCR FIX_AXIS NO_INPUT_QUANTITY CM_IDENTITY 16 0 15 FIX_AXIS_PAR_DIST 0 1 16 /end AXIS_DESCR
/end CHARACTERISTIC
/begin CHARACTERISTIC MAP_175_14915_6 "veroyatnaya mapscan addr 0x14915" CURVE 0x14915 RL_2D_A16_UWORD 0 CM_IDENTITY 0 65535 /begin AXIS_DESCR STD_AXIS NO_INPUT_QUANTITY CM_IDENTITY 6 0 65535 /end AXIS_DESCR /end CHARACTERISTIC
/begin CHARACTERISTIC NDFILOG "veroyatnaya damos-veroyatno addr 0x14934 | Threshold for filter output ndfil" CURVE 0x14934 RL_GRID_UBYTE 0 CM_0p25_0_Umin 0 63.75
 /begin AXIS_DESCR FIX_AXIS NO_INPUT_QUANTITY CM_IDENTITY 6 0 5 FIX_AXIS_PAR_DIST 0 1 6 /end AXIS_DESCR
/end CHARACTERISTIC
/begin CHARACTERISTIC TVKUPHS "veroyatnaya damos-veroyatno addr 0x14940 | delay time for clutch switch during shifting in higher gear" CURVE 0x14940 RL_GRID_UBYTE 0 CM_0p01_0_s 0 2.55
 /begin AXIS_DESCR FIX_AXIS NO_INPUT_QUANTITY CM_IDENTITY 6 0 5 FIX_AXIS_PAR_DIST 0 1 6 /end AXIS_DESCR
/end CHARACTERISTIC
/begin CHARACTERISTIC TVKUPRS "veroyatnaya damos-veroyatno addr 0x1494C | delay time for clutch switch during shifting in lower gear" CURVE 0x1494C RL_GRID_UBYTE 0 CM_0p01_0_s 0 2.55
 /begin AXIS_DESCR FIX_AXIS NO_INPUT_QUANTITY CM_IDENTITY 6 0 5 FIX_AXIS_PAR_DIST 0 1 6 /end AXIS_DESCR
/end CHARACTERISTIC
/begin CHARACTERISTIC DETANN "veroyatnaya damos-veroyatno addr 0x14959 | negative change limitation of etazwvg for each 10ms" CURVE 0x14959 RL_GRID_UBYTE 0 CM_0p001953125_0 0 0.498047
 /begin AXIS_DESCR FIX_AXIS NO_INPUT_QUANTITY CM_IDENTITY 10 0 9 FIX_AXIS_PAR_DIST 0 1 10 /end AXIS_DESCR
/end CHARACTERISTIC
/begin CHARACTERISTIC DETAPN "veroyatnaya damos-veroyatno addr 0x14979 | Positive change limitation of etazwvg for each 10ms" CURVE 0x14979 RL_GRID_UBYTE 0 CM_0p001953125_0 0 0.498047
 /begin AXIS_DESCR FIX_AXIS NO_INPUT_QUANTITY CM_IDENTITY 10 0 9 FIX_AXIS_PAR_DIST 0 1 10 /end AXIS_DESCR
/end CHARACTERISTIC
/begin CHARACTERISTIC MAP_181_14998_10 "veroyatnaya mapscan addr 0x14998" CURVE 0x14998 RL_2D_A8_UWORD 0 CM_IDENTITY 0 65535 /begin AXIS_DESCR STD_AXIS NO_INPUT_QUANTITY CM_IDENTITY 10 0 255 /end AXIS_DESCR /end CHARACTERISTIC
/begin CHARACTERISTIC MAP_182_149B8_10 "veroyatnaya mapscan addr 0x149B8" CURVE 0x149B8 RL_2D_A8_UWORD 0 CM_IDENTITY 0 65535 /begin AXIS_DESCR STD_AXIS NO_INPUT_QUANTITY CM_IDENTITY 10 0 255 /end AXIS_DESCR /end CHARACTERISTIC
/begin CHARACTERISTIC MAP_183_149D8_10 "veroyatnaya mapscan addr 0x149D8" CURVE 0x149D8 RL_2D_A8_UWORD 0 CM_IDENTITY 0 65535 /begin AXIS_DESCR STD_AXIS NO_INPUT_QUANTITY CM_IDENTITY 10 0 255 /end AXIS_DESCR /end CHARACTERISTIC
/begin CHARACTERISTIC MAP_184_14A11_10 "veroyatnaya mapscan addr 0x14A11" CURVE 0x14A11 RL_2D_A16_UWORD 0 CM_IDENTITY 0 65535 /begin AXIS_DESCR STD_AXIS NO_INPUT_QUANTITY CM_IDENTITY 10 0 65535 /end AXIS_DESCR /end CHARACTERISTIC
/begin CHARACTERISTIC SRL11OPUW_14B1A "veroyatnaya damos-veroyatno addr 0x14B1A | set point distribution relative charge" CURVE 0x14B1A RL_GRID_UBYTE 0 CM_IDENTITY 0 255
 /begin AXIS_DESCR FIX_AXIS NO_INPUT_QUANTITY CM_IDENTITY 11 0 10 FIX_AXIS_PAR_DIST 0 1 11 /end AXIS_DESCR
/end CHARACTERISTIC
/begin CHARACTERISTIC DMLWWKMK "veroyatnaya damos-veroyatno addr 0x14B33 | Motor torque threshold for antijerking on an openned lockup clutch" CURVE 0x14B33 RL_GRID_UBYTE 0 CM_0p1960784314_0 0 50
 /begin AXIS_DESCR FIX_AXIS NO_INPUT_QUANTITY CM_IDENTITY 6 0 5 FIX_AXIS_PAR_DIST 0 1 6 /end AXIS_DESCR
/end CHARACTERISTIC
/begin CHARACTERISTIC KLDMLWSDO "veroyatnaya damos-veroyatno addr 0x14B41 | Delta torque for enabling impact limitation" CURVE 0x14B41 RL_GRID_UBYTE 0 CM_0p1960784314_0 0 50
 /begin AXIS_DESCR FIX_AXIS NO_INPUT_QUANTITY CM_IDENTITY 6 0 5 FIX_AXIS_PAR_DIST 0 1 6 /end AXIS_DESCR
/end CHARACTERISTIC
/begin CHARACTERISTIC KLMKLWSD "veroyatnaya damos-veroyatno addr 0x14B4E | Torgue threshold value for impact damping" CURVE 0x14B4E RL_GRID_SBYTE 0 CM_0p003051757812_0 -0.390625 0.387573
 /begin AXIS_DESCR FIX_AXIS NO_INPUT_QUANTITY CM_IDENTITY 6 0 5 FIX_AXIS_PAR_DIST 0 1 6 /end AXIS_DESCR
/end CHARACTERISTIC
/begin CHARACTERISTIC MAP_189_14BC5_12 "veroyatnaya mapscan addr 0x14BC5" CURVE 0x14BC5 RL_2D_A16_UWORD 0 CM_IDENTITY 0 65535 /begin AXIS_DESCR STD_AXIS NO_INPUT_QUANTITY CM_IDENTITY 12 0 65535 /end AXIS_DESCR /end CHARACTERISTIC
/begin CHARACTERISTIC MAP_190_14BFB_5 "veroyatnaya mapscan addr 0x14BFB" CURVE 0x14BFB RL_2D_A16_UWORD 0 CM_IDENTITY 0 65535 /begin AXIS_DESCR STD_AXIS NO_INPUT_QUANTITY CM_IDENTITY 5 0 65535 /end AXIS_DESCR /end CHARACTERISTIC
/begin CHARACTERISTIC MAP_191_14C2D_4 "veroyatnaya mapscan addr 0x14C2D" CURVE 0x14C2D RL_2D_A16_UWORD 0 CM_IDENTITY 0 65535 /begin AXIS_DESCR STD_AXIS NO_INPUT_QUANTITY CM_IDENTITY 4 0 65535 /end AXIS_DESCR /end CHARACTERISTIC
/begin CHARACTERISTIC MAP_192_14C45_4 "veroyatnaya mapscan addr 0x14C45" CURVE 0x14C45 RL_2D_A16_UWORD 0 CM_IDENTITY 0 65535 /begin AXIS_DESCR STD_AXIS NO_INPUT_QUANTITY CM_IDENTITY 4 0 65535 /end AXIS_DESCR /end CHARACTERISTIC
/begin CHARACTERISTIC MAP_193_14C5D_4 "veroyatnaya mapscan addr 0x14C5D" CURVE 0x14C5D RL_2D_A16_UWORD 0 CM_IDENTITY 0 65535 /begin AXIS_DESCR STD_AXIS NO_INPUT_QUANTITY CM_IDENTITY 4 0 65535 /end AXIS_DESCR /end CHARACTERISTIC
/begin CHARACTERISTIC MAP_194_14C75_4 "veroyatnaya mapscan addr 0x14C75" CURVE 0x14C75 RL_2D_A16_UWORD 0 CM_IDENTITY 0 65535 /begin AXIS_DESCR STD_AXIS NO_INPUT_QUANTITY CM_IDENTITY 4 0 65535 /end AXIS_DESCR /end CHARACTERISTIC
/begin CHARACTERISTIC MAP_195_14C8D_4 "veroyatnaya mapscan addr 0x14C8D" CURVE 0x14C8D RL_2D_A16_UWORD 0 CM_IDENTITY 0 65535 /begin AXIS_DESCR STD_AXIS NO_INPUT_QUANTITY CM_IDENTITY 4 0 65535 /end AXIS_DESCR /end CHARACTERISTIC
/begin CHARACTERISTIC MAP_196_14CA5_4 "veroyatnaya mapscan addr 0x14CA5" CURVE 0x14CA5 RL_2D_A16_UWORD 0 CM_IDENTITY 0 65535 /begin AXIS_DESCR STD_AXIS NO_INPUT_QUANTITY CM_IDENTITY 4 0 65535 /end AXIS_DESCR /end CHARACTERISTIC
/begin CHARACTERISTIC MAP_197_14CBD_4 "veroyatnaya mapscan addr 0x14CBD" CURVE 0x14CBD RL_2D_A16_UWORD 0 CM_IDENTITY 0 65535 /begin AXIS_DESCR STD_AXIS NO_INPUT_QUANTITY CM_IDENTITY 4 0 65535 /end AXIS_DESCR /end CHARACTERISTIC
/begin CHARACTERISTIC MAP_198_14CD5_4 "veroyatnaya mapscan addr 0x14CD5" CURVE 0x14CD5 RL_2D_A16_UWORD 0 CM_IDENTITY 0 65535 /begin AXIS_DESCR STD_AXIS NO_INPUT_QUANTITY CM_IDENTITY 4 0 65535 /end AXIS_DESCR /end CHARACTERISTIC
/begin CHARACTERISTIC MAP_199_14CED_4 "veroyatnaya mapscan addr 0x14CED" CURVE 0x14CED RL_2D_A16_UWORD 0 CM_IDENTITY 0 65535 /begin AXIS_DESCR STD_AXIS NO_INPUT_QUANTITY CM_IDENTITY 4 0 65535 /end AXIS_DESCR /end CHARACTERISTIC
/begin CHARACTERISTIC MAP_200_14D05_4 "veroyatnaya mapscan addr 0x14D05" CURVE 0x14D05 RL_2D_A16_UWORD 0 CM_IDENTITY 0 65535 /begin AXIS_DESCR STD_AXIS NO_INPUT_QUANTITY CM_IDENTITY 4 0 65535 /end AXIS_DESCR /end CHARACTERISTIC
/begin CHARACTERISTIC MAP_201_14D1D_4 "veroyatnaya mapscan addr 0x14D1D" CURVE 0x14D1D RL_2D_A16_UWORD 0 CM_IDENTITY 0 65535 /begin AXIS_DESCR STD_AXIS NO_INPUT_QUANTITY CM_IDENTITY 4 0 65535 /end AXIS_DESCR /end CHARACTERISTIC
/begin CHARACTERISTIC MAP_202_14D35_4 "veroyatnaya mapscan addr 0x14D35" CURVE 0x14D35 RL_2D_A16_UWORD 0 CM_IDENTITY 0 65535 /begin AXIS_DESCR STD_AXIS NO_INPUT_QUANTITY CM_IDENTITY 4 0 65535 /end AXIS_DESCR /end CHARACTERISTIC
/begin CHARACTERISTIC MAP_203_14D4D_4 "veroyatnaya mapscan addr 0x14D4D" CURVE 0x14D4D RL_2D_A16_UWORD 0 CM_IDENTITY 0 65535 /begin AXIS_DESCR STD_AXIS NO_INPUT_QUANTITY CM_IDENTITY 4 0 65535 /end AXIS_DESCR /end CHARACTERISTIC
/begin CHARACTERISTIC MAP_204_14D65_4 "veroyatnaya mapscan addr 0x14D65" CURVE 0x14D65 RL_2D_A16_UWORD 0 CM_IDENTITY 0 65535 /begin AXIS_DESCR STD_AXIS NO_INPUT_QUANTITY CM_IDENTITY 4 0 65535 /end AXIS_DESCR /end CHARACTERISTIC
/begin CHARACTERISTIC SRL03MFUW "veroyatnaya damos-veroyatno addr 0x14D78" CURVE 0x14D78 RL_GRID_UBYTE 0 CM_IDENTITY 0 255
 /begin AXIS_DESCR FIX_AXIS NO_INPUT_QUANTITY CM_IDENTITY 3 0 2 FIX_AXIS_PAR_DIST 0 1 3 /end AXIS_DESCR
/end CHARACTERISTIC
/begin CHARACTERISTIC MAP_208_14F60_8 "veroyatnaya mapscan addr 0x14F60" CURVE 0x14F60 RL_2D_A8_UWORD 0 CM_IDENTITY 0 65535 /begin AXIS_DESCR STD_AXIS NO_INPUT_QUANTITY CM_IDENTITY 8 0 255 /end AXIS_DESCR /end CHARACTERISTIC
/begin CHARACTERISTIC MAP_209_14F7F_6 "veroyatnaya mapscan addr 0x14F7F" CURVE 0x14F7F RL_2D_A8_UBYTE 0 CM_IDENTITY 0 255 /begin AXIS_DESCR STD_AXIS NO_INPUT_QUANTITY CM_IDENTITY 6 0 255 /end AXIS_DESCR /end CHARACTERISTIC
/begin CHARACTERISTIC MAP_211_14FF7_5 "veroyatnaya mapscan addr 0x14FF7" CURVE 0x14FF7 RL_2D_A8_UBYTE 0 CM_IDENTITY 0 255 /begin AXIS_DESCR STD_AXIS NO_INPUT_QUANTITY CM_IDENTITY 5 0 255 /end AXIS_DESCR /end CHARACTERISTIC
/begin CHARACTERISTIC MAP_212_15005_6 "veroyatnaya mapscan addr 0x15005" CURVE 0x15005 RL_2D_A8_UBYTE 0 CM_IDENTITY 0 255 /begin AXIS_DESCR STD_AXIS NO_INPUT_QUANTITY CM_IDENTITY 6 0 255 /end AXIS_DESCR /end CHARACTERISTIC
/begin CHARACTERISTIC DMLLNGV "veroyatnaya damos-veroyatno addr 0x15064 | LLR: D-gain depending of ngasf for air path" CURVE 0x15064 RL_GRID_SBYTE 0 CM_0p0030515625_0_Umin -0.3906 0.387548
 /begin AXIS_DESCR FIX_AXIS NO_INPUT_QUANTITY CM_IDENTITY 6 0 5 FIX_AXIS_PAR_DIST 0 1 6 /end AXIS_DESCR
/end CHARACTERISTIC
/begin CHARACTERISTIC MAP_217_15137_6 "veroyatnaya mapscan addr 0x15137" CURVE 0x15137 RL_2D_A16_UWORD 0 CM_IDENTITY 0 65535 /begin AXIS_DESCR STD_AXIS NO_INPUT_QUANTITY CM_IDENTITY 6 0 65535 /end AXIS_DESCR /end CHARACTERISTIC
/begin CHARACTERISTIC DMDNSM_0_A "veroyatnaya damos-veroyatno addr 0x151DD | Torque offset for after cranking compensation" CURVE 0x151DD RL_GRID_UBYTE 0 CM_0p390625_0 0 99.6094
 /begin AXIS_DESCR FIX_AXIS NO_INPUT_QUANTITY CM_IDENTITY 8 0 7 FIX_AXIS_PAR_DIST 0 1 8 /end AXIS_DESCR
/end CHARACTERISTIC
/begin CHARACTERISTIC ZMDNSM_0_A "veroyatnaya damos-veroyatno addr 0x151E5 | time constant for decay of torque offset after cranking" CURVE 0x151E5 RL_GRID_UBYTE 0 CM_IDENTITY 0 255
 /begin AXIS_DESCR FIX_AXIS NO_INPUT_QUANTITY CM_IDENTITY 8 0 7 FIX_AXIS_PAR_DIST 0 1 8 /end AXIS_DESCR
/end CHARACTERISTIC
/begin CHARACTERISTIC MDSM_0_A "veroyatnaya damos-veroyatno addr 0x151ED | temperatuer share of enginie friction torque" CURVE 0x151ED RL_GRID_UWORD 0 CM_0p001525878906_0 0 99.9985
 /begin AXIS_DESCR FIX_AXIS NO_INPUT_QUANTITY CM_IDENTITY 10 0 9 FIX_AXIS_PAR_DIST 0 1 10 /end AXIS_DESCR
/end CHARACTERISTIC
/begin CHARACTERISTIC MAP_221_15261_6 "veroyatnaya mapscan addr 0x15261" CURVE 0x15261 RL_2D_A16_UWORD 0 CM_IDENTITY 0 65535 /begin AXIS_DESCR STD_AXIS NO_INPUT_QUANTITY CM_IDENTITY 6 0 65535 /end AXIS_DESCR /end CHARACTERISTIC
/begin CHARACTERISTIC MAP_222_15281_6 "veroyatnaya mapscan addr 0x15281" CURVE 0x15281 RL_2D_A16_UWORD 0 CM_IDENTITY 0 65535 /begin AXIS_DESCR STD_AXIS NO_INPUT_QUANTITY CM_IDENTITY 6 0 65535 /end AXIS_DESCR /end CHARACTERISTIC
/begin CHARACTERISTIC MAP_223_152A1_6x7 "veroyatnaya mapscan addr 0x152A1" MAP 0x152A1 RL_3D_A16_UWORD 0 CM_IDENTITY 0 65535 /begin AXIS_DESCR STD_AXIS NO_INPUT_QUANTITY CM_IDENTITY 7 0 65535 /end AXIS_DESCR /begin AXIS_DESCR STD_AXIS NO_INPUT_QUANTITY CM_IDENTITY 6 0 65535 /end AXIS_DESCR /end CHARACTERISTIC
/begin CHARACTERISTIC MAP_224_15311_7 "veroyatnaya mapscan addr 0x15311" CURVE 0x15311 RL_2D_A16_UWORD 0 CM_IDENTITY 0 65535 /begin AXIS_DESCR STD_AXIS NO_INPUT_QUANTITY CM_IDENTITY 7 0 65535 /end AXIS_DESCR /end CHARACTERISTIC
/begin CHARACTERISTIC MAP_225_15331_7 "veroyatnaya mapscan addr 0x15331" CURVE 0x15331 RL_2D_A16_UWORD 0 CM_IDENTITY 0 65535 /begin AXIS_DESCR STD_AXIS NO_INPUT_QUANTITY CM_IDENTITY 7 0 65535 /end AXIS_DESCR /end CHARACTERISTIC
/begin CHARACTERISTIC MAP_226_15362_8x24 "veroyatnaya mapscan addr 0x15362" MAP 0x15362 RL_3D_A16_UWORD 0 CM_IDENTITY 0 65535 /begin AXIS_DESCR STD_AXIS NO_INPUT_QUANTITY CM_IDENTITY 24 0 65535 /end AXIS_DESCR /begin AXIS_DESCR STD_AXIS NO_INPUT_QUANTITY CM_IDENTITY 8 0 65535 /end AXIS_DESCR /end CHARACTERISTIC
/begin CHARACTERISTIC MAP_227_15528_12 "veroyatnaya mapscan addr 0x15528" CURVE 0x15528 RL_2D_A16_UWORD 0 CM_IDENTITY 0 65535 /begin AXIS_DESCR STD_AXIS NO_INPUT_QUANTITY CM_IDENTITY 12 0 65535 /end AXIS_DESCR /end CHARACTERISTIC
/begin CHARACTERISTIC MAP_228_15559_16 "veroyatnaya mapscan addr 0x15559" CURVE 0x15559 RL_2D_A16_UWORD 0 CM_IDENTITY 0 65535 /begin AXIS_DESCR STD_AXIS NO_INPUT_QUANTITY CM_IDENTITY 16 0 65535 /end AXIS_DESCR /end CHARACTERISTIC
/begin CHARACTERISTIC WDKUGDN_15672 "veroyatnaya damos-veroyatno addr 0x15672 | throttle angle necessary for 95 % of the maximum possible air charge" CURVE 0x15672 RL_GRID_UWORD 0 CM_0p001525878906_0 0 99.9985
 /begin AXIS_DESCR FIX_AXIS NO_INPUT_QUANTITY CM_IDENTITY 12 0 11 FIX_AXIS_PAR_DIST 0 1 12 /end AXIS_DESCR
/end CHARACTERISTIC
/begin CHARACTERISTIC ZKMSDK "veroyatnaya damos-veroyatno addr 0x1568B | integrator speed for fast constant mass-flow adaption" CURVE 0x1568B RL_GRID_UWORD 0 CM_0p000244140625_0 0 15.9998
 /begin AXIS_DESCR FIX_AXIS NO_INPUT_QUANTITY CM_IDENTITY 8 0 7 FIX_AXIS_PAR_DIST 0 1 8 /end AXIS_DESCR
/end CHARACTERISTIC
/begin CHARACTERISTIC ZKPVDK "veroyatnaya damos-veroyatno addr 0x156AD | integrator speed for slow constant mass-flow adaption" CURVE 0x156AD RL_GRID_UWORD 0 CM_0p000244140625_0 0 15.9998
 /begin AXIS_DESCR FIX_AXIS NO_INPUT_QUANTITY CM_IDENTITY 8 0 7 FIX_AXIS_PAR_DIST 0 1 8 /end AXIS_DESCR
/end CHARACTERISTIC
/begin CHARACTERISTIC KLSIS "veroyatnaya damos-veroyatno addr 0x156D3 | Charachteristic map of idle throttle on switch on" CURVE 0x156D3 RL_GRID_UWORD 0 CM_0p001525878906_0 0 99.9985
 /begin AXIS_DESCR FIX_AXIS NO_INPUT_QUANTITY CM_IDENTITY 8 0 7 FIX_AXIS_PAR_DIST 0 1 8 /end AXIS_DESCR
/end CHARACTERISTIC
/begin CHARACTERISTIC MSNLLSP "veroyatnaya damos-veroyatno addr 0x1573B | chara. line standardised air mass flow dependent on ISA position" CURVE 0x1573B RL_GRID_UWORD 0 CM_0p0015625_0_kgh 0 102.398
 /begin AXIS_DESCR FIX_AXIS NO_INPUT_QUANTITY CM_IDENTITY 16 0 15 FIX_AXIS_PAR_DIST 0 1 16 /end AXIS_DESCR
/end CHARACTERISTIC
/begin CHARACTERISTIC TLRVAMW "veroyatnaya damos-veroyatno addr 0x15A78 | blocking time for activation LC after VA (word)" CURVE 0x15A78 RL_GRID_UBYTE 0 CM_0p02_0_s 0 5.1
 /begin AXIS_DESCR FIX_AXIS NO_INPUT_QUANTITY CM_IDENTITY 8 0 7 FIX_AXIS_PAR_DIST 0 1 8 /end AXIS_DESCR
/end CHARACTERISTIC
/begin CHARACTERISTIC LALIUSRH "veroyatnaya damos-veroyatno addr 0x15AC1 | lambda linearization, sensor behind catalyst" CURVE 0x15AC1 RL_GRID_UWORD 0 CM_0p000244140625_0 0 15.9998
 /begin AXIS_DESCR FIX_AXIS NO_INPUT_QUANTITY CM_IDENTITY 10 0 9 FIX_AXIS_PAR_DIST 0 1 10 /end AXIS_DESCR
/end CHARACTERISTIC
/begin CHARACTERISTIC RLSALUN_0_A "veroyatnaya damos-veroyatno addr 0x15B20 | threshold load fuel cut-off detection for deactivating misfire detection" CURVE 0x15B20 RL_GRID_UBYTE 0 CM_0p75_0 0 191.25
 /begin AXIS_DESCR FIX_AXIS NO_INPUT_QUANTITY CM_IDENTITY 8 0 7 FIX_AXIS_PAR_DIST 0 1 8 /end AXIS_DESCR
/end CHARACTERISTIC
/begin CHARACTERISTIC NGALU_0_A "veroyatnaya damos-veroyatno addr 0x15B28 | Misfire Detection : treshold for gradient of engine speed" CURVE 0x15B28 RL_GRID_UBYTE 0 CM_0p39063_0_Umins 0 99.6106
 /begin AXIS_DESCR FIX_AXIS NO_INPUT_QUANTITY CM_IDENTITY 8 0 7 FIX_AXIS_PAR_DIST 0 1 8 /end AXIS_DESCR
/end CHARACTERISTIC
/begin CHARACTERISTIC NGKRWN "veroyatnaya damos-veroyatno addr 0x15B4A | threshold revolution gradient for dynamics detection" CURVE 0x15B4A RL_GRID_SBYTE 0 CM_0p39063_0_Umins -50.0006 49.61
 /begin AXIS_DESCR FIX_AXIS NO_INPUT_QUANTITY CM_IDENTITY 16 0 15 FIX_AXIS_PAR_DIST 0 1 16 /end AXIS_DESCR
/end CHARACTERISTIC
/begin CHARACTERISTIC AZKELDYN_0_A "veroyatnaya damos-veroyatno addr 0x15B6A | ignition per cylinder for load dynamics => knock detection" CURVE 0x15B6A RL_GRID_UBYTE 0 CM_IDENTITY 0 255
 /begin AXIS_DESCR FIX_AXIS NO_INPUT_QUANTITY CM_IDENTITY 16 0 15 FIX_AXIS_PAR_DIST 0 1 16 /end AXIS_DESCR
/end CHARACTERISTIC
/begin CHARACTERISTIC MAP_247_15BCB_7 "veroyatnaya mapscan addr 0x15BCB" CURVE 0x15BCB RL_2D_A16_UWORD 0 CM_IDENTITY 0 65535 /begin AXIS_DESCR STD_AXIS NO_INPUT_QUANTITY CM_IDENTITY 7 0 65535 /end AXIS_DESCR /end CHARACTERISTIC
/begin CHARACTERISTIC MAP_248_15C2D_7 "veroyatnaya mapscan addr 0x15C2D" CURVE 0x15C2D RL_2D_A16_UWORD 0 CM_IDENTITY 0 65535 /begin AXIS_DESCR STD_AXIS NO_INPUT_QUANTITY CM_IDENTITY 7 0 65535 /end AXIS_DESCR /end CHARACTERISTIC
/begin CHARACTERISTIC FNSSM_0_A "veroyatnaya damos-veroyatno addr 0x15DC2 | after start increase" CURVE 0x15DC2 RL_GRID_UBYTE 0 CM_0p015625_0 0 3.98438
 /begin AXIS_DESCR FIX_AXIS NO_INPUT_QUANTITY CM_IDENTITY 12 0 11 FIX_AXIS_PAR_DIST 0 1 12 /end AXIS_DESCR
/end CHARACTERISTIC
/begin CHARACTERISTIC WFRL "veroyatnaya damos-veroyatno addr 0x15DEA | fuel wall hang.up" CURVE 0x15DEA RL_GRID_UWORD 0 CM_0p09375_0 0 6143.91
 /begin AXIS_DESCR FIX_AXIS NO_INPUT_QUANTITY CM_IDENTITY 26 0 25 FIX_AXIS_PAR_DIST 0 1 26 /end AXIS_DESCR
/end CHARACTERISTIC
/begin CHARACTERISTIC KLLAMFA_0_A "veroyatnaya damos-veroyatno addr 0x15E73 | full load enrichment" CURVE 0x15E73 RL_GRID_UBYTE 0 CM_0p0078125_0 0 1.99219
 /begin AXIS_DESCR FIX_AXIS NO_INPUT_QUANTITY CM_IDENTITY 6 0 5 FIX_AXIS_PAR_DIST 0 1 6 /end AXIS_DESCR
/end CHARACTERISTIC
/begin CHARACTERISTIC FVERZDYN "veroyatnaya damos-veroyatno addr 0x15EC6 | dynamic factor delay of purge flow in the manifold" CURVE 0x15EC6 RL_GRID_UBYTE 0 CM_5p96En08_0_Min 0 1.5198e-05
 /begin AXIS_DESCR FIX_AXIS NO_INPUT_QUANTITY CM_IDENTITY 5 0 4 FIX_AXIS_PAR_DIST 0 1 5 /end AXIS_DESCR
/end CHARACTERISTIC
/begin CHARACTERISTIC TATEMSN "veroyatnaya damos-veroyatno addr 0x15F14 | characteristic line of the PCV duty-cycle depending on the desired mass-flow" CURVE 0x15F14 RL_GRID_UWORD 0 CM_0p001525878906_0 0 99.9985
 /begin AXIS_DESCR FIX_AXIS NO_INPUT_QUANTITY CM_IDENTITY 10 0 9 FIX_AXIS_PAR_DIST 0 1 10 /end AXIS_DESCR
/end CHARACTERISTIC
/begin CHARACTERISTIC KLAFTE "veroyatnaya damos-veroyatno addr 0x15F4C | characteristic of Saint-Venant of purge control valve an line AKF-TEV" CURVE 0x15F4C RL_GRID_UWORD 0 CM_3p051757812En05_0 0 1.99997
 /begin AXIS_DESCR FIX_AXIS NO_INPUT_QUANTITY CM_IDENTITY 14 0 13 FIX_AXIS_PAR_DIST 0 1 14 /end AXIS_DESCR
/end CHARACTERISTIC
/begin CHARACTERISTIC MAP_261_15F88_12 "veroyatnaya mapscan addr 0x15F88" CURVE 0x15F88 RL_2D_A16_UWORD 0 CM_IDENTITY 0 65535 /begin AXIS_DESCR STD_AXIS NO_INPUT_QUANTITY CM_IDENTITY 12 0 65535 /end AXIS_DESCR /end CHARACTERISTIC
/begin CHARACTERISTIC CDCAAA "veroyatnaya damos-veroyatno addr 0x15FD1 | Dummy: top of table" CURVE 0x15FD1 RL_GRID_UBYTE 0 CM_IDENTITY 0 255
 /begin AXIS_DESCR FIX_AXIS NO_INPUT_QUANTITY CM_IDENTITY 4 0 3 FIX_AXIS_PAR_DIST 0 1 4 /end AXIS_DESCR
/end CHARACTERISTIC
/begin CHARACTERISTIC CDCAGRF "veroyatnaya damos-veroyatno addr 0x15FD9 | code word CARB: EGR flow monitoring" CURVE 0x15FD9 RL_GRID_UBYTE 0 CM_IDENTITY 0 255
 /begin AXIS_DESCR FIX_AXIS NO_INPUT_QUANTITY CM_IDENTITY 4 0 3 FIX_AXIS_PAR_DIST 0 1 4 /end AXIS_DESCR
/end CHARACTERISTIC
/begin CHARACTERISTIC CDCAGRL "veroyatnaya damos-veroyatno addr 0x15FE1 | code word CARB: EGR valve position sensor" CURVE 0x15FE1 RL_GRID_UBYTE 0 CM_IDENTITY 0 255
 /begin AXIS_DESCR FIX_AXIS NO_INPUT_QUANTITY CM_IDENTITY 4 0 3 FIX_AXIS_PAR_DIST 0 1 4 /end AXIS_DESCR
/end CHARACTERISTIC
/begin CHARACTERISTIC CDCAGRV "veroyatnaya damos-veroyatno addr 0x15FE9 | code word CARB: diagnosis EGR valve" CURVE 0x15FE9 RL_GRID_UBYTE 0 CM_IDENTITY 0 255
 /begin AXIS_DESCR FIX_AXIS NO_INPUT_QUANTITY CM_IDENTITY 4 0 3 FIX_AXIS_PAR_DIST 0 1 4 /end AXIS_DESCR
/end CHARACTERISTIC
/begin CHARACTERISTIC CDCAHC "veroyatnaya damos-veroyatno addr 0x15FF1 | code word CARB: MT/AT encoding" CURVE 0x15FF1 RL_GRID_UBYTE 0 CM_IDENTITY 0 255
 /begin AXIS_DESCR FIX_AXIS NO_INPUT_QUANTITY CM_IDENTITY 4 0 3 FIX_AXIS_PAR_DIST 0 1 4 /end AXIS_DESCR
/end CHARACTERISTIC
/begin CHARACTERISTIC CDCBM "veroyatnaya damos-veroyatno addr 0x15FF9 | code word CARB: reference mark sensor" CURVE 0x15FF9 RL_GRID_UBYTE 0 CM_IDENTITY 0 255
 /begin AXIS_DESCR FIX_AXIS NO_INPUT_QUANTITY CM_IDENTITY 4 0 3 FIX_AXIS_PAR_DIST 0 1 4 /end AXIS_DESCR
/end CHARACTERISTIC
/begin CHARACTERISTIC CDCDK "veroyatnaya damos-veroyatno addr 0x16001 | code word CARB: throttle position sensor" CURVE 0x16001 RL_GRID_UBYTE 0 CM_IDENTITY 0 255
 /begin AXIS_DESCR FIX_AXIS NO_INPUT_QUANTITY CM_IDENTITY 4 0 3 FIX_AXIS_PAR_DIST 0 1 4 /end AXIS_DESCR
/end CHARACTERISTIC
/begin CHARACTERISTIC CDCDUMMY "veroyatnaya damos-veroyatno addr 0x16009" CURVE 0x16009 RL_GRID_UBYTE 0 CM_IDENTITY 0 255
 /begin AXIS_DESCR FIX_AXIS NO_INPUT_QUANTITY CM_IDENTITY 4 0 3 FIX_AXIS_PAR_DIST 0 1 4 /end AXIS_DESCR
/end CHARACTERISTIC
/begin CHARACTERISTIC CDCEGFE "veroyatnaya damos-veroyatno addr 0x16011 | code word CARB: charge detection" CURVE 0x16011 RL_GRID_UBYTE 0 CM_IDENTITY 0 255
 /begin AXIS_DESCR FIX_AXIS NO_INPUT_QUANTITY CM_IDENTITY 4 0 3 FIX_AXIS_PAR_DIST 0 1 4 /end AXIS_DESCR
/end CHARACTERISTIC
/begin CHARACTERISTIC CDCEV1 "veroyatnaya damos-veroyatno addr 0x16019 | code word CARB: injector 1" CURVE 0x16019 RL_GRID_UBYTE 0 CM_IDENTITY 0 255
 /begin AXIS_DESCR FIX_AXIS NO_INPUT_QUANTITY CM_IDENTITY 4 0 3 FIX_AXIS_PAR_DIST 0 1 4 /end AXIS_DESCR
/end CHARACTERISTIC
/begin CHARACTERISTIC CDCEV2 "veroyatnaya damos-veroyatno addr 0x16021 | code word CARB: injector 2" CURVE 0x16021 RL_GRID_UBYTE 0 CM_IDENTITY 0 255
 /begin AXIS_DESCR FIX_AXIS NO_INPUT_QUANTITY CM_IDENTITY 4 0 3 FIX_AXIS_PAR_DIST 0 1 4 /end AXIS_DESCR
/end CHARACTERISTIC
/begin CHARACTERISTIC CDCEV3 "veroyatnaya damos-veroyatno addr 0x16029 | code word CARB: injector 3" CURVE 0x16029 RL_GRID_UBYTE 0 CM_IDENTITY 0 255
 /begin AXIS_DESCR FIX_AXIS NO_INPUT_QUANTITY CM_IDENTITY 4 0 3 FIX_AXIS_PAR_DIST 0 1 4 /end AXIS_DESCR
/end CHARACTERISTIC
/begin CHARACTERISTIC CDCEV4 "veroyatnaya damos-veroyatno addr 0x16031 | code word CARB: injector 4" CURVE 0x16031 RL_GRID_UBYTE 0 CM_IDENTITY 0 255
 /begin AXIS_DESCR FIX_AXIS NO_INPUT_QUANTITY CM_IDENTITY 4 0 3 FIX_AXIS_PAR_DIST 0 1 4 /end AXIS_DESCR
/end CHARACTERISTIC
/begin CHARACTERISTIC CDCEV5 "veroyatnaya damos-veroyatno addr 0x16039 | code word CARB: injector 5" CURVE 0x16039 RL_GRID_UBYTE 0 CM_IDENTITY 0 255
 /begin AXIS_DESCR FIX_AXIS NO_INPUT_QUANTITY CM_IDENTITY 4 0 3 FIX_AXIS_PAR_DIST 0 1 4 /end AXIS_DESCR
/end CHARACTERISTIC
/begin CHARACTERISTIC CDCEV6 "veroyatnaya damos-veroyatno addr 0x16041 | code word CARB: injector 6" CURVE 0x16041 RL_GRID_UBYTE 0 CM_IDENTITY 0 255
 /begin AXIS_DESCR FIX_AXIS NO_INPUT_QUANTITY CM_IDENTITY 4 0 3 FIX_AXIS_PAR_DIST 0 1 4 /end AXIS_DESCR
/end CHARACTERISTIC
/begin CHARACTERISTIC CDCFRAO "veroyatnaya damos-veroyatno addr 0x16049 | code word CARB: mixture adaptation factor frao" CURVE 0x16049 RL_GRID_UBYTE 0 CM_IDENTITY 0 255
 /begin AXIS_DESCR FIX_AXIS NO_INPUT_QUANTITY CM_IDENTITY 4 0 3 FIX_AXIS_PAR_DIST 0 1 4 /end AXIS_DESCR
/end CHARACTERISTIC
/begin CHARACTERISTIC CDCFRAU "veroyatnaya damos-veroyatno addr 0x16051 | code word CARB: mixture adaptation factor frau" CURVE 0x16051 RL_GRID_UBYTE 0 CM_IDENTITY 0 255
 /begin AXIS_DESCR FIX_AXIS NO_INPUT_QUANTITY CM_IDENTITY 4 0 3 FIX_AXIS_PAR_DIST 0 1 4 /end AXIS_DESCR
/end CHARACTERISTIC
/begin CHARACTERISTIC CDCFRST "veroyatnaya damos-veroyatno addr 0x16059 | code word CARB: deiation of lambda loop control" CURVE 0x16059 RL_GRID_UBYTE 0 CM_IDENTITY 0 255
 /begin AXIS_DESCR FIX_AXIS NO_INPUT_QUANTITY CM_IDENTITY 4 0 3 FIX_AXIS_PAR_DIST 0 1 4 /end AXIS_DESCR
/end CHARACTERISTIC
/begin CHARACTERISTIC CDCGE "veroyatnaya damos-veroyatno addr 0x16061 | code word CARB: transmission controlled spark advance GE" CURVE 0x16061 RL_GRID_UBYTE 0 CM_IDENTITY 0 255
 /begin AXIS_DESCR FIX_AXIS NO_INPUT_QUANTITY CM_IDENTITY 4 0 3 FIX_AXIS_PAR_DIST 0 1 4 /end AXIS_DESCR
/end CHARACTERISTIC
/begin CHARACTERISTIC CDCHSH "veroyatnaya damos-veroyatno addr 0x16069 | code word CARB: lambda sensor heating downstream cat" CURVE 0x16069 RL_GRID_UBYTE 0 CM_IDENTITY 0 255
 /begin AXIS_DESCR FIX_AXIS NO_INPUT_QUANTITY CM_IDENTITY 4 0 3 FIX_AXIS_PAR_DIST 0 1 4 /end AXIS_DESCR
/end CHARACTERISTIC
/begin CHARACTERISTIC CDCHSHE "veroyatnaya damos-veroyatno addr 0x16071 | Code word CARB: O2 Sensor Heater power stage" CURVE 0x16071 RL_GRID_UBYTE 0 CM_IDENTITY 0 255
 /begin AXIS_DESCR FIX_AXIS NO_INPUT_QUANTITY CM_IDENTITY 4 0 3 FIX_AXIS_PAR_DIST 0 1 4 /end AXIS_DESCR
/end CHARACTERISTIC
/begin CHARACTERISTIC CDCHSV "veroyatnaya damos-veroyatno addr 0x16079 | code word CARB: lambda sensor heating upstream cat" CURVE 0x16079 RL_GRID_UBYTE 0 CM_IDENTITY 0 255
 /begin AXIS_DESCR FIX_AXIS NO_INPUT_QUANTITY CM_IDENTITY 4 0 3 FIX_AXIS_PAR_DIST 0 1 4 /end AXIS_DESCR
/end CHARACTERISTIC
/begin CHARACTERISTIC CDCHSVE "veroyatnaya damos-veroyatno addr 0x16081 | code word CARB: lambda sensor heating power stage upstream cat" CURVE 0x16081 RL_GRID_UBYTE 0 CM_IDENTITY 0 255
 /begin AXIS_DESCR FIX_AXIS NO_INPUT_QUANTITY CM_IDENTITY 4 0 3 FIX_AXIS_PAR_DIST 0 1 4 /end AXIS_DESCR
/end CHARACTERISTIC
/begin CHARACTERISTIC CDCKAT "veroyatnaya damos-veroyatno addr 0x16089 | code word CARB: catalyst conversion" CURVE 0x16089 RL_GRID_UBYTE 0 CM_IDENTITY 0 255
 /begin AXIS_DESCR FIX_AXIS NO_INPUT_QUANTITY CM_IDENTITY 4 0 3 FIX_AXIS_PAR_DIST 0 1 4 /end AXIS_DESCR
/end CHARACTERISTIC
/begin CHARACTERISTIC CDCKOSE "veroyatnaya damos-veroyatno addr 0x16091 | Code word CARB: A/C control power stage" CURVE 0x16091 RL_GRID_UBYTE 0 CM_IDENTITY 0 255
 /begin AXIS_DESCR FIX_AXIS NO_INPUT_QUANTITY CM_IDENTITY 4 0 3 FIX_AXIS_PAR_DIST 0 1 4 /end AXIS_DESCR
/end CHARACTERISTIC
/begin CHARACTERISTIC CDCKPE "veroyatnaya damos-veroyatno addr 0x16099 | Code word CARB: fuel pump relay power stage" CURVE 0x16099 RL_GRID_UBYTE 0 CM_IDENTITY 0 255
 /begin AXIS_DESCR FIX_AXIS NO_INPUT_QUANTITY CM_IDENTITY 4 0 3 FIX_AXIS_PAR_DIST 0 1 4 /end AXIS_DESCR
/end CHARACTERISTIC
/begin CHARACTERISTIC CDCKRNT "veroyatnaya damos-veroyatno addr 0x160A1 | code word CARB: knock control zero test pulse" CURVE 0x160A1 RL_GRID_UBYTE 0 CM_IDENTITY 0 255
 /begin AXIS_DESCR FIX_AXIS NO_INPUT_QUANTITY CM_IDENTITY 4 0 3 FIX_AXIS_PAR_DIST 0 1 4 /end AXIS_DESCR
/end CHARACTERISTIC
/begin CHARACTERISTIC CDCKROF "veroyatnaya damos-veroyatno addr 0x160A9 | codeword CARB: knock control offset" CURVE 0x160A9 RL_GRID_UBYTE 0 CM_IDENTITY 0 255
 /begin AXIS_DESCR FIX_AXIS NO_INPUT_QUANTITY CM_IDENTITY 4 0 3 FIX_AXIS_PAR_DIST 0 1 4 /end AXIS_DESCR
/end CHARACTERISTIC
/begin CHARACTERISTIC CDCKRTP "veroyatnaya damos-veroyatno addr 0x160B1 | code word CARB: knock control test pulse" CURVE 0x160B1 RL_GRID_UBYTE 0 CM_IDENTITY 0 255
 /begin AXIS_DESCR FIX_AXIS NO_INPUT_QUANTITY CM_IDENTITY 4 0 3 FIX_AXIS_PAR_DIST 0 1 4 /end AXIS_DESCR
/end CHARACTERISTIC
/begin CHARACTERISTIC CDCKS1 "veroyatnaya damos-veroyatno addr 0x160B9 | code word CARB: knock sensor 1" CURVE 0x160B9 RL_GRID_UBYTE 0 CM_IDENTITY 0 255
 /begin AXIS_DESCR FIX_AXIS NO_INPUT_QUANTITY CM_IDENTITY 4 0 3 FIX_AXIS_PAR_DIST 0 1 4 /end AXIS_DESCR
/end CHARACTERISTIC
/begin CHARACTERISTIC CDCKS2 "veroyatnaya damos-veroyatno addr 0x160C1 | code word CARB: knock sensor 2" CURVE 0x160C1 RL_GRID_UBYTE 0 CM_IDENTITY 0 255
 /begin AXIS_DESCR FIX_AXIS NO_INPUT_QUANTITY CM_IDENTITY 4 0 3 FIX_AXIS_PAR_DIST 0 1 4 /end AXIS_DESCR
/end CHARACTERISTIC
/begin CHARACTERISTIC CDCKS3 "veroyatnaya damos-veroyatno addr 0x160C9 | code word CARB: knock sensor 3" CURVE 0x160C9 RL_GRID_UBYTE 0 CM_IDENTITY 0 255
 /begin AXIS_DESCR FIX_AXIS NO_INPUT_QUANTITY CM_IDENTITY 4 0 3 FIX_AXIS_PAR_DIST 0 1 4 /end AXIS_DESCR
/end CHARACTERISTIC
/begin CHARACTERISTIC CDCKS4 "veroyatnaya damos-veroyatno addr 0x160D1 | code word CARB: knock sensor 4" CURVE 0x160D1 RL_GRID_UBYTE 0 CM_IDENTITY 0 255
 /begin AXIS_DESCR FIX_AXIS NO_INPUT_QUANTITY CM_IDENTITY 4 0 3 FIX_AXIS_PAR_DIST 0 1 4 /end AXIS_DESCR
/end CHARACTERISTIC
/begin CHARACTERISTIC CDCLASH "veroyatnaya damos-veroyatno addr 0x160D9 | code word CARB: lambda sensor aging downstream cat" CURVE 0x160D9 RL_GRID_UBYTE 0 CM_IDENTITY 0 255
 /begin AXIS_DESCR FIX_AXIS NO_INPUT_QUANTITY CM_IDENTITY 4 0 3 FIX_AXIS_PAR_DIST 0 1 4 /end AXIS_DESCR
/end CHARACTERISTIC
/begin CHARACTERISTIC CDCLATP "veroyatnaya damos-veroyatno addr 0x160E1 | code word CARB: lambda sensor aging tp" CURVE 0x160E1 RL_GRID_UBYTE 0 CM_IDENTITY 0 255
 /begin AXIS_DESCR FIX_AXIS NO_INPUT_QUANTITY CM_IDENTITY 4 0 3 FIX_AXIS_PAR_DIST 0 1 4 /end AXIS_DESCR
/end CHARACTERISTIC
/begin CHARACTERISTIC CDCLATV "veroyatnaya damos-veroyatno addr 0x160E9 | code word CARB: lambda sensor aging tv" CURVE 0x160E9 RL_GRID_UBYTE 0 CM_IDENTITY 0 255
 /begin AXIS_DESCR FIX_AXIS NO_INPUT_QUANTITY CM_IDENTITY 4 0 3 FIX_AXIS_PAR_DIST 0 1 4 /end AXIS_DESCR
/end CHARACTERISTIC
/begin CHARACTERISTIC CDCLLR "veroyatnaya damos-veroyatno addr 0x160F1 | code word CARB: idle speed control at limit" CURVE 0x160F1 RL_GRID_UBYTE 0 CM_IDENTITY 0 255
 /begin AXIS_DESCR FIX_AXIS NO_INPUT_QUANTITY CM_IDENTITY 4 0 3 FIX_AXIS_PAR_DIST 0 1 4 /end AXIS_DESCR
/end CHARACTERISTIC
/begin CHARACTERISTIC CDCLM "veroyatnaya damos-veroyatno addr 0x160F9 | code word CARB: air flow sensor" CURVE 0x160F9 RL_GRID_UBYTE 0 CM_IDENTITY 0 255
 /begin AXIS_DESCR FIX_AXIS NO_INPUT_QUANTITY CM_IDENTITY 4 0 3 FIX_AXIS_PAR_DIST 0 1 4 /end AXIS_DESCR
/end CHARACTERISTIC
/begin CHARACTERISTIC CDCLSH "veroyatnaya damos-veroyatno addr 0x16101 | code word CARB: lambda sensor downstream catalyst" CURVE 0x16101 RL_GRID_UBYTE 0 CM_IDENTITY 0 255
 /begin AXIS_DESCR FIX_AXIS NO_INPUT_QUANTITY CM_IDENTITY 4 0 3 FIX_AXIS_PAR_DIST 0 1 4 /end AXIS_DESCR
/end CHARACTERISTIC
/begin CHARACTERISTIC CDCLSV "veroyatnaya damos-veroyatno addr 0x16109 | code word CARB: lambda sensor upstream cat" CURVE 0x16109 RL_GRID_UBYTE 0 CM_IDENTITY 0 255
 /begin AXIS_DESCR FIX_AXIS NO_INPUT_QUANTITY CM_IDENTITY 4 0 3 FIX_AXIS_PAR_DIST 0 1 4 /end AXIS_DESCR
/end CHARACTERISTIC
/begin CHARACTERISTIC CDCLUEA "veroyatnaya damos-veroyatno addr 0x16111 | code word CARB: Power stage engine fan A" CURVE 0x16111 RL_GRID_UBYTE 0 CM_IDENTITY 0 255
 /begin AXIS_DESCR FIX_AXIS NO_INPUT_QUANTITY CM_IDENTITY 4 0 3 FIX_AXIS_PAR_DIST 0 1 4 /end AXIS_DESCR
/end CHARACTERISTIC
/begin CHARACTERISTIC MAP_303_1611B_4 "veroyatnaya mapscan addr 0x1611B" CURVE 0x1611B RL_2D_A16_UWORD 0 CM_IDENTITY 0 65535 /begin AXIS_DESCR STD_AXIS NO_INPUT_QUANTITY CM_IDENTITY 4 0 65535 /end AXIS_DESCR /end CHARACTERISTIC
/begin CHARACTERISTIC CDCMD01 "veroyatnaya damos-veroyatno addr 0x16131 | Code word CARB: misfire cyl. 1" CURVE 0x16131 RL_GRID_UBYTE 0 CM_IDENTITY 0 255
 /begin AXIS_DESCR FIX_AXIS NO_INPUT_QUANTITY CM_IDENTITY 4 0 3 FIX_AXIS_PAR_DIST 0 1 4 /end AXIS_DESCR
/end CHARACTERISTIC
/begin CHARACTERISTIC CDCMD02 "veroyatnaya damos-veroyatno addr 0x16139 | Code word CARB: misfire cylinder 2" CURVE 0x16139 RL_GRID_UBYTE 0 CM_IDENTITY 0 255
 /begin AXIS_DESCR FIX_AXIS NO_INPUT_QUANTITY CM_IDENTITY 4 0 3 FIX_AXIS_PAR_DIST 0 1 4 /end AXIS_DESCR
/end CHARACTERISTIC
/begin CHARACTERISTIC CDCMD03 "veroyatnaya damos-veroyatno addr 0x16141 | Code word CARB: misfire cylinder 3" CURVE 0x16141 RL_GRID_UBYTE 0 CM_IDENTITY 0 255
 /begin AXIS_DESCR FIX_AXIS NO_INPUT_QUANTITY CM_IDENTITY 4 0 3 FIX_AXIS_PAR_DIST 0 1 4 /end AXIS_DESCR
/end CHARACTERISTIC
/begin CHARACTERISTIC CDCMFA "veroyatnaya damos-veroyatno addr 0x16149 | code word CARB: MIL not local fixed" CURVE 0x16149 RL_GRID_UBYTE 0 CM_IDENTITY 0 255
 /begin AXIS_DESCR FIX_AXIS NO_INPUT_QUANTITY CM_IDENTITY 4 0 3 FIX_AXIS_PAR_DIST 0 1 4 /end AXIS_DESCR
/end CHARACTERISTIC
/begin CHARACTERISTIC CDCMFB "veroyatnaya damos-veroyatno addr 0x16151 | code word CARB: MIL external request" CURVE 0x16151 RL_GRID_UBYTE 0 CM_IDENTITY 0 255
 /begin AXIS_DESCR FIX_AXIS NO_INPUT_QUANTITY CM_IDENTITY 4 0 3 FIX_AXIS_PAR_DIST 0 1 4 /end AXIS_DESCR
/end CHARACTERISTIC
/begin CHARACTERISTIC MAP_309_16156_5 "veroyatnaya mapscan addr 0x16156" CURVE 0x16156 RL_2D_A8_UWORD 0 CM_IDENTITY 0 65535 /begin AXIS_DESCR STD_AXIS NO_INPUT_QUANTITY CM_IDENTITY 5 0 255 /end AXIS_DESCR /end CHARACTERISTIC
/begin CHARACTERISTIC CDCPH "veroyatnaya damos-veroyatno addr 0x16169 | code word CARB: phase sensor" CURVE 0x16169 RL_GRID_UBYTE 0 CM_IDENTITY 0 255
 /begin AXIS_DESCR FIX_AXIS NO_INPUT_QUANTITY CM_IDENTITY 4 0 3 FIX_AXIS_PAR_DIST 0 1 4 /end AXIS_DESCR
/end CHARACTERISTIC
/begin CHARACTERISTIC CDCPUA "veroyatnaya damos-veroyatno addr 0x16171 | Code word CARB: ambient pressure adaptation" CURVE 0x16171 RL_GRID_UBYTE 0 CM_IDENTITY 0 255
 /begin AXIS_DESCR FIX_AXIS NO_INPUT_QUANTITY CM_IDENTITY 4 0 3 FIX_AXIS_PAR_DIST 0 1 4 /end AXIS_DESCR
/end CHARACTERISTIC
/begin CHARACTERISTIC CDCRKAT "veroyatnaya damos-veroyatno addr 0x16179 | code word CARB: additive adaptive mixture correction rkat" CURVE 0x16179 RL_GRID_UBYTE 0 CM_IDENTITY 0 255
 /begin AXIS_DESCR FIX_AXIS NO_INPUT_QUANTITY CM_IDENTITY 4 0 3 FIX_AXIS_PAR_DIST 0 1 4 /end AXIS_DESCR
/end CHARACTERISTIC
/begin CHARACTERISTIC CDCRKAZ "veroyatnaya damos-veroyatno addr 0x16181 | code word CARB: additive adaptive mixture correction rkaz" CURVE 0x16181 RL_GRID_UBYTE 0 CM_IDENTITY 0 255
 /begin AXIS_DESCR FIX_AXIS NO_INPUT_QUANTITY CM_IDENTITY 4 0 3 FIX_AXIS_PAR_DIST 0 1 4 /end AXIS_DESCR
/end CHARACTERISTIC
/begin CHARACTERISTIC CDCSGROM "veroyatnaya damos-veroyatno addr 0x16189 | code word CARB: control unit defective (ROM)" CURVE 0x16189 RL_GRID_UBYTE 0 CM_IDENTITY 0 255
 /begin AXIS_DESCR FIX_AXIS NO_INPUT_QUANTITY CM_IDENTITY 4 0 3 FIX_AXIS_PAR_DIST 0 1 4 /end AXIS_DESCR
/end CHARACTERISTIC
/begin CHARACTERISTIC CDCSWE "veroyatnaya damos-veroyatno addr 0x16191 | code word CARB: acceleration sensor for rough surface detection" CURVE 0x16191 RL_GRID_UBYTE 0 CM_IDENTITY 0 255
 /begin AXIS_DESCR FIX_AXIS NO_INPUT_QUANTITY CM_IDENTITY 4 0 3 FIX_AXIS_PAR_DIST 0 1 4 /end AXIS_DESCR
/end CHARACTERISTIC
/begin CHARACTERISTIC CDCTA "veroyatnaya damos-veroyatno addr 0x16199 | code word CARB: intake air temperature" CURVE 0x16199 RL_GRID_UBYTE 0 CM_IDENTITY 0 255
 /begin AXIS_DESCR FIX_AXIS NO_INPUT_QUANTITY CM_IDENTITY 4 0 3 FIX_AXIS_PAR_DIST 0 1 4 /end AXIS_DESCR
/end CHARACTERISTIC
/begin CHARACTERISTIC CDCTES "veroyatnaya damos-veroyatno addr 0x161A1 | code word CARB: canister purge system" CURVE 0x161A1 RL_GRID_UBYTE 0 CM_IDENTITY 0 255
 /begin AXIS_DESCR FIX_AXIS NO_INPUT_QUANTITY CM_IDENTITY 4 0 3 FIX_AXIS_PAR_DIST 0 1 4 /end AXIS_DESCR
/end CHARACTERISTIC
/begin CHARACTERISTIC CDCTEVE "veroyatnaya damos-veroyatno addr 0x161A9 | code word CARB: canister purge valve power stage" CURVE 0x161A9 RL_GRID_UBYTE 0 CM_IDENTITY 0 255
 /begin AXIS_DESCR FIX_AXIS NO_INPUT_QUANTITY CM_IDENTITY 4 0 3 FIX_AXIS_PAR_DIST 0 1 4 /end AXIS_DESCR
/end CHARACTERISTIC
/begin CHARACTERISTIC CDCTHM "veroyatnaya damos-veroyatno addr 0x161B1 | code word CARB: engine thermostat monitoring THM" CURVE 0x161B1 RL_GRID_UBYTE 0 CM_IDENTITY 0 255
 /begin AXIS_DESCR FIX_AXIS NO_INPUT_QUANTITY CM_IDENTITY 4 0 3 FIX_AXIS_PAR_DIST 0 1 4 /end AXIS_DESCR
/end CHARACTERISTIC
/begin CHARACTERISTIC CDCTM "veroyatnaya damos-veroyatno addr 0x161B9 | code word CARB: engine coolant temperature TMOT" CURVE 0x161B9 RL_GRID_UBYTE 0 CM_IDENTITY 0 255
 /begin AXIS_DESCR FIX_AXIS NO_INPUT_QUANTITY CM_IDENTITY 4 0 3 FIX_AXIS_PAR_DIST 0 1 4 /end AXIS_DESCR
/end CHARACTERISTIC
/begin CHARACTERISTIC CDCUB "veroyatnaya damos-veroyatno addr 0x161C1 | code word CARB: battery voltage UB (onboard)" CURVE 0x161C1 RL_GRID_UBYTE 0 CM_IDENTITY 0 255
 /begin AXIS_DESCR FIX_AXIS NO_INPUT_QUANTITY CM_IDENTITY 4 0 3 FIX_AXIS_PAR_DIST 0 1 4 /end AXIS_DESCR
/end CHARACTERISTIC
/begin CHARACTERISTIC CDCVFZ "veroyatnaya damos-veroyatno addr 0x161C9 | code word CARB: vehicle speed signal" CURVE 0x161C9 RL_GRID_UBYTE 0 CM_IDENTITY 0 255
 /begin AXIS_DESCR FIX_AXIS NO_INPUT_QUANTITY CM_IDENTITY 4 0 3 FIX_AXIS_PAR_DIST 0 1 4 /end AXIS_DESCR
/end CHARACTERISTIC
/begin CHARACTERISTIC CDCZOE "veroyatnaya damos-veroyatno addr 0x161D1 | code word CARB: idle speed actuator opening" CURVE 0x161D1 RL_GRID_UBYTE 0 CM_IDENTITY 0 255
 /begin AXIS_DESCR FIX_AXIS NO_INPUT_QUANTITY CM_IDENTITY 4 0 3 FIX_AXIS_PAR_DIST 0 1 4 /end AXIS_DESCR
/end CHARACTERISTIC
/begin CHARACTERISTIC CDCZSE "veroyatnaya damos-veroyatno addr 0x161D9 | code word CARB: idle speed actuator closing" CURVE 0x161D9 RL_GRID_UBYTE 0 CM_IDENTITY 0 255
 /begin AXIS_DESCR FIX_AXIS NO_INPUT_QUANTITY CM_IDENTITY 4 0 3 FIX_AXIS_PAR_DIST 0 1 4 /end AXIS_DESCR
/end CHARACTERISTIC
/begin CHARACTERISTIC CDCZZZ "veroyatnaya damos-veroyatno addr 0x161E1 | Dummy: end of table" CURVE 0x161E1 RL_GRID_UBYTE 0 CM_IDENTITY 0 255
 /begin AXIS_DESCR FIX_AXIS NO_INPUT_QUANTITY CM_IDENTITY 4 0 3 FIX_AXIS_PAR_DIST 0 1 4 /end AXIS_DESCR
/end CHARACTERISTIC
/begin CHARACTERISTIC GRID_326_1637C_16x7 "veroyatnaya gridscan addr 0x1637C" MAP 0x1637C RL_GRID_UBYTE 0 CM_IDENTITY 0 255
 /begin AXIS_DESCR FIX_AXIS NO_INPUT_QUANTITY CM_IDENTITY 16 0 15 FIX_AXIS_PAR_DIST 0 1 16 /end AXIS_DESCR
 /begin AXIS_DESCR FIX_AXIS NO_INPUT_QUANTITY CM_IDENTITY 7 0 6 FIX_AXIS_PAR_DIST 0 1 7 /end AXIS_DESCR
/end CHARACTERISTIC
/begin CHARACTERISTIC FLRAG "veroyatnaya damos-veroyatno addr 0x18291 | amplification of load controller at AT" CURVE 0x18291 RL_GRID_UBYTE 0 CM_0p0625_0 0 15.9375
 /begin AXIS_DESCR FIX_AXIS NO_INPUT_QUANTITY CM_IDENTITY 6 0 5 FIX_AXIS_PAR_DIST 0 1 6 /end AXIS_DESCR
/end CHARACTERISTIC
/begin CHARACTERISTIC FLRAWG "veroyatnaya damos-veroyatno addr 0x18297 | amplification of load controller" CURVE 0x18297 RL_GRID_UBYTE 0 CM_0p0625_0 0 15.9375
 /begin AXIS_DESCR FIX_AXIS NO_INPUT_QUANTITY CM_IDENTITY 6 0 5 FIX_AXIS_PAR_DIST 0 1 6 /end AXIS_DESCR
/end CHARACTERISTIC
/begin CHARACTERISTIC FLRHG "veroyatnaya damos-veroyatno addr 0x1829D | amplification of load controller" CURVE 0x1829D RL_GRID_UBYTE 0 CM_0p0625_0 0 15.9375
 /begin AXIS_DESCR FIX_AXIS NO_INPUT_QUANTITY CM_IDENTITY 6 0 5 FIX_AXIS_PAR_DIST 0 1 6 /end AXIS_DESCR
/end CHARACTERISTIC
/begin CHARACTERISTIC FRARAG "veroyatnaya damos-veroyatno addr 0x182A3 | amplification factor at AT" CURVE 0x182A3 RL_GRID_UBYTE 0 CM_0p01220703125_0_Upm 0 3.11279
 /begin AXIS_DESCR FIX_AXIS NO_INPUT_QUANTITY CM_IDENTITY 6 0 5 FIX_AXIS_PAR_DIST 0 1 6 /end AXIS_DESCR
/end CHARACTERISTIC
/begin CHARACTERISTIC FRARAWG "veroyatnaya damos-veroyatno addr 0x182A9 | amplification factor" CURVE 0x182A9 RL_GRID_UBYTE 0 CM_0p01220703125_0_Upm 0 3.11279
 /begin AXIS_DESCR FIX_AXIS NO_INPUT_QUANTITY CM_IDENTITY 6 0 5 FIX_AXIS_PAR_DIST 0 1 6 /end AXIS_DESCR
/end CHARACTERISTIC
/begin CHARACTERISTIC FRARHG "veroyatnaya damos-veroyatno addr 0x182AF | amplification factor" CURVE 0x182AF RL_GRID_UBYTE 0 CM_0p01220703125_0_Upm 0 3.11279
 /begin AXIS_DESCR FIX_AXIS NO_INPUT_QUANTITY CM_IDENTITY 6 0 5 FIX_AXIS_PAR_DIST 0 1 6 /end AXIS_DESCR
/end CHARACTERISTIC
/begin CHARACTERISTIC DFAUWKN "veroyatnaya damos-veroyatno addr 0x182E6 | Damping ratio for filtering torque on a low clutch torque and op. lockup clutch" CURVE 0x182E6 RL_GRID_UBYTE 0 CM_0p00390625_0 0 0.996094
 /begin AXIS_DESCR FIX_AXIS NO_INPUT_QUANTITY CM_IDENTITY 6 0 5 FIX_AXIS_PAR_DIST 0 1 6 /end AXIS_DESCR
/end CHARACTERISTIC
/begin CHARACTERISTIC DFAWKN "veroyatnaya damos-veroyatno addr 0x182EC | Damping ratio for filtering torque on an openned lockup clutch" CURVE 0x182EC RL_GRID_UBYTE 0 CM_0p00390625_0 0 0.996094
 /begin AXIS_DESCR FIX_AXIS NO_INPUT_QUANTITY CM_IDENTITY 6 0 5 FIX_AXIS_PAR_DIST 0 1 6 /end AXIS_DESCR
/end CHARACTERISTIC
/begin CHARACTERISTIC ZFAUWKN "veroyatnaya damos-veroyatno addr 0x183D0 | lower time constant value for filt. torque on openned lockup clutch" CURVE 0x183D0 RL_GRID_UBYTE 0 CM_IDENTITY 0 255
 /begin AXIS_DESCR FIX_AXIS NO_INPUT_QUANTITY CM_IDENTITY 6 0 5 FIX_AXIS_PAR_DIST 0 1 6 /end AXIS_DESCR
/end CHARACTERISTIC
/begin CHARACTERISTIC ZFAWKN "veroyatnaya damos-veroyatno addr 0x183D6 | time constant for filtering motor torque on openned lockup clutch" CURVE 0x183D6 RL_GRID_UBYTE 0 CM_IDENTITY 0 255
 /begin AXIS_DESCR FIX_AXIS NO_INPUT_QUANTITY CM_IDENTITY 6 0 5 FIX_AXIS_PAR_DIST 0 1 6 /end AXIS_DESCR
/end CHARACTERISTIC
/begin CHARACTERISTIC WPHN "veroyatnaya damos-veroyatno addr 0x183EB | phase correction" CURVE 0x183EB RL_GRID_SBYTE 0 CM_0p75_0_gradKW -96 95.25
 /begin AXIS_DESCR FIX_AXIS NO_INPUT_QUANTITY CM_IDENTITY 8 0 7 FIX_AXIS_PAR_DIST 0 1 8 /end AXIS_DESCR
/end CHARACTERISTIC
/begin CHARACTERISTIC DZWSPM "veroyatnaya damos-veroyatno addr 0x183F3 | delta latest ignition angle relative to engine temperature" CURVE 0x183F3 RL_GRID_SBYTE 0 CM_0p75_0_gradKW -96 95.25
 /begin AXIS_DESCR FIX_AXIS NO_INPUT_QUANTITY CM_IDENTITY 6 0 5 FIX_AXIS_PAR_DIST 0 1 6 /end AXIS_DESCR
/end CHARACTERISTIC
/begin CHARACTERISTIC NWECVTM "veroyatnaya damos-veroyatno addr 0x18471 | Fuel restart-speed at CVT" CURVE 0x18471 RL_GRID_UBYTE 0 CM_40_0_Upm 0 10200
 /begin AXIS_DESCR FIX_AXIS NO_INPUT_QUANTITY CM_IDENTITY 5 0 4 FIX_AXIS_PAR_DIST 0 1 5 /end AXIS_DESCR
/end CHARACTERISTIC
/begin CHARACTERISTIC TVSATM "veroyatnaya damos-veroyatno addr 0x18476 | delay time after cranking for fuel cut off" CURVE 0x18476 RL_GRID_UBYTE 0 CM_IDENTITY 0 255
 /begin AXIS_DESCR FIX_AXIS NO_INPUT_QUANTITY CM_IDENTITY 5 0 4 FIX_AXIS_PAR_DIST 0 1 5 /end AXIS_DESCR
/end CHARACTERISTIC
/begin CHARACTERISTIC NFSM "veroyatnaya damos-veroyatno addr 0x184AA | desired engine speed DRIVE-position switch on" CURVE 0x184AA RL_GRID_UBYTE 0 CM_10_0_Umin 0 2550
 /begin AXIS_DESCR FIX_AXIS NO_INPUT_QUANTITY CM_IDENTITY 6 0 5 FIX_AXIS_PAR_DIST 0 1 6 /end AXIS_DESCR
/end CHARACTERISTIC
/begin CHARACTERISTIC NLLM "veroyatnaya damos-veroyatno addr 0x184B0 | desired engine speed" CURVE 0x184B0 RL_GRID_UBYTE 0 CM_10_0_Umin 0 2550
 /begin AXIS_DESCR FIX_AXIS NO_INPUT_QUANTITY CM_IDENTITY 6 0 5 FIX_AXIS_PAR_DIST 0 1 6 /end AXIS_DESCR
/end CHARACTERISTIC
/begin CHARACTERISTIC LIMXDNS "veroyatnaya damos-veroyatno addr 0x184D9 | upper integrator limit for standing car" CURVE 0x184D9 RL_GRID_UBYTE 0 CM_0p09764705882_0 0 24.9
 /begin AXIS_DESCR FIX_AXIS NO_INPUT_QUANTITY CM_IDENTITY 6 0 5 FIX_AXIS_PAR_DIST 0 1 6 /end AXIS_DESCR
/end CHARACTERISTIC
/begin CHARACTERISTIC LIMXVDNS "veroyatnaya damos-veroyatno addr 0x184DF | upper integrator limit for rolling car" CURVE 0x184DF RL_GRID_UBYTE 0 CM_0p09764705882_0 0 24.9
 /begin AXIS_DESCR FIX_AXIS NO_INPUT_QUANTITY CM_IDENTITY 6 0 5 FIX_AXIS_PAR_DIST 0 1 6 /end AXIS_DESCR
/end CHARACTERISTIC
/begin CHARACTERISTIC LISTM "veroyatnaya damos-veroyatno addr 0x184E5 | value of idle speed control integrator during start" CURVE 0x184E5 RL_GRID_UBYTE 0 CM_0p09764705882_0 0 24.9
 /begin AXIS_DESCR FIX_AXIS NO_INPUT_QUANTITY CM_IDENTITY 6 0 5 FIX_AXIS_PAR_DIST 0 1 6 /end AXIS_DESCR
/end CHARACTERISTIC
/begin CHARACTERISTIC MAP_394_1854A_5 "veroyatnaya mapscan addr 0x1854A" CURVE 0x1854A RL_2D_A8_UBYTE 0 CM_IDENTITY 0 255 /begin AXIS_DESCR STD_AXIS NO_INPUT_QUANTITY CM_IDENTITY 5 0 255 /end AXIS_DESCR /end CHARACTERISTIC
/begin CHARACTERISTIC MAP_395_1856E_8 "veroyatnaya mapscan addr 0x1856E" CURVE 0x1856E RL_2D_A8_UBYTE 0 CM_IDENTITY 0 255 /begin AXIS_DESCR STD_AXIS NO_INPUT_QUANTITY CM_IDENTITY 8 0 255 /end AXIS_DESCR /end CHARACTERISTIC
/begin CHARACTERISTIC MAP_399_18613_10x8 "veroyatnaya mapscan addr 0x18613" MAP 0x18613 RL_3D_A8_UBYTE 0 CM_IDENTITY 0 255 /begin AXIS_DESCR STD_AXIS NO_INPUT_QUANTITY CM_IDENTITY 8 0 255 /end AXIS_DESCR /begin AXIS_DESCR STD_AXIS NO_INPUT_QUANTITY CM_IDENTITY 10 0 255 /end AXIS_DESCR /end CHARACTERISTIC
/begin CHARACTERISTIC WDKHKN "veroyatnaya damos-veroyatno addr 0x186A2 | Low threshold throttle plate for altitude adaptation" CURVE 0x186A2 RL_GRID_UBYTE 0 CM_0p390625_0 0 99.6094
 /begin AXIS_DESCR FIX_AXIS NO_INPUT_QUANTITY CM_IDENTITY 6 0 5 FIX_AXIS_PAR_DIST 0 1 6 /end AXIS_DESCR
/end CHARACTERISTIC
/begin CHARACTERISTIC MAP_407_18768_6 "veroyatnaya mapscan addr 0x18768" CURVE 0x18768 RL_2D_A8_UBYTE 0 CM_IDENTITY 0 255 /begin AXIS_DESCR STD_AXIS NO_INPUT_QUANTITY CM_IDENTITY 6 0 255 /end AXIS_DESCR /end CHARACTERISTIC
/begin CHARACTERISTIC MAP_409_1879A_6 "veroyatnaya mapscan addr 0x1879A" CURVE 0x1879A RL_2D_A8_UBYTE 0 CM_IDENTITY 0 255 /begin AXIS_DESCR STD_AXIS NO_INPUT_QUANTITY CM_IDENTITY 6 0 255 /end AXIS_DESCR /end CHARACTERISTIC
/begin CHARACTERISTIC ATMABKA "veroyatnaya damos-veroyatno addr 0x187E2 | factor reduction of exhaust gas temperature = f(soak time)" CURVE 0x187E2 RL_GRID_UBYTE 0 CM_0p00390625_0 0 0.996094
 /begin AXIS_DESCR FIX_AXIS NO_INPUT_QUANTITY CM_IDENTITY 6 0 5 FIX_AXIS_PAR_DIST 0 1 6 /end AXIS_DESCR
/end CHARACTERISTIC
/begin CHARACTERISTIC ATMABKK "veroyatnaya damos-veroyatno addr 0x187E8 | factor reduction for catalyst temperature = f(soak time)" CURVE 0x187E8 RL_GRID_UBYTE 0 CM_0p00390625_0 0 0.996094
 /begin AXIS_DESCR FIX_AXIS NO_INPUT_QUANTITY CM_IDENTITY 6 0 5 FIX_AXIS_PAR_DIST 0 1 6 /end AXIS_DESCR
/end CHARACTERISTIC
/begin CHARACTERISTIC FATMRML "veroyatnaya damos-veroyatno addr 0x187EF | divide factor exhaust-/exhaust-pipe temperature" CURVE 0x187EF RL_GRID_UBYTE 0 CM_0p00390625_0 0 0.996094
 /begin AXIS_DESCR FIX_AXIS NO_INPUT_QUANTITY CM_IDENTITY 7 0 6 FIX_AXIS_PAR_DIST 0 1 7 /end AXIS_DESCR
/end CHARACTERISTIC
/begin CHARACTERISTIC KATMEXML "veroyatnaya damos-veroyatno addr 0x187F9 | Temperature of the exotherme in the catalyst tkatm" CURVE 0x187F9 RL_GRID_SBYTE 0 CM_5_0_GradC -640 635
 /begin AXIS_DESCR FIX_AXIS NO_INPUT_QUANTITY CM_IDENTITY 7 0 6 FIX_AXIS_PAR_DIST 0 1 7 /end AXIS_DESCR
/end CHARACTERISTIC
/begin CHARACTERISTIC KLATMLAE "veroyatnaya damos-veroyatno addr 0x1889A | Temperature of the exotherme decrease during enrichment" CURVE 0x1889A RL_GRID_UBYTE 0 CM_0p00390625_0 0 0.996094
 /begin AXIS_DESCR FIX_AXIS NO_INPUT_QUANTITY CM_IDENTITY 6 0 5 FIX_AXIS_PAR_DIST 0 1 6 /end AXIS_DESCR
/end CHARACTERISTIC
/begin CHARACTERISTIC KLATMZWE "veroyatnaya damos-veroyatno addr 0x188A0 | Temperature of the exotherme decrease in cat during ignition retard tkatm" CURVE 0x188A0 RL_GRID_UBYTE 0 CM_0p00390625_0 0 0.996094
 /begin AXIS_DESCR FIX_AXIS NO_INPUT_QUANTITY CM_IDENTITY 6 0 5 FIX_AXIS_PAR_DIST 0 1 6 /end AXIS_DESCR
/end CHARACTERISTIC
/begin CHARACTERISTIC MAP_422_188CA_5 "veroyatnaya mapscan addr 0x188CA" CURVE 0x188CA RL_2D_A8_UBYTE 0 CM_IDENTITY 0 255 /begin AXIS_DESCR STD_AXIS NO_INPUT_QUANTITY CM_IDENTITY 5 0 255 /end AXIS_DESCR /end CHARACTERISTIC
/begin CHARACTERISTIC KFRI2 "veroyatnaya damos-veroyatno addr 0x189C1 | LR-I-Map for bank 2" MAP 0x189C1 RL_GRID_UBYTE 0 CM_0p3058103976_0_s 0 77.9817
 /begin AXIS_DESCR FIX_AXIS NO_INPUT_QUANTITY CM_IDENTITY 6 0 5 FIX_AXIS_PAR_DIST 0 1 6 /end AXIS_DESCR
 /begin AXIS_DESCR FIX_AXIS NO_INPUT_QUANTITY CM_IDENTITY 7 0 6 FIX_AXIS_PAR_DIST 0 1 7 /end AXIS_DESCR
/end CHARACTERISTIC
/begin CHARACTERISTIC MAP_432_18ABF_8 "veroyatnaya mapscan addr 0x18ABF" CURVE 0x18ABF RL_2D_A8_UBYTE 0 CM_IDENTITY 0 255 /begin AXIS_DESCR STD_AXIS NO_INPUT_QUANTITY CM_IDENTITY 8 0 255 /end AXIS_DESCR /end CHARACTERISTIC
/begin CHARACTERISTIC RLLRUN "veroyatnaya damos-veroyatno addr 0x18AD2 | char.line above nmot,lower rL control limit for controller in front of catalyst" CURVE 0x18AD2 RL_GRID_UBYTE 0 CM_0p75_0 0 191.25
 /begin AXIS_DESCR FIX_AXIS NO_INPUT_QUANTITY CM_IDENTITY 8 0 7 FIX_AXIS_PAR_DIST 0 1 8 /end AXIS_DESCR
/end CHARACTERISTIC
/begin CHARACTERISTIC KFUSHK "veroyatnaya damos-veroyatno addr 0x18B0E | lambda sensor reference value for lambda control downstream of catalyst" MAP 0x18B0E RL_GRID_SBYTE 0 CM_0p005215686275_0p2_V -0.867608 0.462392
 /begin AXIS_DESCR FIX_AXIS NO_INPUT_QUANTITY CM_IDENTITY 6 0 5 FIX_AXIS_PAR_DIST 0 1 6 /end AXIS_DESCR
 /begin AXIS_DESCR FIX_AXIS NO_INPUT_QUANTITY CM_IDENTITY 6 0 5 FIX_AXIS_PAR_DIST 0 1 6 /end AXIS_DESCR
/end CHARACTERISTIC
/begin CHARACTERISTIC PLRHML "veroyatnaya damos-veroyatno addr 0x18B32 | p-part of LRHK, f(dushk)" CURVE 0x18B32 RL_GRID_SBYTE 0 CM_0p01_0_s -1.28 1.27
 /begin AXIS_DESCR FIX_AXIS NO_INPUT_QUANTITY CM_IDENTITY 8 0 7 FIX_AXIS_PAR_DIST 0 1 8 /end AXIS_DESCR
/end CHARACTERISTIC
/begin CHARACTERISTIC RLLRHON "veroyatnaya damos-veroyatno addr 0x18B3A | char. line on nmot, upper rl control threshold for downstream lambda control" CURVE 0x18B3A RL_GRID_UBYTE 0 CM_0p75_0 0 191.25
 /begin AXIS_DESCR FIX_AXIS NO_INPUT_QUANTITY CM_IDENTITY 8 0 7 FIX_AXIS_PAR_DIST 0 1 8 /end AXIS_DESCR
/end CHARACTERISTIC
/begin CHARACTERISTIC RLLRHUN "veroyatnaya damos-veroyatno addr 0x18B42 | char. line on nmot, lower control threshold rl for downstream lambda control" CURVE 0x18B42 RL_GRID_UBYTE 0 CM_0p75_0 0 191.25
 /begin AXIS_DESCR FIX_AXIS NO_INPUT_QUANTITY CM_IDENTITY 8 0 7 FIX_AXIS_PAR_DIST 0 1 8 /end AXIS_DESCR
/end CHARACTERISTIC
/begin CHARACTERISTIC ZLRHML "veroyatnaya damos-veroyatno addr 0x18B4A | time constant of lambda control integrator downstream catalyst" CURVE 0x18B4A RL_GRID_UBYTE 0 CM_0p0390625_0_mss 0 9.96094
 /begin AXIS_DESCR FIX_AXIS NO_INPUT_QUANTITY CM_IDENTITY 8 0 7 FIX_AXIS_PAR_DIST 0 1 8 /end AXIS_DESCR
/end CHARACTERISTIC
/begin CHARACTERISTIC DTVKAML "veroyatnaya damos-veroyatno addr 0x18B52 | delta-tv for cat oxygen neutralization (air mass dependent)" CURVE 0x18B52 RL_GRID_SBYTE 0 CM_0p01_0_s -1.28 1.27
 /begin AXIS_DESCR FIX_AXIS NO_INPUT_QUANTITY CM_IDENTITY 5 0 4 FIX_AXIS_PAR_DIST 0 1 5 /end AXIS_DESCR
/end CHARACTERISTIC
/begin CHARACTERISTIC DTVKAML2 "veroyatnaya damos-veroyatno addr 0x18B57 | delta-tv for cat oxygen neutralization (air mass dependent) bank2" CURVE 0x18B57 RL_GRID_SBYTE 0 CM_0p01_0_s -1.28 1.27
 /begin AXIS_DESCR FIX_AXIS NO_INPUT_QUANTITY CM_IDENTITY 5 0 4 FIX_AXIS_PAR_DIST 0 1 5 /end AXIS_DESCR
/end CHARACTERISTIC
/begin CHARACTERISTIC FKAXAVKAT "veroyatnaya damos-veroyatno addr 0x18B5D | weighting factor for oxygen capacity depending on avkatf" CURVE 0x18B5D RL_GRID_UBYTE 0 CM_0p00390625_0 0 0.996094
 /begin AXIS_DESCR FIX_AXIS NO_INPUT_QUANTITY CM_IDENTITY 5 0 4 FIX_AXIS_PAR_DIST 0 1 5 /end AXIS_DESCR
/end CHARACTERISTIC
/begin CHARACTERISTIC BTRKHTMS "veroyatnaya damos-veroyatno addr 0x18B6B | Characteristic enabling flag B_trkh" CURVE 0x18B6B RL_GRID_UBYTE 0 CM_IDENTITY 0 255
 /begin AXIS_DESCR FIX_AXIS NO_INPUT_QUANTITY CM_IDENTITY 8 0 7 FIX_AXIS_PAR_DIST 0 1 8 /end AXIS_DESCR
/end CHARACTERISTIC
/begin CHARACTERISTIC FTMLAKH "veroyatnaya damos-veroyatno addr 0x18BB0 | tmot-correction of lambda-weighting at catalyst heating" CURVE 0x18BB0 RL_GRID_UBYTE 0 CM_0p00390625_0 0 0.996094
 /begin AXIS_DESCR FIX_AXIS NO_INPUT_QUANTITY CM_IDENTITY 4 0 3 FIX_AXIS_PAR_DIST 0 1 4 /end AXIS_DESCR
/end CHARACTERISTIC
/begin CHARACTERISTIC MAP_446_18BBA_4 "veroyatnaya mapscan addr 0x18BBA" CURVE 0x18BBA RL_2D_A16_UBYTE 0 CM_IDENTITY 0 255 /begin AXIS_DESCR STD_AXIS NO_INPUT_QUANTITY CM_IDENTITY 4 0 65535 /end AXIS_DESCR /end CHARACTERISTIC
/begin CHARACTERISTIC NFSKHM "veroyatnaya damos-veroyatno addr 0x18C01 | LL nominal speed with driving graduations and catalyzer heating" CURVE 0x18C01 RL_GRID_UBYTE 0 CM_10_0_Umin 0 2550
 /begin AXIS_DESCR FIX_AXIS NO_INPUT_QUANTITY CM_IDENTITY 4 0 3 FIX_AXIS_PAR_DIST 0 1 4 /end AXIS_DESCR
/end CHARACTERISTIC
/begin CHARACTERISTIC FMDKHFH "veroyatnaya damos-veroyatno addr 0x18C10 | altitude correction of torque reserve for catalyst heating" CURVE 0x18C10 RL_GRID_UBYTE 0 CM_0p0078125_0 0 1.99219
 /begin AXIS_DESCR FIX_AXIS NO_INPUT_QUANTITY CM_IDENTITY 4 0 3 FIX_AXIS_PAR_DIST 0 1 4 /end AXIS_DESCR
/end CHARACTERISTIC
/begin CHARACTERISTIC FMDKHTM "veroyatnaya damos-veroyatno addr 0x18C19 | tmot-correction of torque reserve for catalyst heating" CURVE 0x18C19 RL_GRID_UBYTE 0 CM_0p0078125_0 0 1.99219
 /begin AXIS_DESCR FIX_AXIS NO_INPUT_QUANTITY CM_IDENTITY 8 0 7 FIX_AXIS_PAR_DIST 0 1 8 /end AXIS_DESCR
/end CHARACTERISTIC
/begin CHARACTERISTIC MAP_452_18C2A_8 "veroyatnaya mapscan addr 0x18C2A" CURVE 0x18C2A RL_2D_A8_UBYTE 0 CM_IDENTITY 0 255 /begin AXIS_DESCR STD_AXIS NO_INPUT_QUANTITY CM_IDENTITY 8 0 255 /end AXIS_DESCR /end CHARACTERISTIC
/begin CHARACTERISTIC MAP_453_18C7C_8 "veroyatnaya mapscan addr 0x18C7C" CURVE 0x18C7C RL_2D_A8_UBYTE 0 CM_IDENTITY 0 255 /begin AXIS_DESCR STD_AXIS NO_INPUT_QUANTITY CM_IDENTITY 8 0 255 /end AXIS_DESCR /end CHARACTERISTIC
/begin CHARACTERISTIC MAP_454_18CCE_4 "veroyatnaya mapscan addr 0x18CCE" CURVE 0x18CCE RL_2D_A8_UBYTE 0 CM_IDENTITY 0 255 /begin AXIS_DESCR STD_AXIS NO_INPUT_QUANTITY CM_IDENTITY 4 0 255 /end AXIS_DESCR /end CHARACTERISTIC
/begin CHARACTERISTIC MAP_456_18CE9_8 "veroyatnaya mapscan addr 0x18CE9" CURVE 0x18CE9 RL_2D_A8_UBYTE 0 CM_IDENTITY 0 255 /begin AXIS_DESCR STD_AXIS NO_INPUT_QUANTITY CM_IDENTITY 8 0 255 /end AXIS_DESCR /end CHARACTERISTIC
/begin CHARACTERISTIC MAP_458_18D3B_8 "veroyatnaya mapscan addr 0x18D3B" CURVE 0x18D3B RL_2D_A8_UBYTE 0 CM_IDENTITY 0 255 /begin AXIS_DESCR STD_AXIS NO_INPUT_QUANTITY CM_IDENTITY 8 0 255 /end AXIS_DESCR /end CHARACTERISTIC
/begin CHARACTERISTIC LMSTMOT "veroyatnaya damos-veroyatno addr 0x18D4D | tmot-correction of lambda engine nominal" CURVE 0x18D4D RL_GRID_UBYTE 0 CM_0p0078125_0 0 1.99219
 /begin AXIS_DESCR FIX_AXIS NO_INPUT_QUANTITY CM_IDENTITY 4 0 3 FIX_AXIS_PAR_DIST 0 1 4 /end AXIS_DESCR
/end CHARACTERISTIC
/begin CHARACTERISTIC KEMLN "veroyatnaya damos-veroyatno addr 0x18D5D | length of the sampling window for knock control" CURVE 0x18D5D RL_GRID_UBYTE 0 CM_0p75_0_GradKW 0 191.25
 /begin AXIS_DESCR FIX_AXIS NO_INPUT_QUANTITY CM_IDENTITY 16 0 15 FIX_AXIS_PAR_DIST 0 1 16 /end AXIS_DESCR
/end CHARACTERISTIC
/begin CHARACTERISTIC SENZZYL "veroyatnaya damos-veroyatno addr 0x18DB0 | knock sensor for sw-cylinder counter 0-7" CURVE 0x18DB0 RL_GRID_UBYTE 0 CM_1_n1 1 256
 /begin AXIS_DESCR FIX_AXIS NO_INPUT_QUANTITY CM_IDENTITY 8 0 7 FIX_AXIS_PAR_DIST 0 1 8 /end AXIS_DESCR
/end CHARACTERISTIC
/begin CHARACTERISTIC KE1N "veroyatnaya damos-veroyatno addr 0x18DBB | knock detection threshold at cylindertimer 1" CURVE 0x18DBB RL_GRID_UBYTE 0 CM_0p0625_0 0 15.9375
 /begin AXIS_DESCR FIX_AXIS NO_INPUT_QUANTITY CM_IDENTITY 16 0 15 FIX_AXIS_PAR_DIST 0 1 16 /end AXIS_DESCR
/end CHARACTERISTIC
/begin CHARACTERISTIC KE2N "veroyatnaya damos-veroyatno addr 0x18DCB | knock detection threshold at cylindertimer 2" CURVE 0x18DCB RL_GRID_UBYTE 0 CM_0p0625_0 0 15.9375
 /begin AXIS_DESCR FIX_AXIS NO_INPUT_QUANTITY CM_IDENTITY 16 0 15 FIX_AXIS_PAR_DIST 0 1 16 /end AXIS_DESCR
/end CHARACTERISTIC
/begin CHARACTERISTIC KE3N "veroyatnaya damos-veroyatno addr 0x18DDB | knock detection threshold at cylindertimer 3" CURVE 0x18DDB RL_GRID_UBYTE 0 CM_0p0625_0 0 15.9375
 /begin AXIS_DESCR FIX_AXIS NO_INPUT_QUANTITY CM_IDENTITY 16 0 15 FIX_AXIS_PAR_DIST 0 1 16 /end AXIS_DESCR
/end CHARACTERISTIC
/begin CHARACTERISTIC KE4N "veroyatnaya damos-veroyatno addr 0x18DEB | knock detection threshold at cylindertimer 4" CURVE 0x18DEB RL_GRID_UBYTE 0 CM_0p0625_0 0 15.9375
 /begin AXIS_DESCR FIX_AXIS NO_INPUT_QUANTITY CM_IDENTITY 16 0 15 FIX_AXIS_PAR_DIST 0 1 16 /end AXIS_DESCR
/end CHARACTERISTIC
/begin CHARACTERISTIC KE5N "veroyatnaya damos-veroyatno addr 0x18DFB | knock detection threshold at cylindertimer 5" CURVE 0x18DFB RL_GRID_UBYTE 0 CM_0p0625_0 0 15.9375
 /begin AXIS_DESCR FIX_AXIS NO_INPUT_QUANTITY CM_IDENTITY 16 0 15 FIX_AXIS_PAR_DIST 0 1 16 /end AXIS_DESCR
/end CHARACTERISTIC
/begin CHARACTERISTIC KE6N "veroyatnaya damos-veroyatno addr 0x18E0B | knock detection threshold at cylindertimer 6" CURVE 0x18E0B RL_GRID_UBYTE 0 CM_0p0625_0 0 15.9375
 /begin AXIS_DESCR FIX_AXIS NO_INPUT_QUANTITY CM_IDENTITY 16 0 15 FIX_AXIS_PAR_DIST 0 1 16 /end AXIS_DESCR
/end CHARACTERISTIC
/begin CHARACTERISTIC KE7N "veroyatnaya damos-veroyatno addr 0x18E1B | knock detection threshold at cylindertimer 7" CURVE 0x18E1B RL_GRID_UBYTE 0 CM_0p0625_0 0 15.9375
 /begin AXIS_DESCR FIX_AXIS NO_INPUT_QUANTITY CM_IDENTITY 16 0 15 FIX_AXIS_PAR_DIST 0 1 16 /end AXIS_DESCR
/end CHARACTERISTIC
/begin CHARACTERISTIC KE8N "veroyatnaya damos-veroyatno addr 0x18E2B | knock detection threshold at cylindertimer 8" CURVE 0x18E2B RL_GRID_UBYTE 0 CM_0p0625_0 0 15.9375
 /begin AXIS_DESCR FIX_AXIS NO_INPUT_QUANTITY CM_IDENTITY 16 0 15 FIX_AXIS_PAR_DIST 0 1 16 /end AXIS_DESCR
/end CHARACTERISTIC
/begin CHARACTERISTIC RKRMX1N "veroyatnaya damos-veroyatno addr 0x18E3B | Maximum of reference level for knock detection threshold cylinder group 1" CURVE 0x18E3B RL_GRID_UBYTE 0 CM_1p25_0_V 0 318.75
 /begin AXIS_DESCR FIX_AXIS NO_INPUT_QUANTITY CM_IDENTITY 16 0 15 FIX_AXIS_PAR_DIST 0 1 16 /end AXIS_DESCR
/end CHARACTERISTIC
/begin CHARACTERISTIC RKRMX2N "veroyatnaya damos-veroyatno addr 0x18E4B | maximum of reference level for knock detection threshold cylinder group 2" CURVE 0x18E4B RL_GRID_UBYTE 0 CM_1p25_0_V 0 318.75
 /begin AXIS_DESCR FIX_AXIS NO_INPUT_QUANTITY CM_IDENTITY 16 0 15 FIX_AXIS_PAR_DIST 0 1 16 /end AXIS_DESCR
/end CHARACTERISTIC
/begin CHARACTERISTIC DWKRMSN "veroyatnaya damos-veroyatno addr 0x18E5D | delta ignition angle knock control distance from mean retarding" CURVE 0x18E5D RL_GRID_SBYTE 0 CM_n0p75_0_gradKW -95.25 96
 /begin AXIS_DESCR FIX_AXIS NO_INPUT_QUANTITY CM_IDENTITY 16 0 15 FIX_AXIS_PAR_DIST 0 1 16 /end AXIS_DESCR
/end CHARACTERISTIC
/begin CHARACTERISTIC KRAL1N "veroyatnaya damos-veroyatno addr 0x18E6D | load range for adaption maps 1" CURVE 0x18E6D RL_GRID_UBYTE 0 CM_0p75_0 0 191.25
 /begin AXIS_DESCR FIX_AXIS NO_INPUT_QUANTITY CM_IDENTITY 16 0 15 FIX_AXIS_PAR_DIST 0 1 16 /end AXIS_DESCR
/end CHARACTERISTIC
/begin CHARACTERISTIC KRAL2N "veroyatnaya damos-veroyatno addr 0x18E7D | load range dor adaption maps 2" CURVE 0x18E7D RL_GRID_UBYTE 0 CM_0p75_0 0 191.25
 /begin AXIS_DESCR FIX_AXIS NO_INPUT_QUANTITY CM_IDENTITY 16 0 15 FIX_AXIS_PAR_DIST 0 1 16 /end AXIS_DESCR
/end CHARACTERISTIC
/begin CHARACTERISTIC MAP_476_18E8E_4 "veroyatnaya mapscan addr 0x18E8E" CURVE 0x18E8E RL_2D_A16_UBYTE 0 CM_IDENTITY 0 255 /begin AXIS_DESCR STD_AXIS NO_INPUT_QUANTITY CM_IDENTITY 4 0 65535 /end AXIS_DESCR /end CHARACTERISTIC
/begin CHARACTERISTIC KRDWSN "veroyatnaya damos-veroyatno addr 0x18EA3 | knock control delta angle safety" CURVE 0x18EA3 RL_GRID_SBYTE 0 CM_n0p75_0_gradKW -95.25 96
 /begin AXIS_DESCR FIX_AXIS NO_INPUT_QUANTITY CM_IDENTITY 16 0 15 FIX_AXIS_PAR_DIST 0 1 16 /end AXIS_DESCR
/end CHARACTERISTIC
/begin CHARACTERISTIC KRFKN "veroyatnaya damos-veroyatno addr 0x18F05 | retard step knock occurrence" CURVE 0x18F05 RL_GRID_SBYTE 0 CM_n0p75_0_gradKW -95.25 96
 /begin AXIS_DESCR FIX_AXIS NO_INPUT_QUANTITY CM_IDENTITY 16 0 15 FIX_AXIS_PAR_DIST 0 1 16 /end AXIS_DESCR
/end CHARACTERISTIC
/begin CHARACTERISTIC KRMXN "veroyatnaya damos-veroyatno addr 0x18F15 | maximum retard adjustment" CURVE 0x18F15 RL_GRID_SBYTE 0 CM_n0p75_0_gradKW -95.25 96
 /begin AXIS_DESCR FIX_AXIS NO_INPUT_QUANTITY CM_IDENTITY 16 0 15 FIX_AXIS_PAR_DIST 0 1 16 /end AXIS_DESCR
/end CHARACTERISTIC
/begin CHARACTERISTIC KRNLZAR "veroyatnaya damos-veroyatno addr 0x18F25 | cylinder individual rpm limit for lead by leading cylinder" CURVE 0x18F25 RL_GRID_UBYTE 0 CM_40_0_Upm 0 10200
 /begin AXIS_DESCR FIX_AXIS NO_INPUT_QUANTITY CM_IDENTITY 8 0 7 FIX_AXIS_PAR_DIST 0 1 8 /end AXIS_DESCR
/end CHARACTERISTIC
/begin CHARACTERISTIC KRVFN "veroyatnaya damos-veroyatno addr 0x18F2D | number of firings/cyl. or time for ignition advancing" CURVE 0x18F2D RL_GRID_UBYTE 0 CM_IDENTITY 0 255
 /begin AXIS_DESCR FIX_AXIS NO_INPUT_QUANTITY CM_IDENTITY 16 0 15 FIX_AXIS_PAR_DIST 0 1 16 /end AXIS_DESCR
/end CHARACTERISTIC
/begin CHARACTERISTIC MAP_482_18F3D_4 "veroyatnaya mapscan addr 0x18F3D" CURVE 0x18F3D RL_2D_A8_UWORD 0 CM_IDENTITY 0 65535 /begin AXIS_DESCR STD_AXIS NO_INPUT_QUANTITY CM_IDENTITY 4 0 255 /end AXIS_DESCR /end CHARACTERISTIC
/begin CHARACTERISTIC LKRN "veroyatnaya damos-veroyatno addr 0x18F4D | load-signal threshold knock control" CURVE 0x18F4D RL_GRID_UBYTE 0 CM_0p75_0 0 191.25
 /begin AXIS_DESCR FIX_AXIS NO_INPUT_QUANTITY CM_IDENTITY 16 0 15 FIX_AXIS_PAR_DIST 0 1 16 /end AXIS_DESCR
/end CHARACTERISTIC
/begin CHARACTERISTIC MAP_484_18F61_4 "veroyatnaya mapscan addr 0x18F61" CURVE 0x18F61 RL_2D_A8_UBYTE 0 CM_IDENTITY 0 255 /begin AXIS_DESCR STD_AXIS NO_INPUT_QUANTITY CM_IDENTITY 4 0 255 /end AXIS_DESCR /end CHARACTERISTIC
/begin CHARACTERISTIC MAP_485_18F71_4 "veroyatnaya mapscan addr 0x18F71" CURVE 0x18F71 RL_2D_A8_UBYTE 0 CM_IDENTITY 0 255 /begin AXIS_DESCR STD_AXIS NO_INPUT_QUANTITY CM_IDENTITY 4 0 255 /end AXIS_DESCR /end CHARACTERISTIC
/begin CHARACTERISTIC MAP_486_18FA2_4 "veroyatnaya mapscan addr 0x18FA2" CURVE 0x18FA2 RL_2D_A8_UBYTE 0 CM_IDENTITY 0 255 /begin AXIS_DESCR STD_AXIS NO_INPUT_QUANTITY CM_IDENTITY 4 0 255 /end AXIS_DESCR /end CHARACTERISTIC
/begin CHARACTERISTIC MAP_487_18FB2_4 "veroyatnaya mapscan addr 0x18FB2" CURVE 0x18FB2 RL_2D_A8_UBYTE 0 CM_IDENTITY 0 255 /begin AXIS_DESCR STD_AXIS NO_INPUT_QUANTITY CM_IDENTITY 4 0 255 /end AXIS_DESCR /end CHARACTERISTIC
/begin CHARACTERISTIC WDKSLN "veroyatnaya damos-veroyatno addr 0x18FCB | Throttle valve angle threshold for idle detection" CURVE 0x18FCB RL_GRID_UBYTE 0 CM_0p3921568627_0_DK 0 100
 /begin AXIS_DESCR FIX_AXIS NO_INPUT_QUANTITY CM_IDENTITY 6 0 5 FIX_AXIS_PAR_DIST 0 1 6 /end AXIS_DESCR
/end CHARACTERISTIC
/begin CHARACTERISTIC MAP_489_18FD6_4 "veroyatnaya mapscan addr 0x18FD6" CURVE 0x18FD6 RL_2D_A8_UBYTE 0 CM_IDENTITY 0 255 /begin AXIS_DESCR STD_AXIS NO_INPUT_QUANTITY CM_IDENTITY 4 0 255 /end AXIS_DESCR /end CHARACTERISTIC
/begin CHARACTERISTIC SNM08GKUB "veroyatnaya damos-veroyatno addr 0x19078 | Datapoint distribution mixture control 8 nmot datapoints" CURVE 0x19078 RL_GRID_UBYTE 0 CM_IDENTITY 0 255
 /begin AXIS_DESCR FIX_AXIS NO_INPUT_QUANTITY CM_IDENTITY 8 0 7 FIX_AXIS_PAR_DIST 0 1 8 /end AXIS_DESCR
/end CHARACTERISTIC
/begin CHARACTERISTIC MAP_493_19081_8 "veroyatnaya mapscan addr 0x19081" CURVE 0x19081 RL_2D_A8_UBYTE 0 CM_IDENTITY 0 255 /begin AXIS_DESCR STD_AXIS NO_INPUT_QUANTITY CM_IDENTITY 8 0 255 /end AXIS_DESCR /end CHARACTERISTIC
/begin CHARACTERISTIC WEAN "veroyatnaya damos-veroyatno addr 0x19093 | angle injection break off" CURVE 0x19093 RL_GRID_UBYTE 0 CM_6_0_GradKW 0 1530
 /begin AXIS_DESCR FIX_AXIS NO_INPUT_QUANTITY CM_IDENTITY 8 0 7 FIX_AXIS_PAR_DIST 0 1 8 /end AXIS_DESCR
/end CHARACTERISTIC
/begin CHARACTERISTIC WEEM "veroyatnaya damos-veroyatno addr 0x1909B | correction of prestorage angle" CURVE 0x1909B RL_GRID_UBYTE 0 CM_6_0_GradKW 0 1530
 /begin AXIS_DESCR FIX_AXIS NO_INPUT_QUANTITY CM_IDENTITY 8 0 7 FIX_AXIS_PAR_DIST 0 1 8 /end AXIS_DESCR
/end CHARACTERISTIC
/begin CHARACTERISTIC WEEMRFAN "veroyatnaya damos-veroyatno addr 0x190A3 | end of injection angle at max relative driver request" CURVE 0x190A3 RL_GRID_UBYTE 0 CM_6_0_GradKW 0 1530
 /begin AXIS_DESCR FIX_AXIS NO_INPUT_QUANTITY CM_IDENTITY 8 0 7 FIX_AXIS_PAR_DIST 0 1 8 /end AXIS_DESCR
/end CHARACTERISTIC
/begin CHARACTERISTIC WEESTM "veroyatnaya damos-veroyatno addr 0x190AB | correction of pretiming of injection during start" CURVE 0x190AB RL_GRID_UBYTE 0 CM_6_0_GradKW 0 1530
 /begin AXIS_DESCR FIX_AXIS NO_INPUT_QUANTITY CM_IDENTITY 8 0 7 FIX_AXIS_PAR_DIST 0 1 8 /end AXIS_DESCR
/end CHARACTERISTIC
/begin CHARACTERISTIC ZZWEETM "veroyatnaya damos-veroyatno addr 0x190BD | Switchover threshold pattern angle" CURVE 0x190BD RL_GRID_UBYTE 0 CM_IDENTITY 0 255
 /begin AXIS_DESCR FIX_AXIS NO_INPUT_QUANTITY CM_IDENTITY 8 0 7 FIX_AXIS_PAR_DIST 0 1 8 /end AXIS_DESCR
/end CHARACTERISTIC
/begin CHARACTERISTIC FSTHO "veroyatnaya damos-veroyatno addr 0x191AD | weighting of factor start" CURVE 0x191AD RL_GRID_UBYTE 0 CM_0p0078125_0 0 1.99219
 /begin AXIS_DESCR FIX_AXIS NO_INPUT_QUANTITY CM_IDENTITY 4 0 3 FIX_AXIS_PAR_DIST 0 1 4 /end AXIS_DESCR
/end CHARACTERISTIC
/begin CHARACTERISTIC FNSA "veroyatnaya damos-veroyatno addr 0x191B5 | after start increase" CURVE 0x191B5 RL_GRID_UBYTE 0 CM_0p0078125_0 0 1.99219
 /begin AXIS_DESCR FIX_AXIS NO_INPUT_QUANTITY CM_IDENTITY 6 0 5 FIX_AXIS_PAR_DIST 0 1 6 /end AXIS_DESCR
/end CHARACTERISTIC
/begin CHARACTERISTIC FNSHO "veroyatnaya damos-veroyatno addr 0x191BC | weighting of afterstart enrichment" CURVE 0x191BC RL_GRID_UBYTE 0 CM_0p0078125_0 0 1.99219
 /begin AXIS_DESCR FIX_AXIS NO_INPUT_QUANTITY CM_IDENTITY 4 0 3 FIX_AXIS_PAR_DIST 0 1 4 /end AXIS_DESCR
/end CHARACTERISTIC
/begin CHARACTERISTIC SZANSSM2 "veroyatnaya damos-veroyatno addr 0x191D3 | switching level 2 of afterstart enrichment" CURVE 0x191D3 RL_GRID_UBYTE 0 CM_0p00390625_0 0 0.996094
 /begin AXIS_DESCR FIX_AXIS NO_INPUT_QUANTITY CM_IDENTITY 12 0 11 FIX_AXIS_PAR_DIST 0 1 12 /end AXIS_DESCR
/end CHARACTERISTIC
/begin CHARACTERISTIC LASWLTM "veroyatnaya damos-veroyatno addr 0x192FF | offset lambda engine nominal with inactive A/F control" CURVE 0x192FF RL_GRID_SBYTE 0 CM_0p0078125_0 -1 0.992188
 /begin AXIS_DESCR FIX_AXIS NO_INPUT_QUANTITY CM_IDENTITY 12 0 11 FIX_AXIS_PAR_DIST 0 1 12 /end AXIS_DESCR
/end CHARACTERISTIC
/begin CHARACTERISTIC KFABAK_1931E "veroyatnaya damos-veroyatno addr 0x1931E | share factor wall wetting for acceleration enrichment" MAP 0x1931E RL_GRID_UBYTE 0 CM_0p00390625_0 0 0.996094
 /begin AXIS_DESCR FIX_AXIS NO_INPUT_QUANTITY CM_IDENTITY 7 0 6 FIX_AXIS_PAR_DIST 0 1 7 /end AXIS_DESCR
 /begin AXIS_DESCR FIX_AXIS NO_INPUT_QUANTITY CM_IDENTITY 9 0 8 FIX_AXIS_PAR_DIST 0 1 9 /end AXIS_DESCR
/end CHARACTERISTIC
/begin CHARACTERISTIC KFAVAK_1935D "veroyatnaya damos-veroyatno addr 0x1935D | share factor wall wetting for deceleration enleanment" MAP 0x1935D RL_GRID_UBYTE 0 CM_0p00390625_0 0 0.996094
 /begin AXIS_DESCR FIX_AXIS NO_INPUT_QUANTITY CM_IDENTITY 7 0 6 FIX_AXIS_PAR_DIST 0 1 7 /end AXIS_DESCR
 /begin AXIS_DESCR FIX_AXIS NO_INPUT_QUANTITY CM_IDENTITY 9 0 8 FIX_AXIS_PAR_DIST 0 1 9 /end AXIS_DESCR
/end CHARACTERISTIC
/begin CHARACTERISTIC KFBAKL_1939C "veroyatnaya damos-veroyatno addr 0x1939C | factor accel. enrichment (short- and long-time part)" MAP 0x1939C RL_GRID_UBYTE 0 CM_0p0625_0 0 15.9375
 /begin AXIS_DESCR FIX_AXIS NO_INPUT_QUANTITY CM_IDENTITY 7 0 6 FIX_AXIS_PAR_DIST 0 1 7 /end AXIS_DESCR
 /begin AXIS_DESCR FIX_AXIS NO_INPUT_QUANTITY CM_IDENTITY 9 0 8 FIX_AXIS_PAR_DIST 0 1 9 /end AXIS_DESCR
/end CHARACTERISTIC
/begin CHARACTERISTIC MAP_512_193E0_9 "veroyatnaya mapscan addr 0x193E0" CURVE 0x193E0 RL_2D_A8_UBYTE 0 CM_IDENTITY 0 255 /begin AXIS_DESCR STD_AXIS NO_INPUT_QUANTITY CM_IDENTITY 9 0 255 /end AXIS_DESCR /end CHARACTERISTIC
/begin CHARACTERISTIC ZBALM "veroyatnaya damos-veroyatno addr 0x1941A | reduction factor L-memory (tmot) for accel. enrichment" CURVE 0x1941A RL_GRID_UBYTE 0 CM_0p00048828125_0 0 0.124512
 /begin AXIS_DESCR FIX_AXIS NO_INPUT_QUANTITY CM_IDENTITY 9 0 8 FIX_AXIS_PAR_DIST 0 1 9 /end AXIS_DESCR
/end CHARACTERISTIC
/begin CHARACTERISTIC ZVALM "veroyatnaya damos-veroyatno addr 0x19423 | reduction factor L-memory (tmot) for decel. enleanment" CURVE 0x19423 RL_GRID_UBYTE 0 CM_0p00048828125_0 0 0.124512
 /begin AXIS_DESCR FIX_AXIS NO_INPUT_QUANTITY CM_IDENTITY 9 0 8 FIX_AXIS_PAR_DIST 0 1 9 /end AXIS_DESCR
/end CHARACTERISTIC
/begin CHARACTERISTIC LAMLGMTM "veroyatnaya damos-veroyatno addr 0x19434 | lambda limit 'lean'" CURVE 0x19434 RL_GRID_UBYTE 0 CM_0p0078125_0 0 1.99219
 /begin AXIS_DESCR FIX_AXIS NO_INPUT_QUANTITY CM_IDENTITY 12 0 11 FIX_AXIS_PAR_DIST 0 1 12 /end AXIS_DESCR
/end CHARACTERISTIC
/begin CHARACTERISTIC WDKARN "veroyatnaya damos-veroyatno addr 0x19441 | threshold throttle angle for activation of the mixture adaptation" CURVE 0x19441 RL_GRID_UBYTE 0 CM_0p390625_0 0 99.6094
 /begin AXIS_DESCR FIX_AXIS NO_INPUT_QUANTITY CM_IDENTITY 10 0 9 FIX_AXIS_PAR_DIST 0 1 10 /end AXIS_DESCR
/end CHARACTERISTIC
/begin CHARACTERISTIC FMRFAZTE "veroyatnaya damos-veroyatno addr 0x19457 | weighting of engine speed to calculate current power" CURVE 0x19457 RL_GRID_UBYTE 0 CM_0p015625_0 0 3.98438
 /begin AXIS_DESCR FIX_AXIS NO_INPUT_QUANTITY CM_IDENTITY 4 0 3 FIX_AXIS_PAR_DIST 0 1 4 /end AXIS_DESCR
/end CHARACTERISTIC
/begin CHARACTERISTIC FBZFRAT "veroyatnaya damos-veroyatno addr 0x19464 | weighting factor for integration speed KFFRAT as f(abo)" CURVE 0x19464 RL_GRID_UBYTE 0 CM_0p00390625_0 0 0.996094
 /begin AXIS_DESCR FIX_AXIS NO_INPUT_QUANTITY CM_IDENTITY 5 0 4 FIX_AXIS_PAR_DIST 0 1 5 /end AXIS_DESCR
/end CHARACTERISTIC
/begin CHARACTERISTIC MAP_521_196F8_5 "veroyatnaya mapscan addr 0x196F8" CURVE 0x196F8 RL_2D_A8_UBYTE 0 CM_IDENTITY 0 255 /begin AXIS_DESCR STD_AXIS NO_INPUT_QUANTITY CM_IDENTITY 5 0 255 /end AXIS_DESCR /end CHARACTERISTIC
/begin CHARACTERISTIC MAP_523_19719_8 "veroyatnaya mapscan addr 0x19719" CURVE 0x19719 RL_2D_A8_UBYTE 0 CM_IDENTITY 0 255 /begin AXIS_DESCR STD_AXIS NO_INPUT_QUANTITY CM_IDENTITY 8 0 255 /end AXIS_DESCR /end CHARACTERISTIC
/begin CHARACTERISTIC MAP_525_1976E_6 "veroyatnaya mapscan addr 0x1976E" CURVE 0x1976E RL_2D_A8_UBYTE 0 CM_IDENTITY 0 255 /begin AXIS_DESCR STD_AXIS NO_INPUT_QUANTITY CM_IDENTITY 6 0 255 /end AXIS_DESCR /end CHARACTERISTIC
/begin CHARACTERISTIC MAP_526_1977E_5 "veroyatnaya mapscan addr 0x1977E" CURVE 0x1977E RL_2D_A8_UBYTE 0 CM_IDENTITY 0 255 /begin AXIS_DESCR STD_AXIS NO_INPUT_QUANTITY CM_IDENTITY 5 0 255 /end AXIS_DESCR /end CHARACTERISTIC
/begin CHARACTERISTIC MAP_527_1979E_6 "veroyatnaya mapscan addr 0x1979E" CURVE 0x1979E RL_2D_A8_UBYTE 0 CM_IDENTITY 0 255 /begin AXIS_DESCR STD_AXIS NO_INPUT_QUANTITY CM_IDENTITY 6 0 255 /end AXIS_DESCR /end CHARACTERISTIC
/begin CHARACTERISTIC MAP_533_198B4_5 "veroyatnaya mapscan addr 0x198B4" CURVE 0x198B4 RL_2D_A8_UWORD 0 CM_IDENTITY 0 65535 /begin AXIS_DESCR STD_AXIS NO_INPUT_QUANTITY CM_IDENTITY 5 0 255 /end AXIS_DESCR /end CHARACTERISTIC
/begin CHARACTERISTIC MAP_537_19950_14 "veroyatnaya mapscan addr 0x19950" CURVE 0x19950 RL_2D_A8_UBYTE 0 CM_IDENTITY 0 255 /begin AXIS_DESCR STD_AXIS NO_INPUT_QUANTITY CM_IDENTITY 14 0 255 /end AXIS_DESCR /end CHARACTERISTIC
/begin CHARACTERISTIC DTLRTML "veroyatnaya damos-veroyatno addr 0x19A1B | proportion factor to decrease waiting time up to tmot-threshold for closed loop" CURVE 0x19A1B RL_GRID_UBYTE 0 CM_0p390625_0 0 99.6094
 /begin AXIS_DESCR FIX_AXIS NO_INPUT_QUANTITY CM_IDENTITY 7 0 6 FIX_AXIS_PAR_DIST 0 1 7 /end AXIS_DESCR
/end CHARACTERISTIC
/begin CHARACTERISTIC TMLRTMS "veroyatnaya damos-veroyatno addr 0x19A26 | engine temp. threshold for lambda control depending on cranking temp. tmst" CURVE 0x19A26 RL_GRID_SBYTE 0 CM_0p75_48_GradC -144 47.25
 /begin AXIS_DESCR FIX_AXIS NO_INPUT_QUANTITY CM_IDENTITY 4 0 3 FIX_AXIS_PAR_DIST 0 1 4 /end AXIS_DESCR
/end CHARACTERISTIC
/begin CHARACTERISTIC MAP_541_19A2F_20 "veroyatnaya mapscan addr 0x19A2F" CURVE 0x19A2F RL_2D_A8_UBYTE 0 CM_IDENTITY 0 255 /begin AXIS_DESCR STD_AXIS NO_INPUT_QUANTITY CM_IDENTITY 20 0 255 /end AXIS_DESCR /end CHARACTERISTIC
/begin CHARACTERISTIC TWLRTMS "veroyatnaya damos-veroyatno addr 0x19A5A | waiting time up to check engine temp. signal exceeding threshold for closed loop" CURVE 0x19A5A RL_GRID_UBYTE 0 CM_20_0_s 0 5100
 /begin AXIS_DESCR FIX_AXIS NO_INPUT_QUANTITY CM_IDENTITY 4 0 3 FIX_AXIS_PAR_DIST 0 1 4 /end AXIS_DESCR
/end CHARACTERISTIC
/begin CHARACTERISTIC MAP_543_19A6B_20 "veroyatnaya mapscan addr 0x19A6B" CURVE 0x19A6B RL_2D_A8_UBYTE 0 CM_IDENTITY 0 255 /begin AXIS_DESCR STD_AXIS NO_INPUT_QUANTITY CM_IDENTITY 20 0 255 /end AXIS_DESCR /end CHARACTERISTIC
/begin CHARACTERISTIC MAP_544_19AAC_4 "veroyatnaya mapscan addr 0x19AAC" CURVE 0x19AAC RL_2D_A8_UBYTE 0 CM_IDENTITY 0 255 /begin AXIS_DESCR STD_AXIS NO_INPUT_QUANTITY CM_IDENTITY 4 0 255 /end AXIS_DESCR /end CHARACTERISTIC
/begin CHARACTERISTIC LURKH "veroyatnaya damos-veroyatno addr 0x19AD3 | dmrkh-depen. engine roughness reference correction value, during cat heating" CURVE 0x19AD3 RL_GRID_UBYTE 0 CM_0p0078125_0 0 1.99219
 /begin AXIS_DESCR FIX_AXIS NO_INPUT_QUANTITY CM_IDENTITY 4 0 3 FIX_AXIS_PAR_DIST 0 1 4 /end AXIS_DESCR
/end CHARACTERISTIC
/begin CHARACTERISTIC AINTKAN "veroyatnaya damos-veroyatno addr 0x19ADB | number of interval misfire frequency at which ti- cutoff" CURVE 0x19ADB RL_GRID_UBYTE 0 CM_IDENTITY 0 255
 /begin AXIS_DESCR FIX_AXIS NO_INPUT_QUANTITY CM_IDENTITY 8 0 7 FIX_AXIS_PAR_DIST 0 1 8 /end AXIS_DESCR
/end CHARACTERISTIC
/begin CHARACTERISTIC SLX06TMUW "veroyatnaya damos-veroyatno addr 0x19BE6 | lamsbg dependet basic point (number 6)" CURVE 0x19BE6 RL_GRID_UBYTE 0 CM_IDENTITY 0 255
 /begin AXIS_DESCR FIX_AXIS NO_INPUT_QUANTITY CM_IDENTITY 6 0 5 FIX_AXIS_PAR_DIST 0 1 6 /end AXIS_DESCR
/end CHARACTERISTIC
/begin CHARACTERISTIC SML07TMUW "veroyatnaya damos-veroyatno addr 0x19BF4 | ml dependet basic point (number 7)" CURVE 0x19BF4 RL_GRID_UBYTE 0 CM_IDENTITY 0 255
 /begin AXIS_DESCR FIX_AXIS NO_INPUT_QUANTITY CM_IDENTITY 7 0 6 FIX_AXIS_PAR_DIST 0 1 7 /end AXIS_DESCR
/end CHARACTERISTIC
/begin CHARACTERISTIC SRL04DYUB "veroyatnaya damos-veroyatno addr 0x19C04 | basepoint distribution of rl, 4 basepoints" CURVE 0x19C04 RL_GRID_UBYTE 0 CM_IDENTITY 0 255
 /begin AXIS_DESCR FIX_AXIS NO_INPUT_QUANTITY CM_IDENTITY 4 0 3 FIX_AXIS_PAR_DIST 0 1 4 /end AXIS_DESCR
/end CHARACTERISTIC
/begin CHARACTERISTIC KIFZGAG "veroyatnaya damos-veroyatno addr 0x1A62E | amplification of vehicle model integrator at AT" CURVE 0x1A62E RL_GRID_UWORD 0 CM_0p07421875_0 0 4863.93
 /begin AXIS_DESCR FIX_AXIS NO_INPUT_QUANTITY CM_IDENTITY 6 0 5 FIX_AXIS_PAR_DIST 0 1 6 /end AXIS_DESCR
/end CHARACTERISTIC
/begin CHARACTERISTIC KIFZGAWG "veroyatnaya damos-veroyatno addr 0x1A63A | amplification of vehicle model integrator at AT" CURVE 0x1A63A RL_GRID_UWORD 0 CM_0p07421875_0 0 4863.93
 /begin AXIS_DESCR FIX_AXIS NO_INPUT_QUANTITY CM_IDENTITY 6 0 5 FIX_AXIS_PAR_DIST 0 1 6 /end AXIS_DESCR
/end CHARACTERISTIC
/begin CHARACTERISTIC KIFZGHG "veroyatnaya damos-veroyatno addr 0x1A646 | amplification of vehicle model integrator at AT" CURVE 0x1A646 RL_GRID_UWORD 0 CM_0p07421875_0 0 4863.93
 /begin AXIS_DESCR FIX_AXIS NO_INPUT_QUANTITY CM_IDENTITY 6 0 5 FIX_AXIS_PAR_DIST 0 1 6 /end AXIS_DESCR
/end CHARACTERISTIC
/begin CHARACTERISTIC MKLWON "veroyatnaya damos-veroyatno addr 0x1A652 | upper clutch torque threshold for antijerking function" CURVE 0x1A652 RL_GRID_SBYTE 0 CM_0p003051757812_0 -0.390625 0.387573
 /begin AXIS_DESCR FIX_AXIS NO_INPUT_QUANTITY CM_IDENTITY 6 0 5 FIX_AXIS_PAR_DIST 0 1 6 /end AXIS_DESCR
/end CHARACTERISTIC
/begin CHARACTERISTIC MKLWOWKN "veroyatnaya damos-veroyatno addr 0x1A65E | upper clutch torque threshold for antijerking on an openned lockup clutch" CURVE 0x1A65E RL_GRID_SBYTE 0 CM_0p003051757812_0 -0.390625 0.387573
 /begin AXIS_DESCR FIX_AXIS NO_INPUT_QUANTITY CM_IDENTITY 6 0 5 FIX_AXIS_PAR_DIST 0 1 6 /end AXIS_DESCR
/end CHARACTERISTIC
/begin CHARACTERISTIC MKLWSAN "veroyatnaya damos-veroyatno addr 0x1A66A | lower clutch torque threshold for antijerking on fuell cutoff restart" CURVE 0x1A66A RL_GRID_SBYTE 0 CM_0p003051757812_0 -0.390625 0.387573
 /begin AXIS_DESCR FIX_AXIS NO_INPUT_QUANTITY CM_IDENTITY 6 0 5 FIX_AXIS_PAR_DIST 0 1 6 /end AXIS_DESCR
/end CHARACTERISTIC
/begin CHARACTERISTIC MKLWUN "veroyatnaya damos-veroyatno addr 0x1A676 | lower clutch torque threshold for antijerking" CURVE 0x1A676 RL_GRID_SBYTE 0 CM_0p003051757812_0 -0.390625 0.387573
 /begin AXIS_DESCR FIX_AXIS NO_INPUT_QUANTITY CM_IDENTITY 6 0 5 FIX_AXIS_PAR_DIST 0 1 6 /end AXIS_DESCR
/end CHARACTERISTIC
/begin CHARACTERISTIC MKLWUWKN "veroyatnaya damos-veroyatno addr 0x1A682 | lower clutch torque threshold for antijerking on an openned lockup clutch" CURVE 0x1A682 RL_GRID_SBYTE 0 CM_0p003051757812_0 -0.390625 0.387573
 /begin AXIS_DESCR FIX_AXIS NO_INPUT_QUANTITY CM_IDENTITY 6 0 5 FIX_AXIS_PAR_DIST 0 1 6 /end AXIS_DESCR
/end CHARACTERISTIC
/begin CHARACTERISTIC MAP_561_1A692_12 "veroyatnaya mapscan addr 0x1A692" CURVE 0x1A692 RL_2D_A8_UWORD 0 CM_IDENTITY 0 65535 /begin AXIS_DESCR STD_AXIS NO_INPUT_QUANTITY CM_IDENTITY 12 0 255 /end AXIS_DESCR /end CHARACTERISTIC
/begin CHARACTERISTIC MAP_565_1A84A_6 "veroyatnaya mapscan addr 0x1A84A" CURVE 0x1A84A RL_2D_A8_UWORD 0 CM_IDENTITY 0 65535 /begin AXIS_DESCR STD_AXIS NO_INPUT_QUANTITY CM_IDENTITY 6 0 255 /end AXIS_DESCR /end CHARACTERISTIC
/begin CHARACTERISTIC MAP_566_1A88A_6 "veroyatnaya mapscan addr 0x1A88A" CURVE 0x1A88A RL_2D_A8_UWORD 0 CM_IDENTITY 0 65535 /begin AXIS_DESCR STD_AXIS NO_INPUT_QUANTITY CM_IDENTITY 6 0 255 /end AXIS_DESCR /end CHARACTERISTIC
/begin CHARACTERISTIC MAP_568_1A945_4 "veroyatnaya mapscan addr 0x1A945" CURVE 0x1A945 RL_2D_A16_UWORD 0 CM_IDENTITY 0 65535 /begin AXIS_DESCR STD_AXIS NO_INPUT_QUANTITY CM_IDENTITY 4 0 65535 /end AXIS_DESCR /end CHARACTERISTIC
/begin CHARACTERISTIC MAP_569_1A965_4 "veroyatnaya mapscan addr 0x1A965" CURVE 0x1A965 RL_2D_A16_UWORD 0 CM_IDENTITY 0 65535 /begin AXIS_DESCR STD_AXIS NO_INPUT_QUANTITY CM_IDENTITY 4 0 65535 /end AXIS_DESCR /end CHARACTERISTIC
/begin CHARACTERISTIC FPVMXN "veroyatnaya damos-veroyatno addr 0x1A986 | factor for pressure ratio maximum" CURVE 0x1A986 RL_GRID_UWORD 0 CM_3p051757812En05_0 0 1.99997
 /begin AXIS_DESCR FIX_AXIS NO_INPUT_QUANTITY CM_IDENTITY 6 0 5 FIX_AXIS_PAR_DIST 0 1 6 /end AXIS_DESCR
/end CHARACTERISTIC
/begin CHARACTERISTIC MAP_572_1AA3A_4 "veroyatnaya mapscan addr 0x1AA3A" CURVE 0x1AA3A RL_2D_A8_UWORD 0 CM_IDENTITY 0 65535 /begin AXIS_DESCR STD_AXIS NO_INPUT_QUANTITY CM_IDENTITY 4 0 255 /end AXIS_DESCR /end CHARACTERISTIC
/begin CHARACTERISTIC MAP_573_1AB22_4 "veroyatnaya mapscan addr 0x1AB22" CURVE 0x1AB22 RL_2D_A8_UWORD 0 CM_IDENTITY 0 65535 /begin AXIS_DESCR STD_AXIS NO_INPUT_QUANTITY CM_IDENTITY 4 0 255 /end AXIS_DESCR /end CHARACTERISTIC
/begin CHARACTERISTIC MAP_574_1AC8F_6 "veroyatnaya mapscan addr 0x1AC8F" CURVE 0x1AC8F RL_2D_A16_UWORD 0 CM_IDENTITY 0 65535 /begin AXIS_DESCR STD_AXIS NO_INPUT_QUANTITY CM_IDENTITY 6 0 65535 /end AXIS_DESCR /end CHARACTERISTIC
/begin CHARACTERISTIC MAP_575_1ADDB_5 "veroyatnaya mapscan addr 0x1ADDB" CURVE 0x1ADDB RL_2D_A16_UWORD 0 CM_IDENTITY 0 65535 /begin AXIS_DESCR STD_AXIS NO_INPUT_QUANTITY CM_IDENTITY 5 0 65535 /end AXIS_DESCR /end CHARACTERISTIC
/begin CHARACTERISTIC MAP_576_1AEC3_6 "veroyatnaya mapscan addr 0x1AEC3" CURVE 0x1AEC3 RL_2D_A8_UBYTE 0 CM_IDENTITY 0 255 /begin AXIS_DESCR STD_AXIS NO_INPUT_QUANTITY CM_IDENTITY 6 0 255 /end AXIS_DESCR /end CHARACTERISTIC
/begin CHARACTERISTIC MAP_577_1AF14_6 "veroyatnaya mapscan addr 0x1AF14" CURVE 0x1AF14 RL_2D_A16_UWORD 0 CM_IDENTITY 0 65535 /begin AXIS_DESCR STD_AXIS NO_INPUT_QUANTITY CM_IDENTITY 6 0 65535 /end AXIS_DESCR /end CHARACTERISTIC
/begin CHARACTERISTIC MAP_578_1B0C2_5 "veroyatnaya mapscan addr 0x1B0C2" CURVE 0x1B0C2 RL_2D_A8_UWORD 0 CM_IDENTITY 0 65535 /begin AXIS_DESCR STD_AXIS NO_INPUT_QUANTITY CM_IDENTITY 5 0 255 /end AXIS_DESCR /end CHARACTERISTIC
/begin CHARACTERISTIC KFURL3SU "veroyatnaya damos-veroyatno addr 0x1B0E9 | conversion factor from ps->rl dependent on camshaft adjustment sumode=3" MAP 0x1B0E9 RL_GRID_UWORD 0 CM_4p577636719En06_0_hPa 0 0.299995
 /begin AXIS_DESCR FIX_AXIS NO_INPUT_QUANTITY CM_IDENTITY 14 0 13 FIX_AXIS_PAR_DIST 0 1 14 /end AXIS_DESCR
 /begin AXIS_DESCR FIX_AXIS NO_INPUT_QUANTITY CM_IDENTITY 10 0 9 FIX_AXIS_PAR_DIST 0 1 10 /end AXIS_DESCR
/end CHARACTERISTIC
/begin CHARACTERISTIC KFURLSU "veroyatnaya damos-veroyatno addr 0x1B229 | conversion factor from ps->rl dependent on camshaft adjustment sumode=1" MAP 0x1B229 RL_GRID_UWORD 0 CM_4p577636719En06_0_hPa 0 0.299995
 /begin AXIS_DESCR FIX_AXIS NO_INPUT_QUANTITY CM_IDENTITY 14 0 13 FIX_AXIS_PAR_DIST 0 1 14 /end AXIS_DESCR
 /begin AXIS_DESCR FIX_AXIS NO_INPUT_QUANTITY CM_IDENTITY 10 0 9 FIX_AXIS_PAR_DIST 0 1 10 /end AXIS_DESCR
/end CHARACTERISTIC
/begin CHARACTERISTIC DEVTMAGR "veroyatnaya damos-veroyatno addr 0x1B352 | offset for evtmod depending on tsges_w at high tans caused by EGR" CURVE 0x1B352 RL_GRID_SBYTE 0 CM_0p75_0_GradC -96 95.25
 /begin AXIS_DESCR FIX_AXIS NO_INPUT_QUANTITY CM_IDENTITY 8 0 7 FIX_AXIS_PAR_DIST 0 1 8 /end AXIS_DESCR
/end CHARACTERISTIC
/begin CHARACTERISTIC DPUPVDK "veroyatnaya damos-veroyatno addr 0x1B378 | pressure difference pu-pvdk" CURVE 0x1B378 RL_GRID_UBYTE 0 CM_0p0390625_0_hPa 0 9.96094
 /begin AXIS_DESCR FIX_AXIS NO_INPUT_QUANTITY CM_IDENTITY 8 0 7 FIX_AXIS_PAR_DIST 0 1 8 /end AXIS_DESCR
/end CHARACTERISTIC
/begin CHARACTERISTIC FKDISA "veroyatnaya damos-veroyatno addr 0x1B39A | faktor difference for integrator ambient pressure during fuel cut off" CURVE 0x1B39A RL_GRID_UWORD 0 CM_6p103515625En05_0 0 3.99994
 /begin AXIS_DESCR FIX_AXIS NO_INPUT_QUANTITY CM_IDENTITY 8 0 7 FIX_AXIS_PAR_DIST 0 1 8 /end AXIS_DESCR
/end CHARACTERISTIC
/begin CHARACTERISTIC MAP_585_1B497_8 "veroyatnaya mapscan addr 0x1B497" CURVE 0x1B497 RL_2D_A16_UBYTE 0 CM_IDENTITY 0 255 /begin AXIS_DESCR STD_AXIS NO_INPUT_QUANTITY CM_IDENTITY 8 0 65535 /end AXIS_DESCR /end CHARACTERISTIC
/begin CHARACTERISTIC MAP_587_1B5E1_6 "veroyatnaya mapscan addr 0x1B5E1" CURVE 0x1B5E1 RL_2D_A8_UWORD 0 CM_IDENTITY 0 65535 /begin AXIS_DESCR STD_AXIS NO_INPUT_QUANTITY CM_IDENTITY 6 0 255 /end AXIS_DESCR /end CHARACTERISTIC
/begin CHARACTERISTIC MAP_588_1B612_5 "veroyatnaya mapscan addr 0x1B612" CURVE 0x1B612 RL_2D_A8_UWORD 0 CM_IDENTITY 0 65535 /begin AXIS_DESCR STD_AXIS NO_INPUT_QUANTITY CM_IDENTITY 5 0 255 /end AXIS_DESCR /end CHARACTERISTIC
/begin CHARACTERISTIC PAGAVML "veroyatnaya damos-veroyatno addr 0x1B640 | exhaust gas pressure at outlet valve" CURVE 0x1B640 RL_GRID_UBYTE 0 CM_0p0390625_0_hPa 0 9.96094
 /begin AXIS_DESCR FIX_AXIS NO_INPUT_QUANTITY CM_IDENTITY 6 0 5 FIX_AXIS_PAR_DIST 0 1 6 /end AXIS_DESCR
/end CHARACTERISTIC
/begin CHARACTERISTIC NMOTNGAS "veroyatnaya damos-veroyatno addr 0x1B660 | Engine speed correction factor dependend on rpm gradient" CURVE 0x1B660 RL_GRID_UBYTE 0 CM_0p0078125_0 0 1.99219
 /begin AXIS_DESCR FIX_AXIS NO_INPUT_QUANTITY CM_IDENTITY 6 0 5 FIX_AXIS_PAR_DIST 0 1 6 /end AXIS_DESCR
/end CHARACTERISTIC
/begin CHARACTERISTIC KFWMABG "veroyatnaya damos-veroyatno addr 0x1B681 | map for heat-quantity threshold dew-point end upstream bank1" MAP 0x1B681 RL_GRID_UWORD 0 CM_0p05664148928_0_kJ 0 3712
 /begin AXIS_DESCR FIX_AXIS NO_INPUT_QUANTITY CM_IDENTITY 5 0 4 FIX_AXIS_PAR_DIST 0 1 5 /end AXIS_DESCR
 /begin AXIS_DESCR FIX_AXIS NO_INPUT_QUANTITY CM_IDENTITY 7 0 6 FIX_AXIS_PAR_DIST 0 1 7 /end AXIS_DESCR
/end CHARACTERISTIC
/begin CHARACTERISTIC KFWMKAT "veroyatnaya damos-veroyatno addr 0x1B6C7 | map for heat quantity threshold dew-point end downstream" MAP 0x1B6C7 RL_GRID_UWORD 0 CM_0p05664148928_0_kJ 0 3712
 /begin AXIS_DESCR FIX_AXIS NO_INPUT_QUANTITY CM_IDENTITY 5 0 4 FIX_AXIS_PAR_DIST 0 1 5 /end AXIS_DESCR
 /begin AXIS_DESCR FIX_AXIS NO_INPUT_QUANTITY CM_IDENTITY 7 0 6 FIX_AXIS_PAR_DIST 0 1 7 /end AXIS_DESCR
/end CHARACTERISTIC
/begin CHARACTERISTIC STS06TMUW "veroyatnaya damos-veroyatno addr 0x1B70D | tabstatm dependet basic point (number 6)" CURVE 0x1B70D RL_GRID_UBYTE 0 CM_IDENTITY 0 255
 /begin AXIS_DESCR FIX_AXIS NO_INPUT_QUANTITY CM_IDENTITY 6 0 5 FIX_AXIS_PAR_DIST 0 1 6 /end AXIS_DESCR
/end CHARACTERISTIC
/begin CHARACTERISTIC ZATMAML "veroyatnaya damos-veroyatno addr 0x1B71D | time constant for exhaust gas temperature model" CURVE 0x1B71D RL_GRID_UBYTE 0 CM_IDENTITY 0 255
 /begin AXIS_DESCR FIX_AXIS NO_INPUT_QUANTITY CM_IDENTITY 7 0 6 FIX_AXIS_PAR_DIST 0 1 7 /end AXIS_DESCR
/end CHARACTERISTIC
/begin CHARACTERISTIC ZATMKML "veroyatnaya damos-veroyatno addr 0x1B72B | time constant for catalyst temperature model tkatm" CURVE 0x1B72B RL_GRID_UBYTE 0 CM_IDENTITY 0 255
 /begin AXIS_DESCR FIX_AXIS NO_INPUT_QUANTITY CM_IDENTITY 7 0 6 FIX_AXIS_PAR_DIST 0 1 7 /end AXIS_DESCR
/end CHARACTERISTIC
/begin CHARACTERISTIC ZATMRML "veroyatnaya damos-veroyatno addr 0x1B739 | time constant for exhaust model temperature - pipe temperature" CURVE 0x1B739 RL_GRID_UBYTE 0 CM_IDENTITY 0 255
 /begin AXIS_DESCR FIX_AXIS NO_INPUT_QUANTITY CM_IDENTITY 7 0 6 FIX_AXIS_PAR_DIST 0 1 7 /end AXIS_DESCR
/end CHARACTERISTIC
/begin CHARACTERISTIC THSHKTK "veroyatnaya damos-veroyatno addr 0x1B807 | Line for switch off time of lambda sensor heating post cat dep. on temp" CURVE 0x1B807 RL_GRID_SBYTE 0 CM_3p9062En05_0p05_s -0.0549999 -0.0450391
 /begin AXIS_DESCR FIX_AXIS NO_INPUT_QUANTITY CM_IDENTITY 8 0 7 FIX_AXIS_PAR_DIST 0 1 8 /end AXIS_DESCR
/end CHARACTERISTIC
/begin CHARACTERISTIC THSVKTA "veroyatnaya damos-veroyatno addr 0x1B829 | Line of switching off time for lambda sensor heating depending on exh.gas temp" CURVE 0x1B829 RL_GRID_SBYTE 0 CM_3p9062En05_0p05_s -0.0549999 -0.0450391
 /begin AXIS_DESCR FIX_AXIS NO_INPUT_QUANTITY CM_IDENTITY 8 0 7 FIX_AXIS_PAR_DIST 0 1 8 /end AXIS_DESCR
/end CHARACTERISTIC
/begin CHARACTERISTIC KFFRMIN "veroyatnaya damos-veroyatno addr 0x1B85E | lower limit of control range" MAP 0x1B85E RL_GRID_UWORD 0 CM_3p051757812En05_0 0 1.99997
 /begin AXIS_DESCR FIX_AXIS NO_INPUT_QUANTITY CM_IDENTITY 5 0 4 FIX_AXIS_PAR_DIST 0 1 5 /end AXIS_DESCR
 /begin AXIS_DESCR FIX_AXIS NO_INPUT_QUANTITY CM_IDENTITY 5 0 4 FIX_AXIS_PAR_DIST 0 1 5 /end AXIS_DESCR
/end CHARACTERISTIC
/begin CHARACTERISTIC MAP_602_1B8C0_5 "veroyatnaya mapscan addr 0x1B8C0" CURVE 0x1B8C0 RL_2D_A8_UBYTE 0 CM_IDENTITY 0 255 /begin AXIS_DESCR STD_AXIS NO_INPUT_QUANTITY CM_IDENTITY 5 0 255 /end AXIS_DESCR /end CHARACTERISTIC
/begin CHARACTERISTIC MAP_603_1B91F_5 "veroyatnaya mapscan addr 0x1B91F" CURVE 0x1B91F RL_2D_A8_UBYTE 0 CM_IDENTITY 0 255 /begin AXIS_DESCR STD_AXIS NO_INPUT_QUANTITY CM_IDENTITY 5 0 255 /end AXIS_DESCR /end CHARACTERISTIC
/begin CHARACTERISTIC LAMKAML "veroyatnaya damos-veroyatno addr 0x1B939 | lambda setpoint for catylyst deoxidation (dependent on air mass)" CURVE 0x1B939 RL_GRID_UWORD 0 CM_0p000244140625_0 0 15.9998
 /begin AXIS_DESCR FIX_AXIS NO_INPUT_QUANTITY CM_IDENTITY 5 0 4 FIX_AXIS_PAR_DIST 0 1 5 /end AXIS_DESCR
/end CHARACTERISTIC
/begin CHARACTERISTIC LAMKAML2 "veroyatnaya damos-veroyatno addr 0x1B943 | lambdasetpoint for catalyst deoxidation (air mass dependent), bank 2" CURVE 0x1B943 RL_GRID_UWORD 0 CM_0p000244140625_0 0 15.9998
 /begin AXIS_DESCR FIX_AXIS NO_INPUT_QUANTITY CM_IDENTITY 5 0 4 FIX_AXIS_PAR_DIST 0 1 5 /end AXIS_DESCR
/end CHARACTERISTIC
/begin CHARACTERISTIC MAP_608_1B9EC_4 "veroyatnaya mapscan addr 0x1B9EC" CURVE 0x1B9EC RL_2D_A8_UBYTE 0 CM_IDENTITY 0 255 /begin AXIS_DESCR STD_AXIS NO_INPUT_QUANTITY CM_IDENTITY 4 0 255 /end AXIS_DESCR /end CHARACTERISTIC
/begin CHARACTERISTIC KLDYMNT "veroyatnaya damos-veroyatno addr 0x1BBC9 | min. value of dynamic response derivation" CURVE 0x1BBC9 RL_GRID_SBYTE 0 CM_n0p75_0_gradKW -95.25 96
 /begin AXIS_DESCR FIX_AXIS NO_INPUT_QUANTITY CM_IDENTITY 16 0 15 FIX_AXIS_PAR_DIST 0 1 16 /end AXIS_DESCR
/end CHARACTERISTIC
/begin CHARACTERISTIC UDKSNO "veroyatnaya damos-veroyatno addr 0x1BBEA | upper reference voltage threshold for diagnosis knock sensors" CURVE 0x1BBEA RL_GRID_UBYTE 0 CM_0p0195313_0_V 0 4.98048
 /begin AXIS_DESCR FIX_AXIS NO_INPUT_QUANTITY CM_IDENTITY 16 0 15 FIX_AXIS_PAR_DIST 0 1 16 /end AXIS_DESCR
/end CHARACTERISTIC
/begin CHARACTERISTIC UDKSNU "veroyatnaya damos-veroyatno addr 0x1BC0A | lower reference voltage threshold for diagnosis knock sensors" CURVE 0x1BC0A RL_GRID_UBYTE 0 CM_0p0195313_0_V 0 4.98048
 /begin AXIS_DESCR FIX_AXIS NO_INPUT_QUANTITY CM_IDENTITY 16 0 15 FIX_AXIS_PAR_DIST 0 1 16 /end AXIS_DESCR
/end CHARACTERISTIC
/begin CHARACTERISTIC MRFAVW "veroyatnaya damos-veroyatno addr 0x1BC2C | threshold to switch end of injection angle at max. driver request" CURVE 0x1BC2C RL_GRID_UWORD 0 CM_0p003051757812_0 0 199.997
 /begin AXIS_DESCR FIX_AXIS NO_INPUT_QUANTITY CM_IDENTITY 8 0 7 FIX_AXIS_PAR_DIST 0 1 8 /end AXIS_DESCR
/end CHARACTERISTIC
/begin CHARACTERISTIC MAP_614_1BC7A_8 "veroyatnaya mapscan addr 0x1BC7A" CURVE 0x1BC7A RL_2D_A8_UBYTE 0 CM_IDENTITY 0 255 /begin AXIS_DESCR STD_AXIS NO_INPUT_QUANTITY CM_IDENTITY 8 0 255 /end AXIS_DESCR /end CHARACTERISTIC
/begin CHARACTERISTIC RKBAUM "veroyatnaya damos-veroyatno addr 0x1BC96 | rk-threshold for acceleration enrichment display" CURVE 0x1BC96 RL_GRID_SWORD 0 CM_0p1875_0 -6144 6143.81
 /begin AXIS_DESCR FIX_AXIS NO_INPUT_QUANTITY CM_IDENTITY 9 0 8 FIX_AXIS_PAR_DIST 0 1 9 /end AXIS_DESCR
/end CHARACTERISTIC
/begin CHARACTERISTIC RKVAUM "veroyatnaya damos-veroyatno addr 0x1BCA8 | rk-threshold for deceleration enleanment display" CURVE 0x1BCA8 RL_GRID_SWORD 0 CM_0p1875_0 -6144 6143.81
 /begin AXIS_DESCR FIX_AXIS NO_INPUT_QUANTITY CM_IDENTITY 9 0 8 FIX_AXIS_PAR_DIST 0 1 9 /end AXIS_DESCR
/end CHARACTERISTIC
/begin CHARACTERISTIC ZMRFABN "veroyatnaya damos-veroyatno addr 0x1BCDB | calculation of current time constant of low pass (permanent high load) mrfabnf_w" CURVE 0x1BCDB RL_GRID_UBYTE 0 CM_IDENTITY 0 255
 /begin AXIS_DESCR FIX_AXIS NO_INPUT_QUANTITY CM_IDENTITY 5 0 4 FIX_AXIS_PAR_DIST 0 1 5 /end AXIS_DESCR
/end CHARACTERISTIC
/begin CHARACTERISTIC KFFRAT "veroyatnaya damos-veroyatno addr 0x1BCFA | load and speed dependent gradient of FRAT integrator" MAP 0x1BCFA RL_GRID_UWORD 0 CM_7p629394531En05_0_1s 0 4.99992
 /begin AXIS_DESCR FIX_AXIS NO_INPUT_QUANTITY CM_IDENTITY 4 0 3 FIX_AXIS_PAR_DIST 0 1 4 /end AXIS_DESCR
 /begin AXIS_DESCR FIX_AXIS NO_INPUT_QUANTITY CM_IDENTITY 4 0 3 FIX_AXIS_PAR_DIST 0 1 4 /end AXIS_DESCR
/end CHARACTERISTIC
/begin CHARACTERISTIC ZKFRAOA "veroyatnaya damos-veroyatno addr 0x1BD41 | time constant for frao-integrator, f(number of starts with fuel in oil)" CURVE 0x1BD41 RL_GRID_UWORD 0 CM_7p629394531En05_0_1s 0 4.99992
 /begin AXIS_DESCR FIX_AXIS NO_INPUT_QUANTITY CM_IDENTITY 3 0 2 FIX_AXIS_PAR_DIST 0 1 3 /end AXIS_DESCR
/end CHARACTERISTIC
/begin CHARACTERISTIC ZKFRAUA "veroyatnaya damos-veroyatno addr 0x1BD4F | time constant for frau-integrator, f(number of starts with" CURVE 0x1BD4F RL_GRID_UWORD 0 CM_7p629394531En05_0_1s 0 4.99992
 /begin AXIS_DESCR FIX_AXIS NO_INPUT_QUANTITY CM_IDENTITY 3 0 2 FIX_AXIS_PAR_DIST 0 1 3 /end AXIS_DESCR
/end CHARACTERISTIC
/begin CHARACTERISTIC ZKRKAZA "veroyatnaya damos-veroyatno addr 0x1BD6B | integration speed integrator rkaz, f(abo)" CURVE 0x1BD6B RL_GRID_UWORD 0 CM_0p0146484375_0_s 0 959.985
 /begin AXIS_DESCR FIX_AXIS NO_INPUT_QUANTITY CM_IDENTITY 3 0 2 FIX_AXIS_PAR_DIST 0 1 3 /end AXIS_DESCR
/end CHARACTERISTIC
/begin CHARACTERISTIC MAP_623_1BD71_5 "veroyatnaya mapscan addr 0x1BD71" CURVE 0x1BD71 RL_2D_A16_UWORD 0 CM_IDENTITY 0 65535 /begin AXIS_DESCR STD_AXIS NO_INPUT_QUANTITY CM_IDENTITY 5 0 65535 /end AXIS_DESCR /end CHARACTERISTIC
/begin CHARACTERISTIC KLKESUKFS "veroyatnaya damos-veroyatno addr 0x1BD99 | characteristic line of integration factor for trans. comp. at engaging gear(A/T)" CURVE 0x1BD99 RL_GRID_UWORD 0 CM_3p051757812En05_0 0 1.99997
 /begin AXIS_DESCR FIX_AXIS NO_INPUT_QUANTITY CM_IDENTITY 5 0 4 FIX_AXIS_PAR_DIST 0 1 5 /end AXIS_DESCR
/end CHARACTERISTIC
/begin CHARACTERISTIC KLKESUKKO "veroyatnaya damos-veroyatno addr 0x1BDA9 | characteristic line of integration factor for transient compensation at A/C on" CURVE 0x1BDA9 RL_GRID_UWORD 0 CM_3p051757812En05_0 0 1.99997
 /begin AXIS_DESCR FIX_AXIS NO_INPUT_QUANTITY CM_IDENTITY 5 0 4 FIX_AXIS_PAR_DIST 0 1 5 /end AXIS_DESCR
/end CHARACTERISTIC
/begin CHARACTERISTIC FRLFSDP "veroyatnaya damos-veroyatno addr 0x1BDB9 | injection correction for RLFS" CURVE 0x1BDB9 RL_GRID_UWORD 0 CM_3p051757812En05_0 0 1.99997
 /begin AXIS_DESCR FIX_AXIS NO_INPUT_QUANTITY CM_IDENTITY 11 0 10 FIX_AXIS_PAR_DIST 0 1 11 /end AXIS_DESCR
/end CHARACTERISTIC
/begin CHARACTERISTIC KFETATE "veroyatnaya damos-veroyatno addr 0x1BE5E | characteristic map for efficency at active purging when te is near TEMIN" MAP 0x1BE5E RL_GRID_UWORD 0 CM_0p001953125_0 0 127.998
 /begin AXIS_DESCR FIX_AXIS NO_INPUT_QUANTITY CM_IDENTITY 5 0 4 FIX_AXIS_PAR_DIST 0 1 5 /end AXIS_DESCR
 /begin AXIS_DESCR FIX_AXIS NO_INPUT_QUANTITY CM_IDENTITY 3 0 2 FIX_AXIS_PAR_DIST 0 1 3 /end AXIS_DESCR
/end CHARACTERISTIC
/begin CHARACTERISTIC KFDTMTE "veroyatnaya damos-veroyatno addr 0x1BF29 | char. map for gradient of engine coolant temperature in substitute temp. model" MAP 0x1BF29 RL_GRID_SBYTE 0 CM_0p000732421875_0_GradC -0.09375 0.0930176
 /begin AXIS_DESCR FIX_AXIS NO_INPUT_QUANTITY CM_IDENTITY 4 0 3 FIX_AXIS_PAR_DIST 0 1 4 /end AXIS_DESCR
 /begin AXIS_DESCR FIX_AXIS NO_INPUT_QUANTITY CM_IDENTITY 5 0 4 FIX_AXIS_PAR_DIST 0 1 5 /end AXIS_DESCR
/end CHARACTERISTIC
/begin CHARACTERISTIC KFDTMTR "veroyatnaya damos-veroyatno addr 0x1BF49 | char. map for gradient of engine coolant temperature in reference model" MAP 0x1BF49 RL_GRID_SBYTE 0 CM_0p000732421875_0_GradC -0.09375 0.0930176
 /begin AXIS_DESCR FIX_AXIS NO_INPUT_QUANTITY CM_IDENTITY 4 0 3 FIX_AXIS_PAR_DIST 0 1 4 /end AXIS_DESCR
 /begin AXIS_DESCR FIX_AXIS NO_INPUT_QUANTITY CM_IDENTITY 5 0 4 FIX_AXIS_PAR_DIST 0 1 5 /end AXIS_DESCR
/end CHARACTERISTIC
/begin CHARACTERISTIC KLDTMRS "veroyatnaya damos-veroyatno addr 0x1BF5F | char.line for gradient of engine coolant temp. during cutoff for reference model" CURVE 0x1BF5F RL_GRID_SBYTE 0 CM_0p000732421875_0_GradC -0.09375 0.0930176
 /begin AXIS_DESCR FIX_AXIS NO_INPUT_QUANTITY CM_IDENTITY 5 0 4 FIX_AXIS_PAR_DIST 0 1 5 /end AXIS_DESCR
/end CHARACTERISTIC
/begin CHARACTERISTIC DFPSLBIT "veroyatnaya damos-veroyatno addr 0x1BF7C | Section bits for indication of the activated error paths" CURVE 0x1BF7C RL_GRID_UBYTE 0 CM_IDENTITY 0 255
 /begin AXIS_DESCR FIX_AXIS NO_INPUT_QUANTITY CM_IDENTITY 16 0 15 FIX_AXIS_PAR_DIST 0 1 16 /end AXIS_DESCR
/end CHARACTERISTIC
/begin CHARACTERISTIC LURBRL8 "veroyatnaya damos-veroyatno addr 0x1BF9F | reference value for engine roughness, vehicle speed zero" CURVE 0x1BF9F RL_GRID_SBYTE 0 CM_IDENTITY -128 127
 /begin AXIS_DESCR FIX_AXIS NO_INPUT_QUANTITY CM_IDENTITY 8 0 7 FIX_AXIS_PAR_DIST 0 1 8 /end AXIS_DESCR
/end CHARACTERISTIC
/begin CHARACTERISTIC FKKVS "veroyatnaya damos-veroyatno addr 0x1C02E | Factor to correct fuel delivery system" MAP 0x1C02E RL_GRID_UWORD 0 CM_3p051757812En05_0 0 1.99997
 /begin AXIS_DESCR FIX_AXIS NO_INPUT_QUANTITY CM_IDENTITY 16 0 15 FIX_AXIS_PAR_DIST 0 1 16 /end AXIS_DESCR
 /begin AXIS_DESCR FIX_AXIS NO_INPUT_QUANTITY CM_IDENTITY 16 0 15 FIX_AXIS_PAR_DIST 0 1 16 /end AXIS_DESCR
/end CHARACTERISTIC
/begin CHARACTERISTIC CL30LINE "veroyatnaya damos-veroyatno addr 0x1C3E2 | 30th line of classtable" CURVE 0x1C3E2 RL_GRID_UBYTE 0 CM_IDENTITY 0 255
 /begin AXIS_DESCR FIX_AXIS NO_INPUT_QUANTITY CM_IDENTITY 13 0 12 FIX_AXIS_PAR_DIST 0 1 13 /end AXIS_DESCR
/end CHARACTERISTIC
/begin CHARACTERISTIC CL31LINE "veroyatnaya damos-veroyatno addr 0x1C3F0 | 31th line of classtable" CURVE 0x1C3F0 RL_GRID_UBYTE 0 CM_IDENTITY 0 255
 /begin AXIS_DESCR FIX_AXIS NO_INPUT_QUANTITY CM_IDENTITY 13 0 12 FIX_AXIS_PAR_DIST 0 1 13 /end AXIS_DESCR
/end CHARACTERISTIC
/begin CHARACTERISTIC CL32LINE "veroyatnaya damos-veroyatno addr 0x1C3FE | 32th line of classtable" CURVE 0x1C3FE RL_GRID_UBYTE 0 CM_IDENTITY 0 255
 /begin AXIS_DESCR FIX_AXIS NO_INPUT_QUANTITY CM_IDENTITY 13 0 12 FIX_AXIS_PAR_DIST 0 1 13 /end AXIS_DESCR
/end CHARACTERISTIC
/begin CHARACTERISTIC CL33LINE "veroyatnaya damos-veroyatno addr 0x1C40C | 33th line of classtable" CURVE 0x1C40C RL_GRID_UBYTE 0 CM_IDENTITY 0 255
 /begin AXIS_DESCR FIX_AXIS NO_INPUT_QUANTITY CM_IDENTITY 13 0 12 FIX_AXIS_PAR_DIST 0 1 13 /end AXIS_DESCR
/end CHARACTERISTIC
/begin CHARACTERISTIC CL34LINE "veroyatnaya damos-veroyatno addr 0x1C41A | 34th line of classtable" CURVE 0x1C41A RL_GRID_UBYTE 0 CM_IDENTITY 0 255
 /begin AXIS_DESCR FIX_AXIS NO_INPUT_QUANTITY CM_IDENTITY 13 0 12 FIX_AXIS_PAR_DIST 0 1 13 /end AXIS_DESCR
/end CHARACTERISTIC
/begin CHARACTERISTIC CL35LINE "veroyatnaya damos-veroyatno addr 0x1C428 | 35th line of classtable" CURVE 0x1C428 RL_GRID_UBYTE 0 CM_IDENTITY 0 255
 /begin AXIS_DESCR FIX_AXIS NO_INPUT_QUANTITY CM_IDENTITY 13 0 12 FIX_AXIS_PAR_DIST 0 1 13 /end AXIS_DESCR
/end CHARACTERISTIC
/begin CHARACTERISTIC CL36LINE "veroyatnaya damos-veroyatno addr 0x1C436 | 36th line of classtable" CURVE 0x1C436 RL_GRID_UBYTE 0 CM_IDENTITY 0 255
 /begin AXIS_DESCR FIX_AXIS NO_INPUT_QUANTITY CM_IDENTITY 13 0 12 FIX_AXIS_PAR_DIST 0 1 13 /end AXIS_DESCR
/end CHARACTERISTIC
/begin CHARACTERISTIC CL37LINE "veroyatnaya damos-veroyatno addr 0x1C444 | 37th line of classtable" CURVE 0x1C444 RL_GRID_UBYTE 0 CM_IDENTITY 0 255
 /begin AXIS_DESCR FIX_AXIS NO_INPUT_QUANTITY CM_IDENTITY 13 0 12 FIX_AXIS_PAR_DIST 0 1 13 /end AXIS_DESCR
/end CHARACTERISTIC
/begin CHARACTERISTIC CL38LINE "veroyatnaya damos-veroyatno addr 0x1C452 | 38th line of classtable" CURVE 0x1C452 RL_GRID_UBYTE 0 CM_IDENTITY 0 255
 /begin AXIS_DESCR FIX_AXIS NO_INPUT_QUANTITY CM_IDENTITY 13 0 12 FIX_AXIS_PAR_DIST 0 1 13 /end AXIS_DESCR
/end CHARACTERISTIC
/begin CHARACTERISTIC CL39LINE "veroyatnaya damos-veroyatno addr 0x1C460 | 39th line of classtable" CURVE 0x1C460 RL_GRID_UBYTE 0 CM_IDENTITY 0 255
 /begin AXIS_DESCR FIX_AXIS NO_INPUT_QUANTITY CM_IDENTITY 13 0 12 FIX_AXIS_PAR_DIST 0 1 13 /end AXIS_DESCR
/end CHARACTERISTIC
/begin CHARACTERISTIC LNXQTM "veroyatnaya damos-veroyatno addr 0x1C471 | natural logarithm from temperature quotient" CURVE 0x1C471 RL_GRID_UWORD 0 CM_6p103515625En05_0 0 3.99994
 /begin AXIS_DESCR FIX_AXIS NO_INPUT_QUANTITY CM_IDENTITY 12 0 11 FIX_AXIS_PAR_DIST 0 1 12 /end AXIS_DESCR
/end CHARACTERISTIC
/begin CHARACTERISTIC TNLSGM "veroyatnaya damos-veroyatno addr 0x1C4A3 | Delay time for ECU shut-off" CURVE 0x1C4A3 RL_GRID_UBYTE 0 CM_IDENTITY 0 255
 /begin AXIS_DESCR FIX_AXIS NO_INPUT_QUANTITY CM_IDENTITY 6 0 5 FIX_AXIS_PAR_DIST 0 1 6 /end AXIS_DESCR
/end CHARACTERISTIC
/begin CHARACTERISTIC ZKTABTU "veroyatnaya damos-veroyatno addr 0x1C4BF | time constant for engine cooling" CURVE 0x1C4BF RL_GRID_UBYTE 0 CM_IDENTITY 0 255
 /begin AXIS_DESCR FIX_AXIS NO_INPUT_QUANTITY CM_IDENTITY 4 0 3 FIX_AXIS_PAR_DIST 0 1 4 /end AXIS_DESCR
/end CHARACTERISTIC
/begin GROUP G_ALL "??? ?????" ROOT
 /begin SUB_GROUP G_scanner_veroyatnaya G_scanner_podtverzhdena G_lambda_cat_diag_block G_knock_control G_canister_purge G_scanner_somnitelnaya G_scanner_neodnoznachnaya G_overrun_fuel_cut G_torque_model G_second_lambda G_cyclic_charge G_maps G_hfm_path G_scalars G_transient_fuel G_axes_resolved_from_code G_full_load_lambda G_throttle_air_model G_axis_blocks G_fuel_path G_fuel_path_unchanged G_max_charge_at_wot G_other_regions G_saint_venant /end SUB_GROUP
/end GROUP
/begin GROUP G_scanner_veroyatnaya "Skaner: veroyatnye"
 /begin REF_CHARACTERISTIC SNG06LLSB NARASTG RLMNN RLMNSAN KFMIRED FSWALUV FUGKUE ZDSH1GS ZDSHGS MAP_056_10D9A_6 SNS06LLSB ZNSMST DMLLRIMXN DMLLRLMNN DMLLRLMXN DMLLRMNN DMLLRMXN DVNG DVNGV FDDN GFDLDN IVDN IVDNDTE PVDN PVLDN PVLDNV SDN06LLSB SNS206LLSB TVFSAM TVFSAMR TVFSEM TVFSEMR UEVERG ZKMDWAM FZN0 FZN1 FZN2 FZN3 FZN4 FZN5 FZN6 FZN7 FZNWN0 FZNWN1 FZNWN2 FZNWN3 FZNWN4 FZNWN5 FZNWN6 FZNWN7 KFWHSTT KFWKSTN FWSTAS2 LZFUER WKRLZOF WDKNLN FHSTT MAP_115_112C2_14 MAP_117_113A3_14x14 TKOAMXN TKOEMNN MAP_120_11567_8 FVRMDYN MAP_123_11595_8 MAP_124_115EC_7 MAP_125_115FB_7 FAGRH MAP_127_11616_8 MAP_128_11673_6 MAP_129_1168B_6 MAP_130_11698_12 MAP_131_116B2_6x6 MAP_132_116E5_4 MAP_134_11986_5x6 MAP_137_11A1A_6 MAP_139_11A40_10x10 FFTEV6 FFTFRAO FFTFRAU FFTFRST FFTGE FFTHSH FFTHSHE FFTHSV FFTHSVE FFTKAT FFTKOSE FFTKPE MAP_152_11AD4_16x12 DLURMIN ANALUN MAP_160_11F22_8 KFLURB2 LURKTM LURMIN1 LURMIN2 LURMIN3 KFKSWF MAP_171_124D4_6 MAP_172_128BD_21 SAN12ESUW SNM16OPUW_148D2 MAP_175_14915_6 NDFILOG TVKUPHS TVKUPRS DETANN DETAPN MAP_181_14998_10 MAP_182_149B8_10 MAP_183_149D8_10 MAP_184_14A11_10 SRL11OPUW_14B1A DMLWWKMK KLDMLWSDO KLMKLWSD MAP_189_14BC5_12 MAP_190_14BFB_5 MAP_191_14C2D_4 MAP_192_14C45_4 MAP_193_14C5D_4 MAP_194_14C75_4 MAP_195_14C8D_4 MAP_196_14CA5_4 MAP_197_14CBD_4 MAP_198_14CD5_4 MAP_199_14CED_4 MAP_200_14D05_4 MAP_201_14D1D_4 MAP_202_14D35_4 MAP_203_14D4D_4 MAP_204_14D65_4 SRL03MFUW MAP_208_14F60_8 MAP_209_14F7F_6 MAP_211_14FF7_5 MAP_212_15005_6 DMLLNGV MAP_217_15137_6 DMDNSM_0_A ZMDNSM_0_A MDSM_0_A MAP_221_15261_6 MAP_222_15281_6 MAP_223_152A1_6x7 MAP_224_15311_7 MAP_225_15331_7 MAP_226_15362_8x24 MAP_227_15528_12 MAP_228_15559_16 WDKUGDN_15672 ZKMSDK ZKPVDK KLSIS MSNLLSP TLRVAMW LALIUSRH RLSALUN_0_A NGALU_0_A NGKRWN AZKELDYN_0_A MAP_247_15BCB_7 MAP_248_15C2D_7 FNSSM_0_A WFRL KLLAMFA_0_A FVERZDYN TATEMSN KLAFTE MAP_261_15F88_12 CDCAAA CDCAGRF CDCAGRL CDCAGRV CDCAHC CDCBM CDCDK CDCDUMMY CDCEGFE CDCEV1 CDCEV2 CDCEV3 CDCEV4 CDCEV5 CDCEV6 CDCFRAO CDCFRAU CDCFRST CDCGE CDCHSH CDCHSHE CDCHSV CDCHSVE CDCKAT CDCKOSE CDCKPE CDCKRNT CDCKROF CDCKRTP CDCKS1 CDCKS2 CDCKS3 CDCKS4 CDCLASH CDCLATP CDCLATV CDCLLR CDCLM CDCLSH CDCLSV CDCLUEA MAP_303_1611B_4 CDCMD01 CDCMD02 CDCMD03 CDCMFA CDCMFB MAP_309_16156_5 CDCPH CDCPUA CDCRKAT CDCRKAZ CDCSGROM CDCSWE CDCTA CDCTES CDCTEVE CDCTHM CDCTM CDCUB CDCVFZ CDCZOE CDCZSE CDCZZZ GRID_326_1637C_16x7 FLRAG FLRAWG FLRHG FRARAG FRARAWG FRARHG DFAUWKN DFAWKN ZFAUWKN ZFAWKN WPHN DZWSPM NWECVTM TVSATM NFSM NLLM LIMXDNS LIMXVDNS LISTM MAP_394_1854A_5 MAP_395_1856E_8 MAP_399_18613_10x8 WDKHKN MAP_407_18768_6 MAP_409_1879A_6 ATMABKA ATMABKK FATMRML KATMEXML KLATMLAE KLATMZWE MAP_422_188CA_5 KFRI2 MAP_432_18ABF_8 RLLRUN KFUSHK PLRHML RLLRHON RLLRHUN ZLRHML DTVKAML DTVKAML2 FKAXAVKAT BTRKHTMS FTMLAKH MAP_446_18BBA_4 NFSKHM FMDKHFH FMDKHTM MAP_452_18C2A_8 MAP_453_18C7C_8 MAP_454_18CCE_4 MAP_456_18CE9_8 MAP_458_18D3B_8 LMSTMOT KEMLN SENZZYL KE1N KE2N KE3N KE4N KE5N KE6N KE7N KE8N RKRMX1N RKRMX2N DWKRMSN KRAL1N KRAL2N MAP_476_18E8E_4 KRDWSN KRFKN KRMXN KRNLZAR KRVFN MAP_482_18F3D_4 LKRN MAP_484_18F61_4 MAP_485_18F71_4 MAP_486_18FA2_4 MAP_487_18FB2_4 WDKSLN MAP_489_18FD6_4 SNM08GKUB MAP_493_19081_8 WEAN WEEM WEEMRFAN WEESTM ZZWEETM FSTHO FNSA FNSHO SZANSSM2 LASWLTM KFABAK_1931E KFAVAK_1935D KFBAKL_1939C MAP_512_193E0_9 ZBALM ZVALM LAMLGMTM WDKARN FMRFAZTE FBZFRAT MAP_521_196F8_5 MAP_523_19719_8 MAP_525_1976E_6 MAP_526_1977E_5 MAP_527_1979E_6 MAP_533_198B4_5 MAP_537_19950_14 DTLRTML TMLRTMS MAP_541_19A2F_20 TWLRTMS MAP_543_19A6B_20 MAP_544_19AAC_4 LURKH AINTKAN SLX06TMUW SML07TMUW SRL04DYUB KIFZGAG KIFZGAWG KIFZGHG MKLWON MKLWOWKN MKLWSAN MKLWUN MKLWUWKN MAP_561_1A692_12 MAP_565_1A84A_6 MAP_566_1A88A_6 MAP_568_1A945_4 MAP_569_1A965_4 FPVMXN MAP_572_1AA3A_4 MAP_573_1AB22_4 MAP_574_1AC8F_6 MAP_575_1ADDB_5 MAP_576_1AEC3_6 MAP_577_1AF14_6 MAP_578_1B0C2_5 KFURL3SU KFURLSU DEVTMAGR DPUPVDK FKDISA MAP_585_1B497_8 MAP_587_1B5E1_6 MAP_588_1B612_5 PAGAVML NMOTNGAS KFWMABG KFWMKAT STS06TMUW ZATMAML ZATMKML ZATMRML THSHKTK THSVKTA KFFRMIN MAP_602_1B8C0_5 MAP_603_1B91F_5 LAMKAML LAMKAML2 MAP_608_1B9EC_4 KLDYMNT UDKSNO UDKSNU MRFAVW MAP_614_1BC7A_8 RKBAUM RKVAUM ZMRFABN KFFRAT ZKFRAOA ZKFRAUA ZKRKAZA MAP_623_1BD71_5 KLKESUKFS KLKESUKKO FRLFSDP KFETATE KFDTMTE KFDTMTR KLDTMRS DFPSLBIT LURBRL8 FKKVS CL30LINE CL31LINE CL32LINE CL33LINE CL34LINE CL35LINE CL36LINE CL37LINE CL38LINE CL39LINE LNXQTM TNLSGM ZKTABTU /end REF_CHARACTERISTIC
/end GROUP
/end MODULE
/end PROJECT
