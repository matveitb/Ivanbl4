ASAP2_VERSION 1 51
/begin PROJECT FBH3ID60 "Bosch M7.9.7 C167"
/begin HEADER "Kia Spectra 1.6 FBH3ID60" VERSION "1.0" /end HEADER
/begin MODULE FBH3ID60_MOD "Bosch M7.9.7"
/begin MOD_COMMON "little endian, alignment 1" BYTE_ORDER MSB_LAST ALIGNMENT_BYTE 1 ALIGNMENT_WORD 1 ALIGNMENT_LONG 1 /end MOD_COMMON
/begin COMPU_METHOD CM_IDENTITY "raw values" RAT_FUNC "%.3f" "" COEFFS 0 1 0 0 0 1 /end COMPU_METHOD
/begin COMPU_METHOD CM_40_0_rpm "scale 40" RAT_FUNC "%.1f" "rpm" COEFFS 0 1 0 0 0 40 /end COMPU_METHOD
/begin COMPU_METHOD CM_0p75_0 "scale 0.75" RAT_FUNC "%.3f" "%" COEFFS 0 1 0 0 0 0.75 /end COMPU_METHOD
/begin COMPU_METHOD CM_0p0234375_0 "scale 0.0234375" RAT_FUNC "%.3f" "%" COEFFS 0 1 0 0 0 0.0234375 /end COMPU_METHOD
/begin COMPU_METHOD CM_0p75_48_GradC "scale 0.75" RAT_FUNC "%.3f" "Grad C" COEFFS 0 1 48 0 0 0.75 /end COMPU_METHOD
/begin COMPU_METHOD CM_4_0_kgh "scale 4" RAT_FUNC "%.1f" "kg/h" COEFFS 0 1 0 0 0 4 /end COMPU_METHOD
/begin COMPU_METHOD CM_40_0_Upm "scale 40" RAT_FUNC "%.1f" "Upm" COEFFS 0 1 0 0 0 40 /end COMPU_METHOD
/begin COMPU_METHOD CM_0p0625_0 "scale 0.0625" RAT_FUNC "%.3f" "-" COEFFS 0 1 0 0 0 0.0625 /end COMPU_METHOD
/begin COMPU_METHOD CM_0p5_0 "scale 0.5" RAT_FUNC "%.3f" "%" COEFFS 0 1 0 0 0 0.5 /end COMPU_METHOD
/begin COMPU_METHOD CM_0p390625_0 "scale 0.390625" RAT_FUNC "%.3f" "%" COEFFS 0 1 0 0 0 0.390625 /end COMPU_METHOD
/begin COMPU_METHOD CM_0p75_0_gradKW "scale 0.75" RAT_FUNC "%.3f" "grad KW" COEFFS 0 1 0 0 0 0.75 /end COMPU_METHOD
/begin COMPU_METHOD CM_0p03125_0 "scale 0.03125" RAT_FUNC "%.3f" "-" COEFFS 0 1 0 0 0 0.03125 /end COMPU_METHOD
/begin COMPU_METHOD CM_0p0078125_0 "scale 0.0078125" RAT_FUNC "%.3f" "-" COEFFS 0 1 0 0 0 0.0078125 /end COMPU_METHOD
/begin COMPU_METHOD CM_10_0_Umin "scale 10" RAT_FUNC "%.1f" "U/min" COEFFS 0 1 0 0 0 10 /end COMPU_METHOD
/begin COMPU_METHOD CM_0p00390625_0 "scale 0.00390625" RAT_FUNC "%.3f" "-" COEFFS 0 1 0 0 0 0.00390625 /end COMPU_METHOD
/begin COMPU_METHOD CM_0p02_0_s "scale 0.02" RAT_FUNC "%.3f" "s" COEFFS 0 1 0 0 0 0.02 /end COMPU_METHOD
/begin COMPU_METHOD CM_0p046875_0 "scale 0.046875" RAT_FUNC "%.3f" "%" COEFFS 0 1 0 0 0 0.046875 /end COMPU_METHOD
/begin COMPU_METHOD CM_3p051757812En05_0 "scale 3.05176e-05" RAT_FUNC "%.3f" "-" COEFFS 0 1 0 0 0 3.051757812e-05 /end COMPU_METHOD
/begin COMPU_METHOD CM_0p3921568627_0_DK "scale 0.392157" RAT_FUNC "%.3f" "% DK" COEFFS 0 1 0 0 0 0.3921568627 /end COMPU_METHOD
/begin COMPU_METHOD CM_5_50_GradC "scale 5" RAT_FUNC "%.1f" "Grad C" COEFFS 0 1 50 0 0 5 /end COMPU_METHOD
/begin COMPU_METHOD CM_0p01_0_s "scale 0.01" RAT_FUNC "%.3f" "s" COEFFS 0 1 0 0 0 0.01 /end COMPU_METHOD
/begin COMPU_METHOD CM_0p1960784314_0 "scale 0.196078" RAT_FUNC "%.3f" "%" COEFFS 0 1 0 0 0 0.1960784314 /end COMPU_METHOD
/begin COMPU_METHOD CM_0p1_0_s "scale 0.1" RAT_FUNC "%.3f" "s" COEFFS 0 1 0 0 0 0.1 /end COMPU_METHOD
/begin COMPU_METHOD CM_0p25_0 "scale 0.25" RAT_FUNC "%.3f" "-" COEFFS 0 1 0 0 0 0.25 /end COMPU_METHOD
/begin COMPU_METHOD CM_n0p75_0_gradKW "scale -0.75" RAT_FUNC "%.3f" "grad KW" COEFFS 0 1 0 0 0 -0.75 /end COMPU_METHOD
/begin COMPU_METHOD CM_0p015625_0 "scale 0.015625" RAT_FUNC "%.3f" "-" COEFFS 0 1 0 0 0 0.015625 /end COMPU_METHOD
/begin COMPU_METHOD CM_0p001953125_0 "scale 0.00195312" RAT_FUNC "%.3f" "-" COEFFS 0 1 0 0 0 0.001953125 /end COMPU_METHOD
/begin COMPU_METHOD CM_4p768359375En05_0_1s "scale 4.76836e-05" RAT_FUNC "%.3f" "1/s" COEFFS 0 1 0 0 0 4.768359375e-05 /end COMPU_METHOD
/begin COMPU_METHOD CM_0p1_0_kgh "scale 0.1" RAT_FUNC "%.3f" "kg/h" COEFFS 0 1 0 0 0 0.1 /end COMPU_METHOD
/begin COMPU_METHOD CM_0p125_0 "scale 0.125" RAT_FUNC "%.3f" "-" COEFFS 0 1 0 0 0 0.125 /end COMPU_METHOD
/begin COMPU_METHOD CM_0p25_0_obmin "scale 0.25" RAT_FUNC "%.3f" "ob/min" COEFFS 0 1 0 0 0 0.25 /end COMPU_METHOD
/begin COMPU_METHOD CM_0p392157_0 "scale 0.392157" RAT_FUNC "%.3f" "%" COEFFS 0 1 0 0 0 0.392157 /end COMPU_METHOD
/begin COMPU_METHOD CM_0p001779359431_0_ms "scale 0.00177936" RAT_FUNC "%.3f" "ms/%" COEFFS 0 1 0 0 0 0.001779359431 /end COMPU_METHOD
/begin COMPU_METHOD CM_0p01953125_0_V "scale 0.0195312" RAT_FUNC "%.3f" "V" COEFFS 0 1 0 0 0 0.01953125 /end COMPU_METHOD
/begin COMPU_METHOD CM_0p75_0_GradKW "scale 0.75" RAT_FUNC "%.3f" "Grad KW" COEFFS 0 1 0 0 0 0.75 /end COMPU_METHOD
/begin COMPU_METHOD CM_0p00048828125_0 "scale 0.000488281" RAT_FUNC "%.3f" "-" COEFFS 0 1 0 0 0 0.00048828125 /end COMPU_METHOD
/begin COMPU_METHOD CM_0p00152588_0_otopornogomoment "scale 0.00152588" RAT_FUNC "%.3f" "% ot opornogo momenta" COEFFS 0 1 0 0 0 0.00152588 /end COMPU_METHOD
/begin COMPU_METHOD CM_0p0234375_0_napolneniya "scale 0.0234375" RAT_FUNC "%.3f" "% napolneniya" COEFFS 0 1 0 0 0 0.0234375 /end COMPU_METHOD
/begin COMPU_METHOD CM_0p001525878906_0_momenta "scale 0.00152588" RAT_FUNC "%.3f" "% momenta" COEFFS 0 1 0 0 0 0.001525878906 /end COMPU_METHOD
/begin COMPU_METHOD CM_0p001525878906_0_otopornogomo "scale 0.00152588" RAT_FUNC "%.3f" "% ot opornogo momenta" COEFFS 0 1 0 0 0 0.001525878906 /end COMPU_METHOD
/begin COMPU_METHOD CM_0p0078125_0_lambda "scale 0.0078125" RAT_FUNC "%.3f" "lambda" COEFFS 0 1 0 0 0 0.0078125 /end COMPU_METHOD
/begin COMPU_METHOD CM_n0p75_0_KV "scale -0.75" RAT_FUNC "%.3f" "KV" COEFFS 0 1 0 0 0 -0.75 /end COMPU_METHOD
/begin COMPU_METHOD CM_40_0_obmin "scale 40" RAT_FUNC "%.1f" "ob/min" COEFFS 0 1 0 0 0 40 /end COMPU_METHOD
/begin COMPU_METHOD CM_5_n50_C "scale 5" RAT_FUNC "%.1f" "C" COEFFS 0 1 -50 0 0 5 /end COMPU_METHOD
/begin COMPU_METHOD CM_0p005215686275_0p2_V "scale 0.00521569" RAT_FUNC "%.3f" "V" COEFFS 0 1 0.2 0 0 0.005215686275 /end COMPU_METHOD
/begin COMPU_METHOD CM_0p52_0_mVms "scale 0.52" RAT_FUNC "%.3f" "mV/ms" COEFFS 0 1 0 0 0 0.52 /end COMPU_METHOD
/begin COMPU_METHOD CM_0p09362_0_1V "scale 0.09362" RAT_FUNC "%.3f" "1/V" COEFFS 0 1 0 0 0 0.09362 /end COMPU_METHOD
/begin COMPU_METHOD CM_0p005215686275_0_V "scale 0.00521569" RAT_FUNC "%.3f" "V" COEFFS 0 1 0 0 0 0.005215686275 /end COMPU_METHOD
/begin COMPU_METHOD CM_0p8695652174_0_mg "scale 0.869565" RAT_FUNC "%.3f" "mg" COEFFS 0 1 0 0 0 0.8695652174 /end COMPU_METHOD
/begin COMPU_METHOD CM_0p8695652174_0_mgs "scale 0.869565" RAT_FUNC "%.3f" "mg/s" COEFFS 0 1 0 0 0 0.8695652174 /end COMPU_METHOD
/begin COMPU_METHOD CM_0p05_0_s "scale 0.05" RAT_FUNC "%.3f" "s" COEFFS 0 1 0 0 0 0.05 /end COMPU_METHOD
/begin COMPU_METHOD CM_0p01_0 "scale 0.01" RAT_FUNC "%.3f" "-" COEFFS 0 1 0 0 0 0.01 /end COMPU_METHOD
/begin COMPU_METHOD CM_0p01_0p05_s "scale 0.01" RAT_FUNC "%.3f" "s" COEFFS 0 1 0.05 0 0 0.01 /end COMPU_METHOD
/begin COMPU_METHOD CM_0p0704_0_V "scale 0.0704" RAT_FUNC "%.3f" "V" COEFFS 0 1 0 0 0 0.0704 /end COMPU_METHOD
/begin COMPU_METHOD CM_0p02392578125_0_1s "scale 0.0239258" RAT_FUNC "%.3f" "1/s" COEFFS 0 1 0 0 0 0.02392578125 /end COMPU_METHOD
/begin COMPU_METHOD CM_0p0444_0_g "scale 0.0444" RAT_FUNC "%.3f" "g" COEFFS 0 1 0 0 0 0.0444 /end COMPU_METHOD
/begin COMPU_METHOD CM_0p2_0_s "scale 0.2" RAT_FUNC "%.3f" "s" COEFFS 0 1 0 0 0 0.2 /end COMPU_METHOD
/begin COMPU_METHOD CM_1p25_0_kmh "scale 1.25" RAT_FUNC "%.1f" "km/h" COEFFS 0 1 0 0 0 1.25 /end COMPU_METHOD
/begin COMPU_METHOD CM_7p8125En06_0_kgh1min "scale 7.8125e-06" RAT_FUNC "%.3f" "(kg/h)/(1/min)/%" COEFFS 0 1 0 0 0 7.8125e-06 /end COMPU_METHOD
/begin COMPU_METHOD CM_0p00078125_0 "scale 0.00078125" RAT_FUNC "%.3f" "" COEFFS 0 1 0 0 0 0.00078125 /end COMPU_METHOD
/begin COMPU_METHOD CM_0p001525878906_0_ugladrossely "scale 0.00152588" RAT_FUNC "%.3f" "% ugla drosselya" COEFFS 0 1 0 0 0 0.001525878906 /end COMPU_METHOD
/begin COMPU_METHOD CM_0p01219512195_0_ugoldrosselya "scale 0.0121951" RAT_FUNC "%.3f" "ugol drosselya, grad" COEFFS 0 1 0 0 0 0.01219512195 /end COMPU_METHOD
/begin COMPU_METHOD CM_0p0078125_0_mnozhitel "scale 0.0078125" RAT_FUNC "%.3f" "mnozhitel" COEFFS 0 1 0 0 0 0.0078125 /end COMPU_METHOD
/begin COMPU_METHOD CM_0p0009765625_0 "scale 0.000976562" RAT_FUNC "%.3f" "-" COEFFS 0 1 0 0 0 0.0009765625 /end COMPU_METHOD
/begin COMPU_METHOD CM_0p0026666667_0_ms "scale 0.00266667" RAT_FUNC "%.3f" "ms" COEFFS 0 1 0 0 0 0.0026666667 /end COMPU_METHOD
/begin COMPU_METHOD CM_0p75_0_K "scale 0.75" RAT_FUNC "%.3f" "K" COEFFS 0 1 0 0 0 0.75 /end COMPU_METHOD
/begin RECORD_LAYOUT RL_AXIS_U8 NO_AXIS_PTS_X 1 UBYTE AXIS_PTS_X 2 UBYTE INDEX_INCR DIRECT /end RECORD_LAYOUT
/begin RECORD_LAYOUT RL_AXIS_U16 NO_AXIS_PTS_X 1 UWORD AXIS_PTS_X 2 UWORD INDEX_INCR DIRECT /end RECORD_LAYOUT
/begin RECORD_LAYOUT RL_GRID_UBYTE FNC_VALUES 1 UBYTE ROW_DIR DIRECT /end RECORD_LAYOUT
/begin RECORD_LAYOUT RL_GRID_SBYTE FNC_VALUES 1 SBYTE ROW_DIR DIRECT /end RECORD_LAYOUT
/begin RECORD_LAYOUT RL_3D_A8_UBYTE NO_AXIS_PTS_Y 1 UBYTE NO_AXIS_PTS_X 2 UBYTE AXIS_PTS_Y 3 UBYTE INDEX_INCR DIRECT AXIS_PTS_X 4 UBYTE INDEX_INCR DIRECT FNC_VALUES 5 UBYTE ROW_DIR DIRECT /end RECORD_LAYOUT
/begin RECORD_LAYOUT RL_3D_A8_SBYTE NO_AXIS_PTS_Y 1 UBYTE NO_AXIS_PTS_X 2 UBYTE AXIS_PTS_Y 3 UBYTE INDEX_INCR DIRECT AXIS_PTS_X 4 UBYTE INDEX_INCR DIRECT FNC_VALUES 5 SBYTE ROW_DIR DIRECT /end RECORD_LAYOUT
/begin RECORD_LAYOUT RL_GRID_UWORD FNC_VALUES 1 UWORD ROW_DIR DIRECT /end RECORD_LAYOUT
/begin RECORD_LAYOUT RL_GRID_SWORD FNC_VALUES 1 SWORD ROW_DIR DIRECT /end RECORD_LAYOUT
/begin RECORD_LAYOUT RL_AXIS_BARE_UBYTE AXIS_PTS_X 1 UBYTE INDEX_INCR DIRECT /end RECORD_LAYOUT
/begin RECORD_LAYOUT RL_AXIS_BARE_UWORD AXIS_PTS_X 1 UWORD INDEX_INCR DIRECT /end RECORD_LAYOUT
/begin AXIS_PTS SNM16_ZU "engine speed, 16 points" 0x10103 NO_INPUT_QUANTITY RL_AXIS_U8 0 CM_40_0_rpm 16 0 10200 /end AXIS_PTS
/begin AXIS_PTS SNM16_OP "engine speed for KFZWOP, 16 points" 0x100F2 NO_INPUT_QUANTITY RL_AXIS_U8 0 CM_40_0_rpm 16 0 10200 /end AXIS_PTS
/begin AXIS_PTS SRL12_ZU "relative load, 12 points" 0x10157 NO_INPUT_QUANTITY RL_AXIS_U8 0 CM_0p75_0 12 0 191.25 /end AXIS_PTS
/begin AXIS_PTS SRL11_OP "relative load for KFZWOP, 11 points" 0x14B70 NO_INPUT_QUANTITY RL_AXIS_U16 0 CM_0p0234375_0 11 0 1535.98 /end AXIS_PTS
/begin AXIS_PTS SNM16_GK "engine speed for KFLBTS, 16 points" 0x181F7 NO_INPUT_QUANTITY RL_AXIS_U8 0 CM_40_0_rpm 16 0 10200 /end AXIS_PTS
/begin AXIS_PTS SRL12_GK "relative load for KFLBTS, 12 points" 0x1821E NO_INPUT_QUANTITY RL_AXIS_U8 0 CM_0p75_0 12 0 191.25 /end AXIS_PTS
/begin AXIS_PTS SNM08_KO "engine speed for A/C compressor, 8 points" 0x119D9 NO_INPUT_QUANTITY RL_AXIS_U8 0 CM_40_0_rpm 8 0 10200 /end AXIS_PTS
/begin AXIS_PTS SNM07_WF "engine speed for wall film maps, 7 points" 0x181E4 NO_INPUT_QUANTITY RL_AXIS_U8 0 CM_40_0_rpm 7 0 10200 /end AXIS_PTS
/begin AXIS_PTS STM09_WF "coolant temperature for wall film maps, 9 points" 0x18273 NO_INPUT_QUANTITY RL_AXIS_U8 0 CM_0p75_48_GradC 9 48 191.25 /end AXIS_PTS
/begin AXIS_PTS AX_18FCB_Y "rpm" 0x18FCB NO_INPUT_QUANTITY RL_AXIS_BARE_UBYTE 0 CM_40_0_rpm 6 -0 10200 /end AXIS_PTS
/begin AXIS_PTS AX_18FD8_Y "rpm" 0x18FD8 NO_INPUT_QUANTITY RL_AXIS_BARE_UBYTE 0 CM_40_0_rpm 6 -0 10200 /end AXIS_PTS
/begin AXIS_PTS AX_18FE5_Y "rpm" 0x18FE5 NO_INPUT_QUANTITY RL_AXIS_BARE_UBYTE 0 CM_40_0_rpm 6 -0 10200 /end AXIS_PTS
/begin AXIS_PTS AX_1955C_Y "rpm" 0x1955C NO_INPUT_QUANTITY RL_AXIS_BARE_UBYTE 0 CM_40_0_rpm 6 -0 10200 /end AXIS_PTS
/begin AXIS_PTS AX_19569_Y "rpm" 0x19569 NO_INPUT_QUANTITY RL_AXIS_BARE_UBYTE 0 CM_40_0_rpm 6 -0 10200 /end AXIS_PTS
/begin AXIS_PTS AX_18AC1_Y "Grad C" 0x18AC1 NO_INPUT_QUANTITY RL_AXIS_BARE_UBYTE 0 CM_0p75_48_GradC 8 -48 143.25 /end AXIS_PTS
/begin AXIS_PTS AX_18AD2_Y "rpm" 0x18AD2 NO_INPUT_QUANTITY RL_AXIS_BARE_UBYTE 0 CM_40_0_rpm 8 -0 10200 /end AXIS_PTS
/begin AXIS_PTS AX_14BE0_X "% momenta" 0x14BE0 NO_INPUT_QUANTITY RL_AXIS_BARE_UWORD 0 CM_0p001525878906_0_momenta 12 -0 99.9985 /end AXIS_PTS
/begin AXIS_PTS AX_14BC0_Y "ob/min" 0x14BC0 NO_INPUT_QUANTITY RL_AXIS_BARE_UWORD 0 CM_0p25_0_obmin 16 -0 16383.8 /end AXIS_PTS
/begin AXIS_PTS AX_1512A_X "% napolneniya" 0x1512A NO_INPUT_QUANTITY RL_AXIS_BARE_UWORD 0 CM_0p0234375_0_napolneniya 12 -0 1535.98 /end AXIS_PTS
/begin AXIS_PTS AX_15116_Y "ob/min" 0x15116 NO_INPUT_QUANTITY RL_AXIS_BARE_UWORD 0 CM_0p25_0_obmin 10 -0 16383.8 /end AXIS_PTS
/begin AXIS_PTS AX_10515_Y "lambda" 0x10515 NO_INPUT_QUANTITY RL_AXIS_BARE_UBYTE 0 CM_0p0078125_0_lambda 10 -0 1.99219 /end AXIS_PTS
/begin AXIS_PTS AX_19516_Y "rpm" 0x19516 NO_INPUT_QUANTITY RL_AXIS_BARE_UBYTE 0 CM_40_0_rpm 10 -0 10200 /end AXIS_PTS
/begin AXIS_PTS AX_11581_Y "rpm" 0x11581 NO_INPUT_QUANTITY RL_AXIS_BARE_UBYTE 0 CM_40_0_rpm 6 -0 10200 /end AXIS_PTS
/begin AXIS_PTS AX_15688_X "% ugla drosselya" 0x15688 NO_INPUT_QUANTITY RL_AXIS_BARE_UWORD 0 CM_IDENTITY 6 -0 65535 /end AXIS_PTS
/begin AXIS_PTS AX_15668_Y "pspvdk" 0x15668 NO_INPUT_QUANTITY RL_AXIS_BARE_UWORD 0 CM_IDENTITY 16 -0 65535 /end AXIS_PTS
/begin AXIS_PTS AX_1AC92_X "ob/min" 0x1AC92 NO_INPUT_QUANTITY RL_AXIS_BARE_UWORD 0 CM_0p25_0_obmin 12 -0 16383.8 /end AXIS_PTS
/begin AXIS_PTS AX_1AC7A_Y "ugol drosselya, grad" 0x1AC7A NO_INPUT_QUANTITY RL_AXIS_BARE_UWORD 0 CM_0p01219512195_0_ugoldrosselya 12 -0 799.207 /end AXIS_PTS
/begin AXIS_PTS AX_11A2F_Y "Grad C" 0x11A2F NO_INPUT_QUANTITY RL_AXIS_BARE_UBYTE 0 CM_0p75_48_GradC 6 -48 143.25 /end AXIS_PTS
/begin AXIS_PTS AX_11699_Y "Grad C" 0x11699 NO_INPUT_QUANTITY RL_AXIS_BARE_UBYTE 0 CM_0p75_48_GradC 12 -48 143.25 /end AXIS_PTS
/begin AXIS_PTS AX_1168C_Y "Grad C" 0x1168C NO_INPUT_QUANTITY RL_AXIS_BARE_UBYTE 0 CM_0p75_48_GradC 6 -48 143.25 /end AXIS_PTS
/begin AXIS_PTS AX_116BA_X "-" 0x116BA NO_INPUT_QUANTITY RL_AXIS_BARE_UBYTE 0 CM_IDENTITY 6 -0 255 /end AXIS_PTS
/begin AXIS_PTS AX_116B4_Y "Grad C" 0x116B4 NO_INPUT_QUANTITY RL_AXIS_BARE_UBYTE 0 CM_0p75_48_GradC 6 -48 143.25 /end AXIS_PTS
/begin AXIS_PTS AX_1170C_X "-" 0x1170C NO_INPUT_QUANTITY RL_AXIS_BARE_UBYTE 0 CM_IDENTITY 6 -0 255 /end AXIS_PTS
/begin AXIS_PTS AX_11700_Y "Grad C" 0x11700 NO_INPUT_QUANTITY RL_AXIS_BARE_UBYTE 0 CM_0p75_48_GradC 12 -48 143.25 /end AXIS_PTS
/begin AXIS_PTS AX_116EA_X "rpm" 0x116EA NO_INPUT_QUANTITY RL_AXIS_BARE_UBYTE 0 CM_40_0_rpm 4 -0 10200 /end AXIS_PTS
/begin AXIS_PTS AX_116E6_Y "Grad C" 0x116E6 NO_INPUT_QUANTITY RL_AXIS_BARE_UBYTE 0 CM_0p75_48_GradC 4 -48 143.25 /end AXIS_PTS
/begin AXIS_PTS AX_15F74_X "Grad C" 0x15F74 NO_INPUT_QUANTITY RL_AXIS_BARE_UBYTE 0 CM_0p75_48_GradC 4 -48 143.25 /end AXIS_PTS
/begin AXIS_PTS AX_15F6C_Y "-" 0x15F6C NO_INPUT_QUANTITY RL_AXIS_BARE_UWORD 0 CM_IDENTITY 4 -0 65535 /end AXIS_PTS
/begin AXIS_PTS AX_1B674_X "ms" 0x1B674 NO_INPUT_QUANTITY RL_AXIS_BARE_UWORD 0 CM_0p0026666667_0_ms 16 -0 174.76 /end AXIS_PTS
/begin AXIS_PTS AX_1B664_Y "rpm" 0x1B664 NO_INPUT_QUANTITY RL_AXIS_BARE_UBYTE 0 CM_40_0_rpm 16 -0 10200 /end AXIS_PTS
/begin AXIS_PTS AX_1827E_X "Grad C" 0x1827E NO_INPUT_QUANTITY RL_AXIS_BARE_UBYTE 0 CM_0p75_48_GradC 12 -48 143.25 /end AXIS_PTS
/begin AXIS_PTS AX_10176_Y "Grad C" 0x10176 NO_INPUT_QUANTITY RL_AXIS_BARE_UBYTE 0 CM_0p75_48_GradC 12 -48 143.25 /end AXIS_PTS
/begin CHARACTERISTIC STM12ESUB "podtverzhdena damos addr 0x10176 | Distribution for the engine coolant temperature tmot" CURVE 0x10176 RL_GRID_UBYTE 0 CM_0p75_48_GradC -48 143.25
 /begin AXIS_DESCR FIX_AXIS NO_INPUT_QUANTITY CM_IDENTITY 12 0 11 FIX_AXIS_PAR_DIST 0 1 12 /end AXIS_DESCR
/end CHARACTERISTIC
/begin CHARACTERISTIC KFETAZW "podtverzhdena profil addr 0x101F4 | Karta KPD po uglu operezheniya zazhiganiya. Klassicheskiy format Bosch: zagolovok nx/ny i osi vnutri bloka." MAP 0x101F4 RL_3D_A8_UBYTE 0 CM_0p5_0 0 127.5 /begin AXIS_DESCR STD_AXIS NO_INPUT_QUANTITY CM_IDENTITY 16 0 255 /end AXIS_DESCR /begin AXIS_DESCR STD_AXIS NO_INPUT_QUANTITY CM_IDENTITY 16 0 255 /end AXIS_DESCR /end CHARACTERISTIC
/begin CHARACTERISTIC KFETAZWN "podtverzhdena profil addr 0x10316 | To zhe na holostom hodu." MAP 0x10316 RL_3D_A8_UBYTE 0 CM_0p5_0 0 127.5 /begin AXIS_DESCR STD_AXIS NO_INPUT_QUANTITY CM_IDENTITY 16 0 255 /end AXIS_DESCR /begin AXIS_DESCR STD_AXIS NO_INPUT_QUANTITY CM_IDENTITY 16 0 255 /end AXIS_DESCR /end CHARACTERISTIC
/begin CHARACTERISTIC ETADZW "podtverzhdena damos-veroyatno addr 0x104D3 | ignition efficiency depending on delta ignition angle | smysl podtverzhden CTP7: Effektivnost po smescheniyu UOZ" CURVE 0x104D3 RL_GRID_UBYTE 0 CM_0p5_0 0 127.5
 /begin AXIS_DESCR FIX_AXIS NO_INPUT_QUANTITY CM_IDENTITY 65 0 64 FIX_AXIS_PAR_DIST 0 1 65 /end AXIS_DESCR
/end CHARACTERISTIC
/begin CHARACTERISTIC ETALAM_10515 "podtverzhdena damos addr 0x10515 | Lambda effectiveness" CURVE 0x10515 RL_GRID_UBYTE 0 CM_0p5_0 0 127.5
 /begin AXIS_DESCR FIX_AXIS NO_INPUT_QUANTITY CM_IDENTITY 10 0 9 FIX_AXIS_PAR_DIST 0 1 10 /end AXIS_DESCR
/end CHARACTERISTIC
/begin CHARACTERISTIC KFZWOP "podtverzhdena profil addr 0x10529 | Optimalnyy ugol operezheniya zazhiganiya. Stolbcy = nagruzka (11 tochek, os SRL11OPUW), stroki = oboroty (16 tochek, os SNM16OPUB, x40 ob/min). Stok 0.75..45 grad. " MAP 0x10529 RL_GRID_SBYTE 0 CM_0p75_0_gradKW -96 95.25
 /begin AXIS_DESCR COM_AXIS NO_INPUT_QUANTITY CM_0p0234375_0 11 0 1535.98 AXIS_PTS_REF SRL11_OP /end AXIS_DESCR
 /begin AXIS_DESCR COM_AXIS NO_INPUT_QUANTITY CM_40_0_rpm 16 0 10200 AXIS_PTS_REF SNM16_OP /end AXIS_DESCR
/end CHARACTERISTIC
/begin CHARACTERISTIC DZWETA "adres podtverzhden damos-veroyatno addr 0x1086C | IMYA NE PODTVERZHDENO, adres: kod: movb RL5, [r4+#0x86c] @0x83DA96 | delta ignition angle from efficiency" CURVE 0x1086C RL_GRID_SBYTE 0 CM_0p75_0_gradKW -96 95.25
 /begin AXIS_DESCR FIX_AXIS NO_INPUT_QUANTITY CM_IDENTITY 201 0 200 FIX_AXIS_PAR_DIST 0 1 201 /end AXIS_DESCR
/end CHARACTERISTIC
/begin CHARACTERISTIC KFZWMS "podtverzhdena profil addr 0x10935 | Predelno pozdniy ugol zazhiganiya. V stoke vsya karta ravna -33 (-24.75 grad). Pravitsya tyuningom." MAP 0x10935 RL_GRID_SBYTE 0 CM_0p75_0_gradKW -96 95.25
 /begin AXIS_DESCR COM_AXIS NO_INPUT_QUANTITY CM_0p75_0 12 0 191.25 AXIS_PTS_REF SRL12_ZU /end AXIS_DESCR
 /begin AXIS_DESCR COM_AXIS NO_INPUT_QUANTITY CM_40_0_rpm 16 0 10200 AXIS_PTS_REF SNM16_ZU /end AXIS_DESCR
/end CHARACTERISTIC
/begin CHARACTERISTIC KFZW "podtverzhdena profil addr 0x109F5 | Osnovnaya karta ugla operezheniya zazhiganiya. Stolbcy = nagruzka (12 tochek, os SRL12ZUUB), stroki = oboroty (16 tochek, SNM16ZUUB). Stok -0.75..42.75 grad." MAP 0x109F5 RL_GRID_SBYTE 0 CM_0p75_0_gradKW -96 95.25
 /begin AXIS_DESCR COM_AXIS NO_INPUT_QUANTITY CM_0p75_0 12 0 191.25 AXIS_PTS_REF SRL12_ZU /end AXIS_DESCR
 /begin AXIS_DESCR COM_AXIS NO_INPUT_QUANTITY CM_40_0_rpm 16 0 10200 AXIS_PTS_REF SNM16_ZU /end AXIS_DESCR
/end CHARACTERISTIC
/begin CHARACTERISTIC KFZW2 "podtverzhdena profil addr 0x10AB5 | Karta zazhiganiya, variant 2. Stok 2.25..33.75 grad." MAP 0x10AB5 RL_GRID_SBYTE 0 CM_0p75_0_gradKW -96 95.25
 /begin AXIS_DESCR COM_AXIS NO_INPUT_QUANTITY CM_0p75_0 12 0 191.25 AXIS_PTS_REF SRL12_ZU /end AXIS_DESCR
 /begin AXIS_DESCR COM_AXIS NO_INPUT_QUANTITY CM_40_0_rpm 16 0 10200 AXIS_PTS_REF SNM16_ZU /end AXIS_DESCR
/end CHARACTERISTIC
/begin CHARACTERISTIC KFZWMN "podtverzhdena profil addr 0x14DA4 | Karta minimalnogo ugla zazhiganiya. Izmenena kalibrovschikom. ADRES -- ZAGOLOVOK: [16][12][os oborotov][os nagruzki], dannye s 0x14DC2. Razvyazka v profile." MAP 0x14DA4 RL_3D_A8_SBYTE 0 CM_0p75_0_gradKW -96 95.25 /begin AXIS_DESCR STD_AXIS NO_INPUT_QUANTITY CM_0p75_0 16 0 191.25 /end AXIS_DESCR /begin AXIS_DESCR STD_AXIS NO_INPUT_QUANTITY CM_40_0_rpm 12 0 10200 /end AXIS_DESCR /end CHARACTERISTIC
/begin CHARACTERISTIC SNM07ESUB "podtverzhdena damos addr 0x181E5 | Base point distribution of engine speed, 7 base pts." CURVE 0x181E5 RL_GRID_UBYTE 0 CM_40_0_Upm 0 10200
 /begin AXIS_DESCR FIX_AXIS NO_INPUT_QUANTITY CM_IDENTITY 7 0 6 FIX_AXIS_PAR_DIST 0 1 7 /end AXIS_DESCR
/end CHARACTERISTIC
/begin CHARACTERISTIC SNM16GKUB_181F8 "podtverzhdena damos addr 0x181F8 | Datapoint distribution mixture control 16 nmot datapoints" CURVE 0x181F8 RL_GRID_UBYTE 0 CM_40_0_Upm 0 10200
 /begin AXIS_DESCR FIX_AXIS NO_INPUT_QUANTITY CM_IDENTITY 16 0 15 FIX_AXIS_PAR_DIST 0 1 16 /end AXIS_DESCR
/end CHARACTERISTIC
/begin CHARACTERISTIC SRL12GKUB_1821F "podtverzhdena damos addr 0x1821F" CURVE 0x1821F RL_GRID_UBYTE 0 CM_0p75_0 0 191.25
 /begin AXIS_DESCR FIX_AXIS NO_INPUT_QUANTITY CM_IDENTITY 12 0 11 FIX_AXIS_PAR_DIST 0 1 12 /end AXIS_DESCR
/end CHARACTERISTIC
/begin CHARACTERISTIC STM09ESUB "podtverzhdena damos addr 0x18274 | Base point distribution of engine temperature, 9 base pts." CURVE 0x18274 RL_GRID_UBYTE 0 CM_0p75_48_GradC -48 143.25
 /begin AXIS_DESCR FIX_AXIS NO_INPUT_QUANTITY CM_IDENTITY 9 0 8 FIX_AXIS_PAR_DIST 0 1 9 /end AXIS_DESCR
/end CHARACTERISTIC
/begin CHARACTERISTIC STS12ESUB "podtverzhdena damos addr 0x1827E | Distribution for engine coolant temperature at start" CURVE 0x1827E RL_GRID_UBYTE 0 CM_0p75_48_GradC -48 143.25
 /begin AXIS_DESCR FIX_AXIS NO_INPUT_QUANTITY CM_IDENTITY 12 0 11 FIX_AXIS_PAR_DIST 0 1 12 /end AXIS_DESCR
/end CHARACTERISTIC
/begin CHARACTERISTIC RLLRUN_18AD2 "adres podtverzhden damos-veroyatno addr 0x18AD2 | IMYA NE PODTVERZHDENO, adres: kod: mov r12, #0xad1 @0x84B798 | char.line above nmot,lower rL control limit for controller in front of catalyst" CURVE 0x18AD2 RL_GRID_UBYTE 0 CM_0p75_0 0 191.25
 /begin AXIS_DESCR FIX_AXIS NO_INPUT_QUANTITY CM_IDENTITY 8 0 7 FIX_AXIS_PAR_DIST 0 1 8 /end AXIS_DESCR
/end CHARACTERISTIC
/begin CHARACTERISTIC WDKSLN_18FCB "adres podtverzhden damos-veroyatno addr 0x18FCB | IMYA NE PODTVERZHDENO, adres: kod: mov r12, #0xfca @0x8506E0 | Throttle valve angle threshold for idle detection" CURVE 0x18FCB RL_GRID_UBYTE 0 CM_0p3921568627_0_DK 0 100
 /begin AXIS_DESCR FIX_AXIS NO_INPUT_QUANTITY CM_IDENTITY 6 0 5 FIX_AXIS_PAR_DIST 0 1 6 /end AXIS_DESCR
/end CHARACTERISTIC
/begin CHARACTERISTIC KFLF "podtverzhdena damos addr 0x190EC | lambda characteristic map at part load" MAP 0x190EC RL_GRID_UBYTE 0 CM_0p0078125_0 0 1.99219
 /begin AXIS_DESCR FIX_AXIS NO_INPUT_QUANTITY CM_IDENTITY 16 0 15 FIX_AXIS_PAR_DIST 0 1 16 /end AXIS_DESCR
 /begin AXIS_DESCR FIX_AXIS NO_INPUT_QUANTITY CM_IDENTITY 12 0 11 FIX_AXIS_PAR_DIST 0 1 12 /end AXIS_DESCR
/end CHARACTERISTIC
/begin CHARACTERISTIC KFLBTS "podtverzhdena profil addr 0x19636 | Celevaya lyambda zaschity komponentov. Stok obogaschaet do 0.789 na vysokoy nagruzke, csok do 0.844, MPower -- 1.000 vo vseh 192 yacheykah, to est obogaschenie zasc" MAP 0x19636 RL_GRID_UBYTE 0 CM_0p0078125_0 0 1.99219
 /begin AXIS_DESCR COM_AXIS NO_INPUT_QUANTITY CM_40_0_rpm 16 0 10200 AXIS_PTS_REF SNM16_GK /end AXIS_DESCR
 /begin AXIS_DESCR COM_AXIS NO_INPUT_QUANTITY CM_0p75_0 12 0 191.25 AXIS_PTS_REF SRL12_GK /end AXIS_DESCR
/end CHARACTERISTIC
/begin CHARACTERISTIC GRID_528_197BC_10x10 "adres podtverzhden gridscan addr 0x197BC | IMYA NE PODTVERZHDENO, adres: kod: mov r12, #0x17bc @0x8574EE" MAP 0x197BC RL_GRID_UBYTE 0 CM_IDENTITY 0 255
 /begin AXIS_DESCR FIX_AXIS NO_INPUT_QUANTITY CM_IDENTITY 10 0 9 FIX_AXIS_PAR_DIST 0 1 10 /end AXIS_DESCR
 /begin AXIS_DESCR FIX_AXIS NO_INPUT_QUANTITY CM_IDENTITY 10 0 9 FIX_AXIS_PAR_DIST 0 1 10 /end AXIS_DESCR
/end CHARACTERISTIC
/begin CHARACTERISTIC KFQTE "podtverzhdena damos-tochno addr 0x1983F | Map for purge rate increase / decrease" MAP 0x1983F RL_GRID_UBYTE 0 CM_4p768359375En05_0_1s 0 0.0121593
 /begin AXIS_DESCR FIX_AXIS NO_INPUT_QUANTITY CM_IDENTITY 5 0 4 FIX_AXIS_PAR_DIST 0 1 5 /end AXIS_DESCR
 /begin AXIS_DESCR FIX_AXIS NO_INPUT_QUANTITY CM_IDENTITY 6 0 5 FIX_AXIS_PAR_DIST 0 1 6 /end AXIS_DESCR
/end CHARACTERISTIC
/begin CHARACTERISTIC DIAG_FLAGS "podtverzhdena | Tablica flagov diagnostiki (znacheniya 0/1). V proshivke csok chast edinic zamenena nulyami otnositelno stoka -- otklyucheny proverki." VALUE 0x10009 RL_GRID_UBYTE 0 CM_IDENTITY -0 255 /end CHARACTERISTIC
/begin CHARACTERISTIC DNMAXH "podtverzhdena | Gisterezis zhestkogo ogranicheniya: toplivo vozvraschaetsya na NMAX minus 120 ob/min. Odinakov vo vseh vosmi proshivkah." VALUE 0x14BB2 RL_GRID_UWORD 0 CM_0p25_0_obmin -0 16383.8 /end CHARACTERISTIC
/begin CHARACTERISTIC NMAX "podtverzhdena | Otsechka. Znacheniya sovpali s tem, chto nazyval kalibrovschik (6800 protiv 7700)." VALUE 0x14BB4 RL_GRID_UWORD 0 CM_0p25_0_obmin -0 16383.8 /end CHARACTERISTIC
/begin CHARACTERISTIC NMAXDV "podtverzhdena | Ogranichenie oborotov pri neispravnom signale skorosti, a ne vtoroy porog obychnoy otsechki. Kosvennoe podtverzhdenie: L podnyal NMAX do 7084 i ostavil zdes 6000 -- bud eto rabochiy pr" VALUE 0x14BB6 RL_GRID_UWORD 0 CM_0p25_0_obmin -0 16383.8 /end CHARACTERISTIC
/begin CHARACTERISTIC NMXDKPU "podtverzhdena | Predel pri neizvestnom ili oshibochnom polozhenii drosselya, limp-houm. 1200 vo vseh proshivkah." VALUE 0x14BB8 RL_GRID_UWORD 0 CM_0p25_0_obmin -0 16383.8 /end CHARACTERISTIC
/begin CHARACTERISTIC TNMAXDV "podtverzhdena | Zaderzhka vklyucheniya ogranicheniya po NMAXDV. 3 s vo vseh proshivkah." VALUE 0x14BBA RL_GRID_UWORD 0 CM_0p01_0_s -0 655.35 /end CHARACTERISTIC
/begin CHARACTERISTIC DTC_CODES "adres podtverzhden | fault code table, 144 words, four entries per code" CURVE 0x1653A RL_GRID_UWORD 0 CM_IDENTITY -0 65535
 /begin AXIS_DESCR FIX_AXIS NO_INPUT_QUANTITY CM_IDENTITY 144 0 143 FIX_AXIS_PAR_DIST 0 1 144 /end AXIS_DESCR
/end CHARACTERISTIC
/begin CHARACTERISTIC WDKSLN "podtverzhdena | Throttle valve angle threshold for idle detection" CURVE 0x18FD1 RL_GRID_UBYTE 0 CM_0p392157_0 -0 100
 /begin AXIS_DESCR COM_AXIS NO_INPUT_QUANTITY CM_40_0_rpm 6 0 10200 AXIS_PTS_REF AX_18FCB_Y /end AXIS_DESCR
/end CHARACTERISTIC
/begin CHARACTERISTIC WDKVLN_0 "podtverzhdena | Throttle valve angle threshold for full load detection, variant 0" CURVE 0x18FDE RL_GRID_UBYTE 0 CM_0p392157_0 -0 100
 /begin AXIS_DESCR COM_AXIS NO_INPUT_QUANTITY CM_40_0_rpm 6 0 10200 AXIS_PTS_REF AX_18FD8_Y /end AXIS_DESCR
/end CHARACTERISTIC
/begin CHARACTERISTIC WDKVLN_1 "podtverzhdena | Throttle valve angle threshold for full load detection, variant 1" CURVE 0x18FEB RL_GRID_UBYTE 0 CM_0p392157_0 -0 100
 /begin AXIS_DESCR COM_AXIS NO_INPUT_QUANTITY CM_40_0_rpm 6 0 10200 AXIS_PTS_REF AX_18FE5_Y /end AXIS_DESCR
/end CHARACTERISTIC
/begin CHARACTERISTIC KLLAMFA_0 "podtverzhdena | full load enrichment, variant 0" CURVE 0x19562 RL_GRID_UBYTE 0 CM_0p0078125_0 -0 1.99219
 /begin AXIS_DESCR COM_AXIS NO_INPUT_QUANTITY CM_40_0_rpm 6 0 10200 AXIS_PTS_REF AX_1955C_Y /end AXIS_DESCR
/end CHARACTERISTIC
/begin CHARACTERISTIC KLLAMFA_1 "podtverzhdena | full load enrichment, variant 1" CURVE 0x1956F RL_GRID_UBYTE 0 CM_0p0078125_0 -0 1.99219
 /begin AXIS_DESCR COM_AXIS NO_INPUT_QUANTITY CM_40_0_rpm 6 0 10200 AXIS_PTS_REF AX_19569_Y /end AXIS_DESCR
/end CHARACTERISTIC
/begin CHARACTERISTIC TV_LAMFA "adres podtverzhden | delay before full load enrichment, per variant (imya nashe: damos etu paru ne nazyvaet)" CURVE 0x1B894 RL_GRID_UBYTE 0 CM_IDENTITY -0 255
 /begin AXIS_DESCR FIX_AXIS NO_INPUT_QUANTITY CM_IDENTITY 2 0 1 FIX_AXIS_PAR_DIST 0 1 2 /end AXIS_DESCR
/end CHARACTERISTIC
/begin CHARACTERISTIC RLLRTMO "podtverzhdena | char. line on tmot, upper rl control threshold for upstream lambda" CURVE 0x18AC9 RL_GRID_UBYTE 0 CM_0p75_0 -0 191.25
 /begin AXIS_DESCR COM_AXIS NO_INPUT_QUANTITY CM_0p75_48_GradC 8 0 143.25 AXIS_PTS_REF AX_18AC1_Y /end AXIS_DESCR
/end CHARACTERISTIC
/begin CHARACTERISTIC RLLRUN "podtverzhdena | char.line above nmot, lower rL control limit" CURVE 0x18ADA RL_GRID_UBYTE 0 CM_0p75_0 -0 191.25
 /begin AXIS_DESCR COM_AXIS NO_INPUT_QUANTITY CM_40_0_rpm 8 0 10200 AXIS_PTS_REF AX_18AD2_Y /end AXIS_DESCR
/end CHARACTERISTIC
/begin CHARACTERISTIC TARAU "podtverzhdena | air temperature threshold for closed loop lambda switch" VALUE 0x18AE2 RL_GRID_UBYTE 0 CM_0p75_48_GradC -48 143.25 /end CHARACTERISTIC
/begin CHARACTERISTIC TASHS "podtverzhdena | intake air temp threshold triggering TLRHS blocking time" VALUE 0x18AE3 RL_GRID_UBYTE 0 CM_0p75_48_GradC -48 143.25 /end CHARACTERISTIC
/begin CHARACTERISTIC TLRHS "podtverzhdena | blocking time of lambda control during hot start" VALUE 0x18AE4 RL_GRID_UBYTE 0 CM_0p1_0_s -0 25.5 /end CHARACTERISTIC
/begin CHARACTERISTIC TMRA1 "podtverzhdena | cut-out condition, idle-speed switch = 0" VALUE 0x18AE5 RL_GRID_UBYTE 0 CM_0p75_48_GradC -48 143.25 /end CHARACTERISTIC
/begin CHARACTERISTIC TMRA2 "adres podtverzhden | cut-out condition, idle-speed switch = 1" VALUE 0x18AE6 RL_GRID_UBYTE 0 CM_0p75_48_GradC -48 143.25 /end CHARACTERISTIC
/begin CHARACTERISTIC TATELL "podtverzhdena | tans-threshold for canister purge control with B_ll = 1" VALUE 0x19535 RL_GRID_UBYTE 0 CM_0p75_48_GradC -48 143.25 /end CHARACTERISTIC
/begin CHARACTERISTIC TMSKLH "podtverzhdena | engine temperature threshold for short initial phase LRA when engin hot" VALUE 0x19536 RL_GRID_UBYTE 0 CM_0p75_48_GradC -48 143.25 /end CHARACTERISTIC
/begin CHARACTERISTIC TMSNOGA "podtverzhdena | threshold tms for endless purge control, if mixture adaptation without error" VALUE 0x19537 RL_GRID_UBYTE 0 CM_0p75_48_GradC -48 143.25 /end CHARACTERISTIC
/begin CHARACTERISTIC FRAOMN "podtverzhdena | lower limit of correction factor frao" VALUE 0x19543 RL_GRID_UBYTE 0 CM_0p0078125_0 -0 1.99219 /end CHARACTERISTIC
/begin CHARACTERISTIC FRAOMX "podtverzhdena | upper limit of correction factor frao" VALUE 0x19544 RL_GRID_UBYTE 0 CM_0p0078125_0 -0 1.99219 /end CHARACTERISTIC
/begin CHARACTERISTIC FRAORN "podtverzhdena | reduced lower threshold for frao correction" VALUE 0x19545 RL_GRID_UBYTE 0 CM_0p0078125_0 -0 1.99219 /end CHARACTERISTIC
/begin CHARACTERISTIC FRAORX "podtverzhdena | reduced upper threshold for trao correction" VALUE 0x19546 RL_GRID_UBYTE 0 CM_0p0078125_0 -0 1.99219 /end CHARACTERISTIC
/begin CHARACTERISTIC FRATMN "podtverzhdena | lower limit of correction factor frat" VALUE 0x19547 RL_GRID_UBYTE 0 CM_0p0078125_0 -0 1.99219 /end CHARACTERISTIC
/begin CHARACTERISTIC FRATMX "podtverzhdena | upper limit of correction factor frat" VALUE 0x19548 RL_GRID_UBYTE 0 CM_0p0078125_0 -0 1.99219 /end CHARACTERISTIC
/begin CHARACTERISTIC FRAUMN "podtverzhdena | lower limit of correction factor frau" VALUE 0x19549 RL_GRID_UBYTE 0 CM_0p0078125_0 -0 1.99219 /end CHARACTERISTIC
/begin CHARACTERISTIC FRAUMX "podtverzhdena | upper limit of correction factor frau" VALUE 0x1954A RL_GRID_UBYTE 0 CM_0p0078125_0 -0 1.99219 /end CHARACTERISTIC
/begin CHARACTERISTIC FRAURN "podtverzhdena | reduced lower threshold for frau correction" VALUE 0x1954B RL_GRID_UBYTE 0 CM_0p0078125_0 -0 1.99219 /end CHARACTERISTIC
/begin CHARACTERISTIC FRAURX "podtverzhdena | reduced upper threshold fpr frau correction" VALUE 0x1954C RL_GRID_UBYTE 0 CM_0p0078125_0 -0 1.99219 /end CHARACTERISTIC
/begin CHARACTERISTIC NO1 "podtverzhdena | upper engine-speed threshold range 1" VALUE 0x1954D RL_GRID_UBYTE 0 CM_40_0_Upm -0 10200 /end CHARACTERISTIC
/begin CHARACTERISTIC NOLRA "podtverzhdena | codeword for release of adaptation" VALUE 0x1954E RL_GRID_UBYTE 0 CM_IDENTITY -0 255 /end CHARACTERISTIC
/begin CHARACTERISTIC NU3 "podtverzhdena | lower engine-speed threshold range 3" VALUE 0x1954F RL_GRID_UBYTE 0 CM_40_0_Upm -0 10200 /end CHARACTERISTIC
/begin CHARACTERISTIC RLO2 "podtverzhdena | upper load threshold of range 2" VALUE 0x19550 RL_GRID_UBYTE 0 CM_0p75_0 -0 191.25 /end CHARACTERISTIC
/begin CHARACTERISTIC RLO3 "podtverzhdena | upper load-signal threshold range 3" VALUE 0x19551 RL_GRID_UBYTE 0 CM_0p75_0 -0 191.25 /end CHARACTERISTIC
/begin CHARACTERISTIC RLO3AC "podtverzhdena | upper load-signal threshold range 3 with compressor" VALUE 0x19552 RL_GRID_UBYTE 0 CM_0p75_0 -0 191.25 /end CHARACTERISTIC
/begin CHARACTERISTIC RLU2 "podtverzhdena | lower load-signal threshold range 2" VALUE 0x19553 RL_GRID_UBYTE 0 CM_0p75_0 -0 191.25 /end CHARACTERISTIC
/begin CHARACTERISTIC RLU2AC "podtverzhdena | lower load-signal threshold range 2 with compressor" VALUE 0x19554 RL_GRID_UBYTE 0 CM_0p75_0 -0 191.25 /end CHARACTERISTIC
/begin CHARACTERISTIC RLU3 "podtverzhdena | lower load-signal threshold range 3" VALUE 0x19555 RL_GRID_UBYTE 0 CM_0p75_0 -0 191.25 /end CHARACTERISTIC
/begin CHARACTERISTIC RLU4 "podtverzhdena | lower load threshold of the upper multiplicative section" VALUE 0x19556 RL_GRID_UBYTE 0 CM_0p75_0 -0 191.25 /end CHARACTERISTIC
/begin CHARACTERISTIC TMFRATMN "podtverzhdena | minimum temperature at it ftklra_w is one" VALUE 0x19557 RL_GRID_UBYTE 0 CM_0p75_48_GradC -48 143.25 /end CHARACTERISTIC
/begin CHARACTERISTIC TMFRATUB "podtverzhdena | upper temperature threshold at it ftklra_w is constant" VALUE 0x19558 RL_GRID_UBYTE 0 CM_0p75_48_GradC -48 143.25 /end CHARACTERISTIC
/begin CHARACTERISTIC CWPKAPP "podtverzhdena | code word application of reference pressure for fuel-pressure controller" VALUE 0x19559 RL_GRID_UBYTE 0 CM_IDENTITY -0 255 /end CHARACTERISTIC
/begin CHARACTERISTIC KRKTE "podtverzhdena | conversion from relative fuel mass rk into effective injection time te" VALUE 0x1955A RL_GRID_UBYTE 0 CM_0p001779359431_0_ms -0 0.453737 /end CHARACTERISTIC
/begin CHARACTERISTIC CWLAMBTS "podtverzhdena | code word: lambda component protection" VALUE 0x19575 RL_GRID_UBYTE 0 CM_IDENTITY -0 255 /end CHARACTERISTIC
/begin CHARACTERISTIC KFFDLBTS "podtverzhdena |" MAP 0x19576 RL_GRID_UBYTE 0 CM_0p0078125_0 -0 1.99219
 /begin AXIS_DESCR COM_AXIS NO_INPUT_QUANTITY CM_40_0_rpm 16 0 10200 AXIS_PTS_REF SNM16_GK /end AXIS_DESCR
 /begin AXIS_DESCR COM_AXIS NO_INPUT_QUANTITY CM_0p75_0 12 0 191.25 AXIS_PTS_REF SRL12_GK /end AXIS_DESCR
/end CHARACTERISTIC
/begin CHARACTERISTIC TVLBTS "podtverzhdena | 0 vo vseh vosmi proshivkah, dopolnitelnoy zaderzhki net" VALUE 0x196F6 RL_GRID_UBYTE 0 CM_IDENTITY -0 255 /end CHARACTERISTIC
/begin CHARACTERISTIC DKROKMX "podtverzhdena | maximum offset-compensation value" VALUE 0x1163B RL_GRID_UBYTE 0 CM_0p01953125_0_V -0 4.98047 /end CHARACTERISTIC
/begin CHARACTERISTIC FKEFMC "podtverzhdena | correction factor for knock detection thresh. in case of change of filter frequ." VALUE 0x1163C RL_GRID_UBYTE 0 CM_0p0625_0 -0 15.9375 /end CHARACTERISTIC
/begin CHARACTERISTIC FKELDY "podtverzhdena | correction factor for knock detection threshold during load dynamics" VALUE 0x1163D RL_GRID_UBYTE 0 CM_0p0625_0 -0 15.9375 /end CHARACTERISTIC
/begin CHARACTERISTIC FKENDY "podtverzhdena | correction factor for knock detection threshold with engine-speed dynamics" VALUE 0x1163E RL_GRID_UBYTE 0 CM_0p0625_0 -0 15.9375 /end CHARACTERISTIC
/begin CHARACTERISTIC FKRFTPFMC "podtverzhdena | correction factor of low pass characteristic at switch of filter mean frequency" VALUE 0x1163F RL_GRID_UBYTE 0 CM_0p0078125_0 -0 1.99219 /end CHARACTERISTIC
/begin CHARACTERISTIC KRFTP1 "podtverzhdena | low pass characteristic normal" VALUE 0x11640 RL_GRID_UBYTE 0 CM_IDENTITY -0 255 /end CHARACTERISTIC
/begin CHARACTERISTIC KRFTP2 "podtverzhdena | low pass characteristic at engine speed dynamics" VALUE 0x11641 RL_GRID_UBYTE 0 CM_IDENTITY -0 255 /end CHARACTERISTIC
/begin CHARACTERISTIC KRFTP3 "podtverzhdena | low pass characteristic at load dynamic" VALUE 0x11642 RL_GRID_UBYTE 0 CM_IDENTITY -0 255 /end CHARACTERISTIC
/begin CHARACTERISTIC KRKFKS "podtverzhdena | selected knock detection threshold, if missing cylinder one detection" VALUE 0x11643 RL_GRID_UBYTE 0 CM_IDENTITY -0 255 /end CHARACTERISTIC
/begin CHARACTERISTIC KRVST "podtverzhdena | gain after cranking" VALUE 0x11644 RL_GRID_UBYTE 0 CM_IDENTITY -0 255 /end CHARACTERISTIC
/begin CHARACTERISTIC REFINI "podtverzhdena | initial value for reference level if knock control enabled" VALUE 0x11645 RL_GRID_UBYTE 0 CM_0p01953125_0_V -0 4.98047 /end CHARACTERISTIC
/begin CHARACTERISTIC KRDWA "podtverzhdena | knock control difference current ignition angle to adaption map" VALUE 0x1164D RL_GRID_UBYTE 0 CM_0p75_0_GradKW -0 191.25 /end CHARACTERISTIC
/begin CHARACTERISTIC KRDWKLA "podtverzhdena | The SV-learning value for KR adaption after knocking detected" VALUE 0x1164E RL_GRID_UBYTE 0 CM_n0p75_0_gradKW -191.25 -0 /end CHARACTERISTIC
/begin CHARACTERISTIC KRDWSA "podtverzhdena | The FV-learning value for KR adation when wkra-wkr > KRDWA" VALUE 0x1164F RL_GRID_UBYTE 0 CM_0p75_0_GradKW -0 191.25 /end CHARACTERISTIC
/begin CHARACTERISTIC KRLMDY "podtverzhdena | Read if change of load range: always or only if dynamic active" VALUE 0x11650 RL_GRID_UBYTE 0 CM_IDENTITY -0 255 /end CHARACTERISTIC
/begin CHARACTERISTIC KRNMDY "podtverzhdena | Read if change of speed range: allways or only if dynamic active" VALUE 0x11651 RL_GRID_UBYTE 0 CM_IDENTITY -0 255 /end CHARACTERISTIC
/begin CHARACTERISTIC KSZA "podtverzhdena | number of knock sensor" VALUE 0x11652 RL_GRID_UBYTE 0 CM_IDENTITY -0 255 /end CHARACTERISTIC
/begin CHARACTERISTIC DYADS "podtverzhdena | add. retarding per cycle through adapt. dynamics" VALUE 0x11663 RL_GRID_UBYTE 0 CM_n0p75_0_gradKW -191.25 -0 /end CHARACTERISTIC
/begin CHARACTERISTIC DYAFVS "podtverzhdena | advance step for deactivation of dynamic response" VALUE 0x11664 RL_GRID_UBYTE 0 CM_0p75_0_GradKW -0 191.25 /end CHARACTERISTIC
/begin CHARACTERISTIC DYAVF "podtverzhdena | deactivation period for dynamics retardation" VALUE 0x11665 RL_GRID_UBYTE 0 CM_IDENTITY -0 255 /end CHARACTERISTIC
/begin CHARACTERISTIC FKELDYA "podtverzhdena | Corrective factor for knock detection threshold for adaptation of load dynamic" VALUE 0x11666 RL_GRID_UBYTE 0 CM_0p0625_0 -0 15.9375 /end CHARACTERISTIC
/begin CHARACTERISTIC PZWKRA "podtverzhdena | percentage frequency of ignition angle output by KC during dyn. adaption" VALUE 0x11667 RL_GRID_UBYTE 0 CM_0p390625_0 -0 99.6094 /end CHARACTERISTIC
/begin CHARACTERISTIC TMDYNA "podtverzhdena | engine temperature threshold to enable load dynamic adaptation" VALUE 0x11668 RL_GRID_UBYTE 0 CM_0p75_48_GradC -48 143.25 /end CHARACTERISTIC
/begin CHARACTERISTIC CWDKRNT "podtverzhdena | code word: kc-diagnosis integrator gradient" VALUE 0x11669 RL_GRID_UBYTE 0 CM_IDENTITY -0 255 /end CHARACTERISTIC
/begin CHARACTERISTIC CWDKROF "podtverzhdena | code word: kc-diagnosis reset value" VALUE 0x1166A RL_GRID_UBYTE 0 CM_IDENTITY -0 255 /end CHARACTERISTIC
/begin CHARACTERISTIC DKROKU "podtverzhdena | lower rpm-limit for determination of offset-compensation-value" VALUE 0x1166B RL_GRID_UBYTE 0 CM_40_0_Upm -0 10200 /end CHARACTERISTIC
/begin CHARACTERISTIC KRFHT "podtverzhdena | error frequency, test pulse" VALUE 0x1166C RL_GRID_UBYTE 0 CM_IDENTITY -0 255 /end CHARACTERISTIC
/begin CHARACTERISTIC UDKRGOFS "podtverzhdena | voltage threshold for DIA/KR basic offset amplifier" VALUE 0x1166D RL_GRID_UBYTE 0 CM_0p01953125_0_V -0 4.98047 /end CHARACTERISTIC
/begin CHARACTERISTIC CWDKRTP "podtverzhdena | code word: kc-diagnosis testpulse" VALUE 0x1166E RL_GRID_UBYTE 0 CM_IDENTITY -0 255 /end CHARACTERISTIC
/begin CHARACTERISTIC UDKRTP "podtverzhdena | integr.volt.thresh. f.diagn. knock eval.circ. test pulse" VALUE 0x1166F RL_GRID_UBYTE 0 CM_0p01953125_0_V -0 4.98047 /end CHARACTERISTIC
/begin CHARACTERISTIC NDSVL "podtverzhdena | full-load switch error detection / n threshold minimum" VALUE 0x11670 RL_GRID_UBYTE 0 CM_40_0_Upm -0 10200 /end CHARACTERISTIC
/begin CHARACTERISTIC QDPSLL "podtverzhdena | maximum rate of air flow for plausibility test of idle-speed switch" VALUE 0x11671 RL_GRID_UBYTE 0 CM_4_0_kgh -0 1020 /end CHARACTERISTIC
/begin CHARACTERISTIC RLDSVL "podtverzhdena | full-load switch error detection / load-signal threshold maximal" VALUE 0x11672 RL_GRID_UBYTE 0 CM_0p75_0 -0 191.25 /end CHARACTERISTIC
/begin CHARACTERISTIC KFABAK "podtverzhdena | dolya plenki dlya obogascheniya na razgone" MAP 0x193F3 RL_GRID_UBYTE 0 CM_0p00390625_0 -0 0.996094
 /begin AXIS_DESCR COM_AXIS NO_INPUT_QUANTITY CM_40_0_rpm 7 0 10200 AXIS_PTS_REF SNM07_WF /end AXIS_DESCR
 /begin AXIS_DESCR COM_AXIS NO_INPUT_QUANTITY CM_0p75_48_GradC 9 0 191.25 AXIS_PTS_REF STM09_WF /end AXIS_DESCR
/end CHARACTERISTIC
/begin CHARACTERISTIC KFAVAK "podtverzhdena | dolya plenki dlya obedneniya na sbrose" MAP 0x19432 RL_GRID_UBYTE 0 CM_0p00390625_0 -0 0.996094
 /begin AXIS_DESCR COM_AXIS NO_INPUT_QUANTITY CM_40_0_rpm 7 0 10200 AXIS_PTS_REF SNM07_WF /end AXIS_DESCR
 /begin AXIS_DESCR COM_AXIS NO_INPUT_QUANTITY CM_0p75_48_GradC 9 0 191.25 AXIS_PTS_REF STM09_WF /end AXIS_DESCR
/end CHARACTERISTIC
/begin CHARACTERISTIC KFBAKL "podtverzhdena | faktor obogascheniya na razgone, korotkaya i dlinnaya sostavlyayuschie" MAP 0x19471 RL_GRID_UBYTE 0 CM_0p0625_0 -0 15.9375
 /begin AXIS_DESCR COM_AXIS NO_INPUT_QUANTITY CM_40_0_rpm 7 0 10200 AXIS_PTS_REF SNM07_WF /end AXIS_DESCR
 /begin AXIS_DESCR COM_AXIS NO_INPUT_QUANTITY CM_0p75_48_GradC 9 0 191.25 AXIS_PTS_REF STM09_WF /end AXIS_DESCR
/end CHARACTERISTIC
/begin CHARACTERISTIC KFVAKL "podtverzhdena | faktor obedneniya na sbrose" MAP 0x194B0 RL_GRID_UBYTE 0 CM_0p0625_0 -0 15.9375
 /begin AXIS_DESCR COM_AXIS NO_INPUT_QUANTITY CM_40_0_rpm 7 0 10200 AXIS_PTS_REF SNM07_WF /end AXIS_DESCR
 /begin AXIS_DESCR COM_AXIS NO_INPUT_QUANTITY CM_0p75_48_GradC 9 0 191.25 AXIS_PTS_REF STM09_WF /end AXIS_DESCR
/end CHARACTERISTIC
/begin CHARACTERISTIC KABAKL_L "podtverzhdena | koefficient ubyvaniya obogascheniya na razgone, dlinnaya sostavlyayuschaya" CURVE 0x194EF RL_GRID_UBYTE 0 CM_0p00048828125_0 -0 0.124512
 /begin AXIS_DESCR COM_AXIS NO_INPUT_QUANTITY CM_0p75_48_GradC 9 0 191.25 AXIS_PTS_REF STM09_WF /end AXIS_DESCR
/end CHARACTERISTIC
/begin CHARACTERISTIC KVAKL_L "podtverzhdena | koefficient ubyvaniya obedneniya na sbrose, dlinnaya sostavlyayuschaya" CURVE 0x194F8 RL_GRID_UBYTE 0 CM_0p00048828125_0 -0 0.124512
 /begin AXIS_DESCR COM_AXIS NO_INPUT_QUANTITY CM_0p75_48_GradC 9 0 191.25 AXIS_PTS_REF STM09_WF /end AXIS_DESCR
/end CHARACTERISTIC
/begin CHARACTERISTIC KFMIOP "podtverzhdena |" MAP 0x14A10 RL_GRID_UWORD 0 CM_0p00152588_0_otopornogomoment -0 99.9985
 /begin AXIS_DESCR COM_AXIS NO_INPUT_QUANTITY CM_0p0234375_0 11 0 1535.98 AXIS_PTS_REF SRL11_OP /end AXIS_DESCR
 /begin AXIS_DESCR COM_AXIS NO_INPUT_QUANTITY CM_40_0_rpm 16 0 10200 AXIS_PTS_REF SNM16_OP /end AXIS_DESCR
/end CHARACTERISTIC
/begin CHARACTERISTIC SRL11OPUW "podtverzhdena | ta zhe os, chto u KFZWOP" CURVE 0x14B70 RL_GRID_UWORD 0 CM_0p0234375_0 -0 1535.98
 /begin AXIS_DESCR FIX_AXIS NO_INPUT_QUANTITY CM_IDENTITY 11 0 10 FIX_AXIS_PAR_DIST 0 1 11 /end AXIS_DESCR
/end CHARACTERISTIC
/begin CHARACTERISTIC KFMIRL "podtverzhdena | trebuemoe napolnenie iz trebuemogo momenta: oboroty x moment v % daet napolnenie v %" MAP 0x14BF8 RL_GRID_UWORD 0 CM_0p0234375_0_napolneniya -0 1535.98
 /begin AXIS_DESCR COM_AXIS NO_INPUT_QUANTITY CM_0p001525878906_0_momenta 12 0 99.9985 AXIS_PTS_REF AX_14BE0_X /end AXIS_DESCR
 /begin AXIS_DESCR COM_AXIS NO_INPUT_QUANTITY CM_0p25_0_obmin 16 0 16383.8 AXIS_PTS_REF AX_14BC0_Y /end AXIS_DESCR
/end CHARACTERISTIC
/begin CHARACTERISTIC KFMDS "podtverzhdena | moment mehanicheskih poter: oboroty x napolnenie" MAP 0x15142 RL_GRID_UWORD 0 CM_0p001525878906_0_otopornogomo -0 99.9985
 /begin AXIS_DESCR COM_AXIS NO_INPUT_QUANTITY CM_0p0234375_0_napolneniya 12 0 1535.98 AXIS_PTS_REF AX_1512A_X /end AXIS_DESCR
 /begin AXIS_DESCR COM_AXIS NO_INPUT_QUANTITY CM_0p25_0_obmin 10 0 16383.8 AXIS_PTS_REF AX_15116_Y /end AXIS_DESCR
/end CHARACTERISTIC
/begin CHARACTERISTIC MDIMX "podtverzhdena | verhniy predel indicirovannogo momenta" VALUE 0x105D9 RL_GRID_UBYTE 0 CM_0p390625_0 -0 99.6094 /end CHARACTERISTIC
/begin CHARACTERISTIC CWMDAPP "podtverzhdena | kodovoe slovo: kalibrovka bez momentnoy struktury" VALUE 0x10024 RL_GRID_UBYTE 0 CM_IDENTITY -0 255 /end CHARACTERISTIC
/begin CHARACTERISTIC ETALAM "podtverzhdena | KPD po sostavu smesi: moment v zavisimosti ot lyambdy" CURVE 0x1051F RL_GRID_UBYTE 0 CM_0p5_0 -0 127.5
 /begin AXIS_DESCR COM_AXIS NO_INPUT_QUANTITY CM_0p0078125_0_lambda 10 0 1.99219 AXIS_PTS_REF AX_10515_Y /end AXIS_DESCR
/end CHARACTERISTIC
/begin CHARACTERISTIC MDLF1 "podtverzhdena | moment na privod ventilyatora ohlazhdeniya 1" VALUE 0x10FB3 RL_GRID_UBYTE 0 CM_0p1960784314_0 -0 50 /end CHARACTERISTIC
/begin CHARACTERISTIC MDLF2 "podtverzhdena | to zhe, ventilyator 2" VALUE 0x10FB4 RL_GRID_UBYTE 0 CM_0p1960784314_0 -0 50 /end CHARACTERISTIC
/begin CHARACTERISTIC MDLFE1 "podtverzhdena | dobavka momenta pri vklyuchenii ventilyatora 1" VALUE 0x10FB5 RL_GRID_UBYTE 0 CM_0p1960784314_0 -0 50 /end CHARACTERISTIC
/begin CHARACTERISTIC MDLFE2 "podtverzhdena | dobavka momenta pri vklyuchenii ventilyatora 2" VALUE 0x10FB6 RL_GRID_UBYTE 0 CM_0p1960784314_0 -0 50 /end CHARACTERISTIC
/begin CHARACTERISTIC KSZWE "podtverzhdena | ugol zaschity ot detonacii" VALUE 0x10ED8 RL_GRID_UBYTE 0 CM_n0p75_0_KV -191.25 -0 /end CHARACTERISTIC
/begin CHARACTERISTIC CWSAWE "podtverzhdena | kodovoe slovo: otsechka topliva -- vozvrat" VALUE 0x10ED9 RL_GRID_UBYTE 0 CM_IDENTITY -0 255 /end CHARACTERISTIC
/begin CHARACTERISTIC DNSAH "podtverzhdena | delta oborotov otsechki, verhnyaya, otnositelno oborotov vozvrata" VALUE 0x10EDA RL_GRID_UBYTE 0 CM_40_0_obmin -0 10200 /end CHARACTERISTIC
/begin CHARACTERISTIC DNSAL "podtverzhdena | delta oborotov otsechki, nizhnyaya, otnositelno oborotov vozvrata" VALUE 0x10EDB RL_GRID_UBYTE 0 CM_40_0_obmin -0 10200 /end CHARACTERISTIC
/begin CHARACTERISTIC DNSATIP "podtverzhdena | podem oborotov otsechki pri tychke gazom" VALUE 0x10EDC RL_GRID_UBYTE 0 CM_40_0_obmin -0 10200 /end CHARACTERISTIC
/begin CHARACTERISTIC DNSLL "podtverzhdena | gisterezis vozvrata topliva na holostom" VALUE 0x10EDD RL_GRID_UBYTE 0 CM_40_0_obmin -0 10200 /end CHARACTERISTIC
/begin CHARACTERISTIC DNVSA "podtverzhdena | podem oborotov otsechki na maloy skorosti" VALUE 0x10EDE RL_GRID_UBYTE 0 CM_40_0_obmin -0 10200 /end CHARACTERISTIC
/begin CHARACTERISTIC DNWEELLS "podtverzhdena | delta vozvrata pri otkaze klapana HH" VALUE 0x10EDF RL_GRID_UBYTE 0 CM_40_0_obmin -0 10200 /end CHARACTERISTIC
/begin CHARACTERISTIC DNWEK "podtverzhdena | delta vozvrata pri vklyuchennom kondicionere" VALUE 0x10EE0 RL_GRID_UBYTE 0 CM_40_0_obmin -0 10200 /end CHARACTERISTIC
/begin CHARACTERISTIC DVSA "podtverzhdena | delta skorosti dlya podema oborotov otsechki" VALUE 0x10EE1 RL_GRID_UBYTE 0 CM_IDENTITY -0 255 /end CHARACTERISTIC
/begin CHARACTERISTIC ENSAKHG "podtverzhdena | razreshenie otsechki po peredache pri progreve katalizatora" VALUE 0x10EE2 RL_GRID_UBYTE 0 CM_IDENTITY -0 255 /end CHARACTERISTIC
/begin CHARACTERISTIC TKATSA "podtverzhdena | porog temperatury katalizatora dlya otsechki" VALUE 0x10EE3 RL_GRID_UBYTE 0 CM_5_n50_C 50 1325 /end CHARACTERISTIC
/begin CHARACTERISTIC VSAA "podtverzhdena | porog skorosti dlya podema oborotov otsechki" VALUE 0x10EE4 RL_GRID_UBYTE 0 CM_IDENTITY -0 255 /end CHARACTERISTIC
/begin CHARACTERISTIC FRKAP "podtverzhdena | globalnyy mnozhitel otnositelnoy massy topliva" VALUE 0x190CD RL_GRID_UBYTE 0 CM_0p0078125_0 -0 1.99219 /end CHARACTERISTIC
/begin CHARACTERISTIC TSTEAA "podtverzhdena | inhibit time after condition B_te (canister purge active)" VALUE 0x1893F RL_GRID_UBYTE 0 CM_0p1_0_s -0 25.5 /end CHARACTERISTIC
/begin CHARACTERISTIC TVLRHMN "podtverzhdena | lower limit for tv-correction" VALUE 0x18940 RL_GRID_UBYTE 0 CM_0p01_0_s -0 2.55 /end CHARACTERISTIC
/begin CHARACTERISTIC TVLRHMX "podtverzhdena | upper limit for tv-correction" VALUE 0x18941 RL_GRID_UBYTE 0 CM_0p01_0_s -0 2.55 /end CHARACTERISTIC
/begin CHARACTERISTIC ANZDYNSH "podtverzhdena | Amount of dynamic measurement for swinging check of sensor post cat" VALUE 0x18942 RL_GRID_UBYTE 0 CM_IDENTITY -0 255 /end CHARACTERISTIC
/begin CHARACTERISTIC CWDLSAHK "podtverzhdena | code word for test aging of O2-sensor post cat" VALUE 0x18943 RL_GRID_UBYTE 0 CM_IDENTITY -0 255 /end CHARACTERISTIC
/begin CHARACTERISTIC TABGSTG "podtverzhdena | threshold for exhaust temperature dynamic-measuring" VALUE 0x18944 RL_GRID_UBYTE 0 CM_5_50_GradC -50 1225 /end CHARACTERISTIC
/begin CHARACTERISTIC TFRMB "podtverzhdena | time delay for detect. the mean value of lamda control factor within thresholds" VALUE 0x18945 RL_GRID_UBYTE 0 CM_0p1_0_s -0 25.5 /end CHARACTERISTIC
/begin CHARACTERISTIC TLLASH "podtverzhdena | time delay for reset lamlash_w if lamsons_w is not lamlash_w" VALUE 0x18946 RL_GRID_UBYTE 0 CM_0p1_0_s -0 25.5 /end CHARACTERISTIC
/begin CHARACTERISTIC TSALASH "podtverzhdena | Time after fuel cut-off for the checking of the sensor downstream catalyst" VALUE 0x18947 RL_GRID_UBYTE 0 CM_0p1_0_s -0 25.5 /end CHARACTERISTIC
/begin CHARACTERISTIC TUSCHUB "podtverzhdena | Delay time for interference peaks at thrust detection of the rear oxygen sensor" VALUE 0x18948 RL_GRID_UBYTE 0 CM_0p1_0_s -0 25.5 /end CHARACTERISTIC
/begin CHARACTERISTIC TUSHSMIN "podtverzhdena | Minimum time for measuring the gradient for enable filter" VALUE 0x18949 RL_GRID_UBYTE 0 CM_0p1_0_s -0 25.5 /end CHARACTERISTIC
/begin CHARACTERISTIC TUSSA "podtverzhdena | delay time after crossing the control threshold downstream cat" VALUE 0x1894A RL_GRID_UBYTE 0 CM_0p1_0_s -0 25.5 /end CHARACTERISTIC
/begin CHARACTERISTIC USHLEAN "podtverzhdena | Threshold for lean volt. for reset dynamic measurement of sensor downstream cat." VALUE 0x1894B RL_GRID_UBYTE 0 CM_0p005215686275_0p2_V -0.2 1.13 /end CHARACTERISTIC
/begin CHARACTERISTIC USHRICH "podtverzhdena | Threshold for rich volt. for valid dyn. measurement of sensor downstream cat." VALUE 0x1894C RL_GRID_UBYTE 0 CM_0p005215686275_0p2_V -0.2 1.13 /end CHARACTERISTIC
/begin CHARACTERISTIC USHSTGMX "podtverzhdena | Value for maximum gradient for initial value of filter" VALUE 0x1894D RL_GRID_UBYTE 0 CM_0p52_0_mVms -0 132.6 /end CHARACTERISTIC
/begin CHARACTERISTIC USHSTSOLL "podtverzhdena | Threshold for permitted gradient of the sensor voltage downstream catalyst" VALUE 0x1894E RL_GRID_UBYTE 0 CM_0p52_0_mVms -0 132.6 /end CHARACTERISTIC
/begin CHARACTERISTIC USSCHUB "podtverzhdena | Threshold for sensor voltage downstream catalyst after fuel cut-off" VALUE 0x1894F RL_GRID_UBYTE 0 CM_0p005215686275_0p2_V -0.2 1.13 /end CHARACTERISTIC
/begin CHARACTERISTIC CWGGLSV "podtverzhdena | Code word for Ri-measurement for O2sensor pre cat (not fully heated)" VALUE 0x18950 RL_GRID_UBYTE 0 CM_IDENTITY -0 255 /end CHARACTERISTIC
/begin CHARACTERISTIC ADKATNF "podtverzhdena | scaling factor for signal amplitude of the sensor resp. of the catalyst stress" VALUE 0x18951 RL_GRID_UBYTE 0 CM_0p09362_0_1V -0 23.8731 /end CHARACTERISTIC
/begin CHARACTERISTIC AHKATMN "podtverzhdena | threshold value catalyst good, AHKAT < AHKATMN" VALUE 0x18952 RL_GRID_UBYTE 0 CM_0p00390625_0 -0 0.996094 /end CHARACTERISTIC
/begin CHARACTERISTIC AHKATS "podtverzhdena | threshold value for sum AHKAT,AHKAT2 (stereo)" VALUE 0x18953 RL_GRID_UBYTE 0 CM_0p0078125_0 -0 1.99219 /end CHARACTERISTIC
/begin CHARACTERISTIC AHKATSB "podtverzhdena | threshold value for error of adding range (stereo)" VALUE 0x18954 RL_GRID_UBYTE 0 CM_0p00390625_0 -0 0.996094 /end CHARACTERISTIC
/begin CHARACTERISTIC AHKTMXT "podtverzhdena | threshold value catalyst defect at tester's request" VALUE 0x18955 RL_GRID_UBYTE 0 CM_0p00390625_0 -0 0.996094 /end CHARACTERISTIC
/begin CHARACTERISTIC APEKTDX "podtverzhdena | max. number of tests with error result" VALUE 0x18956 RL_GRID_UBYTE 0 CM_IDENTITY -0 255 /end CHARACTERISTIC
/begin CHARACTERISTIC AVKATFS "podtverzhdena | setting value for AVKATF in case of powerfail" VALUE 0x18957 RL_GRID_UBYTE 0 CM_0p00390625_0 -0 0.996094 /end CHARACTERISTIC
/begin CHARACTERISTIC CDKATLK "podtverzhdena | code word for B_lrka active" VALUE 0x18958 RL_GRID_UBYTE 0 CM_IDENTITY -0 255 /end CHARACTERISTIC
/begin CHARACTERISTIC DKATCW "podtverzhdena | single run resp. initialization of the DKAT function" VALUE 0x18959 RL_GRID_UBYTE 0 CM_IDENTITY -0 255 /end CHARACTERISTIC
/begin CHARACTERISTIC DRLKTDP "podtverzhdena | Threshold for engine load change" VALUE 0x1895A RL_GRID_UBYTE 0 CM_0p75_0 -0 191.25 /end CHARACTERISTIC
/begin CHARACTERISTIC DRLKTDPT "podtverzhdena | Threshold for engine load change at tester's request" VALUE 0x1895B RL_GRID_UBYTE 0 CM_0p75_0 -0 191.25 /end CHARACTERISTIC
/begin CHARACTERISTIC FALRKTD "podtverzhdena | amplification factor for amplitude of lambda controller" VALUE 0x1895C RL_GRID_UBYTE 0 CM_0p03125_0 -0 7.96875 /end CHARACTERISTIC
/begin CHARACTERISTIC FALRKTT "podtverzhdena | amplification factor for amplitude of lambda controller at tester mode" VALUE 0x1895D RL_GRID_UBYTE 0 CM_0p03125_0 -0 7.96875 /end CHARACTERISTIC
/begin CHARACTERISTIC KATBFMNT "podtverzhdena | threshold value for small catalyst stress at tester's request" VALUE 0x1895E RL_GRID_UBYTE 0 CM_0p00390625_0 -0 0.996094 /end CHARACTERISTIC
/begin CHARACTERISTIC KATBFN "podtverzhdena | standardized mean value of the sensor amplitude" VALUE 0x1895F RL_GRID_UBYTE 0 CM_0p00390625_0 -0 0.996094 /end CHARACTERISTIC
/begin CHARACTERISTIC KATBFNM "podtverzhdena | scaling factor multiplicative for catalyst stress" VALUE 0x18960 RL_GRID_UBYTE 0 CM_0p005215686275_0_V -0 1.33 /end CHARACTERISTIC
/begin CHARACTERISTIC KATBFNP "podtverzhdena | scaling factor additive for catalyst stress" VALUE 0x18961 RL_GRID_UBYTE 0 CM_0p005215686275_0_V -0 1.33 /end CHARACTERISTIC
/begin CHARACTERISTIC KATBFSX "podtverzhdena | maximum integrator value for stop condition" VALUE 0x18962 RL_GRID_UBYTE 0 CM_0p0078125_0 -0 1.99219 /end CHARACTERISTIC
/begin CHARACTERISTIC KATBSG "podtverzhdena | catalyst storage value for catalyst stress" VALUE 0x18963 RL_GRID_UBYTE 0 CM_0p8695652174_0_mg -0 221.739 /end CHARACTERISTIC
/begin CHARACTERISTIC KATBSH "podtverzhdena | offset for lambda control slightly in the rich area" VALUE 0x18964 RL_GRID_UBYTE 0 CM_0p8695652174_0_mgs -0 221.739 /end CHARACTERISTIC
/begin CHARACTERISTIC KATBSHG "podtverzhdena | limitation factor of model lambda-offset due to sensor mean values" VALUE 0x18965 RL_GRID_UBYTE 0 CM_0p00390625_0 -0 0.996094 /end CHARACTERISTIC
/begin CHARACTERISTIC NDKTSOT "podtverzhdena | upper engine speed limit for function request" VALUE 0x18966 RL_GRID_UBYTE 0 CM_40_0_Upm -0 10200 /end CHARACTERISTIC
/begin CHARACTERISTIC NDKTSUT "podtverzhdena | lower engine speed limit for function request" VALUE 0x18967 RL_GRID_UBYTE 0 CM_40_0_Upm -0 10200 /end CHARACTERISTIC
/begin CHARACTERISTIC NKTDX "podtverzhdena | Maximum speed for DKAT calculation" VALUE 0x18968 RL_GRID_UBYTE 0 CM_40_0_Upm -0 10200 /end CHARACTERISTIC
/begin CHARACTERISTIC RLDKTOT "podtverzhdena | upper load limit for function request" VALUE 0x18969 RL_GRID_UBYTE 0 CM_0p75_0 -0 191.25 /end CHARACTERISTIC
/begin CHARACTERISTIC RLDKTUT "podtverzhdena | lower load limit for function request" VALUE 0x1896A RL_GRID_UBYTE 0 CM_0p75_0 -0 191.25 /end CHARACTERISTIC
/begin CHARACTERISTIC TMAXKAT "podtverzhdena | maximum catalyst temp. for active diagnosis" VALUE 0x1896B RL_GRID_UBYTE 0 CM_5_50_GradC -50 1225 /end CHARACTERISTIC
/begin CHARACTERISTIC TMINKAT "podtverzhdena | minimum catalyst temperature for monitoring" VALUE 0x1896C RL_GRID_UBYTE 0 CM_5_50_GradC -50 1225 /end CHARACTERISTIC
/begin CHARACTERISTIC TMNKATT "podtverzhdena | minimum catalyst temperature for monitoring during tester mode" VALUE 0x1896D RL_GRID_UBYTE 0 CM_5_50_GradC -50 1225 /end CHARACTERISTIC
/begin CHARACTERISTIC TMSUKTD "podtverzhdena | minimum engine start temp. for monitoring" VALUE 0x1896E RL_GRID_UBYTE 0 CM_0p75_48_GradC -48 143.25 /end CHARACTERISTIC
/begin CHARACTERISTIC TWDKATST "podtverzhdena | waiting time after stop condition for filter and integrator" VALUE 0x1896F RL_GRID_UBYTE 0 CM_0p05_0_s -0 12.75 /end CHARACTERISTIC
/begin CHARACTERISTIC TWKTDLP "podtverzhdena | delay time after parameter switch over in lambda control" VALUE 0x18970 RL_GRID_UBYTE 0 CM_0p05_0_s -0 12.75 /end CHARACTERISTIC
/begin CHARACTERISTIC ZDKATAD "podtverzhdena | filter time constant of the differentiator for signal amplitude" VALUE 0x18971 RL_GRID_UBYTE 0 CM_IDENTITY -0 255 /end CHARACTERISTIC
/begin CHARACTERISTIC ZDKATAF "podtverzhdena | time constant 'absolute value filter' for signal amplitude" VALUE 0x18972 RL_GRID_UBYTE 0 CM_IDENTITY -0 255 /end CHARACTERISTIC
/begin CHARACTERISTIC ZDKATSH "podtverzhdena | time constant low pass filter, mean sensor values" VALUE 0x18973 RL_GRID_UBYTE 0 CM_IDENTITY -0 255 /end CHARACTERISTIC
/begin CHARACTERISTIC ZDKTBD "podtverzhdena | time constant of the differentiator for RF-alternating component" VALUE 0x18974 RL_GRID_UBYTE 0 CM_IDENTITY -0 255 /end CHARACTERISTIC
/begin CHARACTERISTIC ZDKTBF "podtverzhdena | time constant for gas mixing procedure in front of catalyst" VALUE 0x18975 RL_GRID_UBYTE 0 CM_IDENTITY -0 255 /end CHARACTERISTIC
/begin CHARACTERISTIC ZKTDRL "podtverzhdena | time constant low pass filter, engine load" VALUE 0x18976 RL_GRID_UBYTE 0 CM_IDENTITY -0 255 /end CHARACTERISTIC
/begin CHARACTERISTIC PHLSNVMN "podtverzhdena | minimal normalised heating-power-diagnosis sensor pre catalyst" VALUE 0x18977 RL_GRID_UBYTE 0 CM_0p01_0 -0 2.55 /end CHARACTERISTIC
/begin CHARACTERISTIC TABGMSVU "podtverzhdena | temp. threshold from exhaust temp. modell for diagn. sensor upstream" VALUE 0x18978 RL_GRID_UBYTE 0 CM_5_50_GradC -50 1225 /end CHARACTERISTIC
/begin CHARACTERISTIC TMASO "podtverzhdena | time after fuel cut off for commen open sensor ground" VALUE 0x18979 RL_GRID_UBYTE 0 CM_0p1_0_s -0 25.5 /end CHARACTERISTIC
/begin CHARACTERISTIC TMNEB "podtverzhdena | Engine temprerature threshold for measurement of sensor shunt pre cat" VALUE 0x1897A RL_GRID_UBYTE 0 CM_0p75_48_GradC -48 143.25 /end CHARACTERISTIC
/begin CHARACTERISTIC TMSV "podtverzhdena | engine temp. threshold for recognition cold start for measuring sensor upstream" VALUE 0x1897B RL_GRID_UBYTE 0 CM_0p75_48_GradC -48 143.25 /end CHARACTERISTIC
/begin CHARACTERISTIC TMSVA "podtverzhdena | threshold for engine switch-off temp. for measuring cooling sensor upstream cat" VALUE 0x1897C RL_GRID_UBYTE 0 CM_0p75_48_GradC -48 143.25 /end CHARACTERISTIC
/begin CHARACTERISTIC TRSA "podtverzhdena | monitoring time closed-loop control (upstream CAT) -> sensor off" VALUE 0x1897D RL_GRID_UBYTE 0 CM_0p1_0_s -0 25.5 /end CHARACTERISTIC
/begin CHARACTERISTIC TUSEINV "podtverzhdena | Delay time for condition Lambda sensor ready bit" VALUE 0x1897E RL_GRID_UBYTE 0 CM_IDENTITY -0 255 /end CHARACTERISTIC
/begin CHARACTERISTIC PHLSNHMN "podtverzhdena | Heating power for adequate sensor heating" VALUE 0x1897F RL_GRID_UBYTE 0 CM_0p01_0 -0 2.55 /end CHARACTERISTIC
/begin CHARACTERISTIC THHA "podtverzhdena | off time to reduce heater power of oxygen sensor downstream cat at 13Volt" VALUE 0x18980 RL_GRID_UBYTE 0 CM_0p01_0p05_s -0.05 2.5 /end CHARACTERISTIC
/begin CHARACTERISTIC THHA2 "podtverzhdena | off time to reduce heater power of oxygen sensor2 downstream cat at 13Volt" VALUE 0x18981 RL_GRID_UBYTE 0 CM_0p01_0p05_s -0.05 2.5 /end CHARACTERISTIC
/begin CHARACTERISTIC THHAWU "podtverzhdena | Switch OFF time during power reduction of sensor heating post cat" VALUE 0x18982 RL_GRID_UBYTE 0 CM_0p01_0_s -0 2.55 /end CHARACTERISTIC
/begin CHARACTERISTIC THSHA "podtverzhdena | Verz gerungszeit f r Sonde ausreichend beheizt" VALUE 0x18983 RL_GRID_UBYTE 0 CM_0p1_0_s -0 25.5 /end CHARACTERISTIC
/begin CHARACTERISTIC THVA "podtverzhdena | off time to reduce heater power of oxygen sensor upstream cat at 13 Volt" VALUE 0x18984 RL_GRID_UBYTE 0 CM_0p01_0p05_s -0.05 2.5 /end CHARACTERISTIC
/begin CHARACTERISTIC THVA2 "podtverzhdena | off time to reduce heater power of oxygen sensor2 upstream cat at 13 Volt" VALUE 0x18985 RL_GRID_UBYTE 0 CM_0p01_0p05_s -0.05 2.5 /end CHARACTERISTIC
/begin CHARACTERISTIC THVAWU "podtverzhdena | Switch OFF time during power reduction of sensor heating pre cat" VALUE 0x18986 RL_GRID_UBYTE 0 CM_0p01_0_s -0 2.55 /end CHARACTERISTIC
/begin CHARACTERISTIC TMOHSMN "podtverzhdena | Minimum engine temperature for lambda sensor heating" VALUE 0x18987 RL_GRID_UBYTE 0 CM_0p75_48_GradC -48 143.25 /end CHARACTERISTIC
/begin CHARACTERISTIC TREHS "podtverzhdena | time for restart sensor heating" VALUE 0x18988 RL_GRID_UBYTE 0 CM_0p1_0_s -0 25.5 /end CHARACTERISTIC
/begin CHARACTERISTIC TVHSH "podtverzhdena | delay time for sensor heater downstream cut" VALUE 0x18989 RL_GRID_UBYTE 0 CM_0p1_0_s -0 25.5 /end CHARACTERISTIC
/begin CHARACTERISTIC TVHSV "podtverzhdena | delay time for sensor heater upstream cut" VALUE 0x1898A RL_GRID_UBYTE 0 CM_0p1_0_s -0 25.5 /end CHARACTERISTIC
/begin CHARACTERISTIC TVHSVMX "podtverzhdena | delay time for maximum sensor heater upstream cut" VALUE 0x1898B RL_GRID_UBYTE 0 CM_0p1_0_s -0 25.5 /end CHARACTERISTIC
/begin CHARACTERISTIC UBHS "podtverzhdena | battery voltage threshold for switching off oxygen sensor heater" VALUE 0x1898C RL_GRID_UBYTE 0 CM_0p0704_0_V -0 17.952 /end CHARACTERISTIC
/begin CHARACTERISTIC UHSN "podtverzhdena | Nominal battery voltage for lambda sensor heating" VALUE 0x1898D RL_GRID_UBYTE 0 CM_0p0704_0_V -0 17.952 /end CHARACTERISTIC
/begin CHARACTERISTIC TMTE "podtverzhdena | engine-temperature threshold for canister purge" VALUE 0x1976C RL_GRID_UBYTE 0 CM_0p75_48_GradC -48 143.25 /end CHARACTERISTIC
/begin CHARACTERISTIC FRHB "podtverzhdena | limit for lambda controller to reset Bit 'High HC-canister charge'" VALUE 0x197AB RL_GRID_UBYTE 0 CM_0p0078125_0 -0 1.99219 /end CHARACTERISTIC
/begin CHARACTERISTIC FTEADAB "podtverzhdena | Canister charge threshold for interruption of the purge phase" VALUE 0x197AC RL_GRID_UBYTE 0 CM_0p5_0 -0 127.5 /end CHARACTERISTIC
/begin CHARACTERISTIC FTEADMX "podtverzhdena | Maximum value of the canister charge (ftead)" VALUE 0x197AD RL_GRID_UBYTE 0 CM_0p5_0 -0 127.5 /end CHARACTERISTIC
/begin CHARACTERISTIC FTEFHB "podtverzhdena | Limit for flow rate of purge system to detect high concentration" VALUE 0x197AE RL_GRID_UBYTE 0 CM_0p001953125_0 -0 0.498047 /end CHARACTERISTIC
/begin CHARACTERISTIC FTEHB "podtverzhdena | Limit for purge factor to detect high concentration" VALUE 0x197AF RL_GRID_UBYTE 0 CM_0p5_0 -0 127.5 /end CHARACTERISTIC
/begin CHARACTERISTIC FUMRBRK "podtverzhdena | factor calculation of canister charge (ftead) from HC-concentration" VALUE 0x197BB RL_GRID_UBYTE 0 CM_0p125_0 -0 31.875 /end CHARACTERISTIC
/begin CHARACTERISTIC KHCTEMN "podtverzhdena | minimum value of HC concentration in purge flow" VALUE 0x198AB RL_GRID_UBYTE 0 CM_0p015625_0 -0 3.98438 /end CHARACTERISTIC
/begin CHARACTERISTIC KHCTEMX "podtverzhdena | maximum value of HC concentration in purge flow" VALUE 0x198AC RL_GRID_UBYTE 0 CM_0p015625_0 -0 3.98438 /end CHARACTERISTIC
/begin CHARACTERISTIC ZBTEML "podtverzhdena | integration speed for canister charge adaptation" VALUE 0x198AD RL_GRID_UBYTE 0 CM_0p02392578125_0_1s -0 6.10107 /end CHARACTERISTIC
/begin CHARACTERISTIC DNDTEO "podtverzhdena | upper Nsoll-Nist threshold for abortion diagnosis CPV" VALUE 0x19912 RL_GRID_UBYTE 0 CM_10_0_Umin -0 2550 /end CHARACTERISTIC
/begin CHARACTERISTIC DNDTEU "podtverzhdena | lower Nsoll-Nist threshold for abortion diagnosis CPV" VALUE 0x19913 RL_GRID_UBYTE 0 CM_10_0_Umin -0 2550 /end CHARACTERISTIC
/begin CHARACTERISTIC ETAZWTEN "podtverzhdena | minimum threschold of ignition angle efficiency for diagnosis of PCV" VALUE 0x19914 RL_GRID_UBYTE 0 CM_0p5_0 -0 127.5 /end CHARACTERISTIC
/begin CHARACTERISTIC FKADPMN "podtverzhdena | minimum feul part via CPV for passive O.K. testing." VALUE 0x19915 RL_GRID_UBYTE 0 CM_0p0078125_0 -0 1.99219 /end CHARACTERISTIC
/begin CHARACTERISTIC IMSDTEVA "podtverzhdena | thershold for integral of purge mass flow after a long purge stop" VALUE 0x19916 RL_GRID_UBYTE 0 CM_0p0444_0_g -0 11.322 /end CHARACTERISTIC
/begin CHARACTERISTIC TC6TECI "podtverzhdena | mode 6 code word for O.K. check of CPV form DLDP" VALUE 0x1996E RL_GRID_UBYTE 0 CM_IDENTITY -0 255 /end CHARACTERISTIC
/begin CHARACTERISTIC TC6TECL "podtverzhdena | mode 6 code word for O.K. check of CPV from air-test" VALUE 0x1996F RL_GRID_UBYTE 0 CM_IDENTITY -0 255 /end CHARACTERISTIC
/begin CHARACTERISTIC TC6TECNL "podtverzhdena | mode 6 code word for NOT O.K. check of CPV from air-test" VALUE 0x19970 RL_GRID_UBYTE 0 CM_IDENTITY -0 255 /end CHARACTERISTIC
/begin CHARACTERISTIC TC6TECP "podtverzhdena | mode 6 code word for passive O.K. check of CPV" VALUE 0x19971 RL_GRID_UBYTE 0 CM_IDENTITY -0 255 /end CHARACTERISTIC
/begin CHARACTERISTIC TC6TECRF "podtverzhdena | mode 6 code word for O.K. check of CPV from FR-deviation dircetion rich" VALUE 0x19972 RL_GRID_UBYTE 0 CM_IDENTITY -0 255 /end CHARACTERISTIC
/begin CHARACTERISTIC TC6TECRM "podtverzhdena | mode 6 code word for O.K. check of CPV from FR-deviation dircetion lean" VALUE 0x19973 RL_GRID_UBYTE 0 CM_IDENTITY -0 255 /end CHARACTERISTIC
/begin CHARACTERISTIC TC6TECT "podtverzhdena | mode 6 code word for O.K. check of CPV form DLDP" VALUE 0x19974 RL_GRID_UBYTE 0 CM_IDENTITY -0 255 /end CHARACTERISTIC
/begin CHARACTERISTIC TTEVAZ "podtverzhdena | duration of stay for CPV opening with not successful frm" VALUE 0x19978 RL_GRID_UBYTE 0 CM_0p1_0_s -0 25.5 /end CHARACTERISTIC
/begin CHARACTERISTIC TVDTEB "podtverzhdena | delay time for statement TEV o.k./defect in diagnosis DTEV" VALUE 0x1997A RL_GRID_UBYTE 0 CM_0p1_0_s -0 25.5 /end CHARACTERISTIC
/begin CHARACTERISTIC TVDTEE "podtverzhdena | Duration as of PCV open for checking of DTEV" VALUE 0x1997B RL_GRID_UBYTE 0 CM_0p1_0_s -0 25.5 /end CHARACTERISTIC
/begin CHARACTERISTIC TVDTEVP "podtverzhdena | delay time for setting of the flip flop 'Passive Diagnosis CPV o.k.'" VALUE 0x1997D RL_GRID_UBYTE 0 CM_0p1_0_s -0 25.5 /end CHARACTERISTIC
/begin CHARACTERISTIC TVDTEVZ "podtverzhdena | delay time for closing CPV for active DTEV" VALUE 0x1997F RL_GRID_UBYTE 0 CM_0p1_0_s -0 25.5 /end CHARACTERISTIC
/begin CHARACTERISTIC CURVE_19509 "adres podtverzhden | curve, input 0x90AC; length taken from the start of the next curve" CURVE 0x19509 RL_GRID_UBYTE 0 CM_0p0078125_0 -0 1.99219
 /begin AXIS_DESCR FIX_AXIS NO_INPUT_QUANTITY CM_IDENTITY 12 0 11 FIX_AXIS_PAR_DIST 0 1 12 /end AXIS_DESCR
/end CHARACTERISTIC
/begin CHARACTERISTIC CURVE_19515 "adres podtverzhden | porog ugla drosselya dlya vklyucheniya adaptacii, po oborotam (CTP7: 'Porog po drosselyu dlya vkl. adaptacii', 50.8..60.2 %). CHitaetsya v toy zhe procedure, chto i porog temperat" CURVE 0x19520 RL_GRID_UBYTE 0 CM_0p390625_0 -0 99.6094
 /begin AXIS_DESCR COM_AXIS NO_INPUT_QUANTITY CM_40_0_rpm 10 0 10200 AXIS_PTS_REF AX_19516_Y /end AXIS_DESCR
/end CHARACTERISTIC
/begin CHARACTERISTIC LIMTKOA "podtverzhdena | Time threshold to switch off the AC-compressor indefinitly" VALUE 0x119D8 RL_GRID_UBYTE 0 CM_0p2_0_s -0 51 /end CHARACTERISTIC
/begin CHARACTERISTIC TKOAMNN "podtverzhdena | minimum shutdown time for air-conditioning compressor" CURVE 0x119E2 RL_GRID_UBYTE 0 CM_0p2_0_s -0 51
 /begin AXIS_DESCR COM_AXIS NO_INPUT_QUANTITY CM_40_0_rpm 8 0 10200 AXIS_PTS_REF SNM08_KO /end AXIS_DESCR
/end CHARACTERISTIC
/begin CHARACTERISTIC TKOAMXN "podtverzhdena | maximum shutdown time for air-conditioning compressor" CURVE 0x119EA RL_GRID_UBYTE 0 CM_0p2_0_s -0 51
 /begin AXIS_DESCR COM_AXIS NO_INPUT_QUANTITY CM_40_0_rpm 8 0 10200 AXIS_PTS_REF SNM08_KO /end AXIS_DESCR
/end CHARACTERISTIC
/begin CHARACTERISTIC TKOEMNN "podtverzhdena | minimal time of air-condition compressor beeing swiched on" CURVE 0x119F2 RL_GRID_UBYTE 0 CM_0p2_0_s -0 51
 /begin AXIS_DESCR COM_AXIS NO_INPUT_QUANTITY CM_40_0_rpm 8 0 10200 AXIS_PTS_REF SNM08_KO /end AXIS_DESCR
/end CHARACTERISTIC
/begin CHARACTERISTIC TMKOAO "podtverzhdena | Upper coolant temperature for swichting off the AC-compressor" VALUE 0x119FA RL_GRID_UBYTE 0 CM_0p75_48_GradC -48 143.25 /end CHARACTERISTIC
/begin CHARACTERISTIC TMKOAU "podtverzhdena | Lower coolant temperature for swichting off the AC-compressor" VALUE 0x119FB RL_GRID_UBYTE 0 CM_0p75_48_GradC -48 143.25 /end CHARACTERISTIC
/begin CHARACTERISTIC TNACMX "podtverzhdena | maximal time for engine speed nac after S_ko = 0" VALUE 0x119FC RL_GRID_UBYTE 0 CM_0p2_0_s -0 51 /end CHARACTERISTIC
/begin CHARACTERISTIC TVKOA "podtverzhdena | delay time for compressor OFF" VALUE 0x119FD RL_GRID_UBYTE 0 CM_0p02_0_s -0 5.1 /end CHARACTERISTIC
/begin CHARACTERISTIC TVKOE "podtverzhdena | delay time for compressor ON" VALUE 0x119FE RL_GRID_UBYTE 0 CM_0p02_0_s -0 5.1 /end CHARACTERISTIC
/begin CHARACTERISTIC VKOAO "podtverzhdena | Upper vehicle speed threshold to inhibit the AC-compressor" VALUE 0x119FF RL_GRID_UBYTE 0 CM_1p25_0_kmh -0 318.75 /end CHARACTERISTIC
/begin CHARACTERISTIC VKOAU "podtverzhdena | low vehicle speed threshold to inhibit the AC-compressor" VALUE 0x11A00 RL_GRID_UBYTE 0 CM_1p25_0_kmh -0 318.75 /end CHARACTERISTIC
/begin CHARACTERISTIC WDKKOAN_0 "podtverzhdena | wdk threshold for A/C compressor cut off, variant 0" CURVE 0x11A01 RL_GRID_UBYTE 0 CM_0p390625_0 -0 99.6094
 /begin AXIS_DESCR COM_AXIS NO_INPUT_QUANTITY CM_40_0_rpm 8 0 10200 AXIS_PTS_REF SNM08_KO /end AXIS_DESCR
/end CHARACTERISTIC
/begin CHARACTERISTIC WDKKOAN_1 "podtverzhdena | wdk threshold for A/C compressor cut off, variant 1" CURVE 0x11A09 RL_GRID_UBYTE 0 CM_0p390625_0 -0 99.6094
 /begin AXIS_DESCR COM_AXIS NO_INPUT_QUANTITY CM_40_0_rpm 8 0 10200 AXIS_PTS_REF SNM08_KO /end AXIS_DESCR
/end CHARACTERISTIC
/begin CHARACTERISTIC WDKKOEN "podtverzhdena | wdk threshold for air-condition compressor authorisation" CURVE 0x11A11 RL_GRID_UBYTE 0 CM_0p390625_0 -0 99.6094
 /begin AXIS_DESCR COM_AXIS NO_INPUT_QUANTITY CM_40_0_rpm 8 0 10200 AXIS_PTS_REF SNM08_KO /end AXIS_DESCR
/end CHARACTERISTIC
/begin CHARACTERISTIC KUMSRL "podtverzhdena | konstanta perescheta rashoda vozduha v otnositelnoe napolnenie" VALUE 0x1157C RL_GRID_UBYTE 0 CM_7p8125En06_0_kgh1min -0 0.00199219 /end CHARACTERISTIC
/begin CHARACTERISTIC CWFKMSDKA "podtverzhdena | kodovoe slovo: adaptaciya rashoda vklyuchena" VALUE 0x1157A RL_GRID_UBYTE 0 CM_IDENTITY -0 255 /end CHARACTERISTIC
/begin CHARACTERISTIC KIMSALL "podtverzhdena | popravka integratora vozduha holostogo hoda" VALUE 0x1157B RL_GRID_UBYTE 0 CM_0p00078125_0 -0 0.199219 /end CHARACTERISTIC
/begin CHARACTERISTIC MSALLMN "podtverzhdena | nizhniy predel adaptacii vozduha HH" VALUE 0x1157D RL_GRID_UBYTE 0 CM_0p1_0_kgh -0 25.5 /end CHARACTERISTIC
/begin CHARACTERISTIC MSALLMX "podtverzhdena | verhniy predel adaptacii vozduha HH" VALUE 0x1157E RL_GRID_UBYTE 0 CM_0p1_0_kgh -0 25.5 /end CHARACTERISTIC
/begin CHARACTERISTIC MSLG "podtverzhdena | rashod summarnogo podsosa (utechki) vozduha" VALUE 0x1157F RL_GRID_UBYTE 0 CM_0p1_0_kgh -0 25.5 /end CHARACTERISTIC
/begin CHARACTERISTIC RLNOT "podtverzhdena | Podmena napolneniya pri otkaze. Imenno etot mehanizm sposoben derzhat nevernoe napolnenie skolko ugodno dolgo, v otlichie ot oshibki prognoza, zhivuschey 2-5 ciklov." CURVE 0x11587 RL_GRID_UBYTE 0 CM_0p75_0 -0 191.25
 /begin AXIS_DESCR COM_AXIS NO_INPUT_QUANTITY CM_40_0_rpm 6 0 10200 AXIS_PTS_REF AX_11581_Y /end AXIS_DESCR
/end CHARACTERISTIC
/begin CHARACTERISTIC KLAF "podtverzhdena | funkciya istecheniya Sen-Venana dlya drosselya" CURVE 0x15754 RL_GRID_UWORD 0 CM_IDENTITY -0 65535
 /begin AXIS_DESCR FIX_AXIS NO_INPUT_QUANTITY CM_IDENTITY 501 0 500 FIX_AXIS_PAR_DIST 0 1 501 /end AXIS_DESCR
/end CHARACTERISTIC
/begin CHARACTERISTIC KFMSNWDK "podtverzhdena | bazovyy rashod cherez drossel, vhod wdkba (ugol) i pspvdk (otnoshenie davleniy)" MAP 0x15694 RL_GRID_UWORD 0 CM_0p1_0_kgh -0 6553.5
 /begin AXIS_DESCR COM_AXIS NO_INPUT_QUANTITY CM_IDENTITY 6 0 65535 AXIS_PTS_REF AX_15688_X /end AXIS_DESCR
 /begin AXIS_DESCR COM_AXIS NO_INPUT_QUANTITY CM_IDENTITY 16 0 65535 AXIS_PTS_REF AX_15668_Y /end AXIS_DESCR
/end CHARACTERISTIC
/begin CHARACTERISTIC WDKUGDN "podtverzhdena | ugol drosselya, pri kotorom dostigaetsya 95 % maksimalno vozmozhnogo napolneniya" CURVE 0x15B40 RL_GRID_UWORD 0 CM_0p001525878906_0_ugladrossely -0 99.9985
 /begin AXIS_DESCR FIX_AXIS NO_INPUT_QUANTITY CM_IDENTITY 12 0 11 FIX_AXIS_PAR_DIST 0 1 12 /end AXIS_DESCR
/end CHARACTERISTIC
/begin CHARACTERISTIC KFRLW "podtverzhdena | rezervnyy signal napolneniya ot ugla drosselya i oborotov (auxiliary load signal). Imenno na nego EBU pereklyuchaetsya, kogda osnovnoy signal po DMRV priznan negodnym -- tot samyy seco" MAP 0x1ACAA RL_GRID_UWORD 0 CM_0p0234375_0_napolneniya -0 1535.98
 /begin AXIS_DESCR COM_AXIS NO_INPUT_QUANTITY CM_0p25_0_obmin 12 0 16383.8 AXIS_PTS_REF AX_1AC92_X /end AXIS_DESCR
 /begin AXIS_DESCR COM_AXIS NO_INPUT_QUANTITY CM_0p01219512195_0_ugoldrosselya 12 0 799.207 AXIS_PTS_REF AX_1AC7A_Y /end AXIS_DESCR
/end CHARACTERISTIC
/begin CHARACTERISTIC KFPU "podtverzhdena | korrekciya pulsaciy potoka, oboroty x ugol drosselya" MAP 0x114A3 RL_GRID_UBYTE 0 CM_0p0078125_0 -0 1.99219
 /begin AXIS_DESCR FIX_AXIS NO_INPUT_QUANTITY CM_IDENTITY 14 0 13 FIX_AXIS_PAR_DIST 0 1 14 /end AXIS_DESCR
 /begin AXIS_DESCR FIX_AXIS NO_INPUT_QUANTITY CM_IDENTITY 14 0 13 FIX_AXIS_PAR_DIST 0 1 14 /end AXIS_DESCR
/end CHARACTERISTIC
/begin CHARACTERISTIC KFPUSU "podtverzhdena | to zhe pri izmenyaemoy geometrii vpuska (rezhim 1)" MAP 0x111FD RL_GRID_UBYTE 0 CM_0p0078125_0 -0 1.99219
 /begin AXIS_DESCR FIX_AXIS NO_INPUT_QUANTITY CM_IDENTITY 14 0 13 FIX_AXIS_PAR_DIST 0 1 14 /end AXIS_DESCR
 /begin AXIS_DESCR FIX_AXIS NO_INPUT_QUANTITY CM_IDENTITY 14 0 13 FIX_AXIS_PAR_DIST 0 1 14 /end AXIS_DESCR
/end CHARACTERISTIC
/begin CHARACTERISTIC KFPUNW "podtverzhdena | to zhe pri upravlenii fazami (rezhim 2) -- vsya v edinicah, fazovraschatelya tut net" MAP 0x112DF RL_GRID_UBYTE 0 CM_0p0078125_0 -0 1.99219
 /begin AXIS_DESCR FIX_AXIS NO_INPUT_QUANTITY CM_IDENTITY 14 0 13 FIX_AXIS_PAR_DIST 0 1 14 /end AXIS_DESCR
 /begin AXIS_DESCR FIX_AXIS NO_INPUT_QUANTITY CM_IDENTITY 14 0 13 FIX_AXIS_PAR_DIST 0 1 14 /end AXIS_DESCR
/end CHARACTERISTIC
/begin CHARACTERISTIC KFPUSUNW "podtverzhdena | to zhe pri oboih (rezhim 3) -- vsya v edinicah" MAP 0x113C1 RL_GRID_UBYTE 0 CM_0p0078125_0 -0 1.99219
 /begin AXIS_DESCR FIX_AXIS NO_INPUT_QUANTITY CM_IDENTITY 14 0 13 FIX_AXIS_PAR_DIST 0 1 14 /end AXIS_DESCR
 /begin AXIS_DESCR FIX_AXIS NO_INPUT_QUANTITY CM_IDENTITY 14 0 13 FIX_AXIS_PAR_DIST 0 1 14 /end AXIS_DESCR
/end CHARACTERISTIC
/begin CHARACTERISTIC KFKHFM "podtverzhdena | korrekciya harakteristiki DMRV, oboroty x napolnenie" MAP 0x1111B RL_GRID_UBYTE 0 CM_0p0078125_0 -0 1.99219
 /begin AXIS_DESCR FIX_AXIS NO_INPUT_QUANTITY CM_IDENTITY 14 0 13 FIX_AXIS_PAR_DIST 0 1 14 /end AXIS_DESCR
 /begin AXIS_DESCR FIX_AXIS NO_INPUT_QUANTITY CM_IDENTITY 14 0 13 FIX_AXIS_PAR_DIST 0 1 14 /end AXIS_DESCR
/end CHARACTERISTIC
/begin CHARACTERISTIC PUKANS "podtverzhdena | popravka korrekcii pulsaciy po temperature vozduha na vpuske" CURVE 0x11568 RL_GRID_UBYTE 0 CM_0p0078125_0_mnozhitel -0 1.99219
 /begin AXIS_DESCR FIX_AXIS NO_INPUT_QUANTITY CM_IDENTITY 8 0 7 FIX_AXIS_PAR_DIST 0 1 8 /end AXIS_DESCR
/end CHARACTERISTIC
/begin CHARACTERISTIC CURVE_11A2E "adres podtverzhden | curve over coolant temperature, result to 0x9910" CURVE 0x11A35 RL_GRID_UBYTE 0 CM_IDENTITY -0 255
 /begin AXIS_DESCR COM_AXIS NO_INPUT_QUANTITY CM_0p75_48_GradC 6 0 143.25 AXIS_PTS_REF AX_11A2F_Y /end AXIS_DESCR
/end CHARACTERISTIC
/begin CHARACTERISTIC KST_COLD "podtverzhdena | koefficient holodnogo puska po temperature OZH" CURVE 0x116A5 RL_GRID_UBYTE 0 CM_0p0009765625_0 -0 0.249023
 /begin AXIS_DESCR COM_AXIS NO_INPUT_QUANTITY CM_0p75_48_GradC 12 0 143.25 AXIS_PTS_REF AX_11699_Y /end AXIS_DESCR
/end CHARACTERISTIC
/begin CHARACTERISTIC KST_HOT "podtverzhdena | koefficient goryachego puska po temperature vozduha na vpuske (vhod 0x8AB9)" CURVE 0x11692 RL_GRID_UBYTE 0 CM_0p25_0 -0 63.75
 /begin AXIS_DESCR COM_AXIS NO_INPUT_QUANTITY CM_0p75_48_GradC 6 0 143.25 AXIS_PTS_REF AX_1168C_Y /end AXIS_DESCR
/end CHARACTERISTIC
/begin CHARACTERISTIC KST_HOT_MUL "podtverzhdena | mnozhitel koefficienta goryachego puska: stroki -- temperatura vozduha, podryad -- velichina 0x8A00 (0..30)" MAP 0x116C0 RL_GRID_UBYTE 0 CM_0p0078125_0 -0 1.99219
 /begin AXIS_DESCR COM_AXIS NO_INPUT_QUANTITY CM_IDENTITY 6 0 255 AXIS_PTS_REF AX_116BA_X /end AXIS_DESCR
 /begin AXIS_DESCR COM_AXIS NO_INPUT_QUANTITY CM_0p75_48_GradC 6 0 143.25 AXIS_PTS_REF AX_116B4_Y /end AXIS_DESCR
/end CHARACTERISTIC
/begin CHARACTERISTIC KST_COLD_MUL "podtverzhdena | mnozhitel koefficienta holodnogo puska: stroki -- temperatura OZH, podryad -- velichina 0x8A00 (0..64)" MAP 0x11712 RL_GRID_UBYTE 0 CM_0p0078125_0 -0 1.99219
 /begin AXIS_DESCR COM_AXIS NO_INPUT_QUANTITY CM_IDENTITY 6 0 255 AXIS_PTS_REF AX_1170C_X /end AXIS_DESCR
 /begin AXIS_DESCR COM_AXIS NO_INPUT_QUANTITY CM_0p75_48_GradC 12 0 143.25 AXIS_PTS_REF AX_11700_Y /end AXIS_DESCR
/end CHARACTERISTIC
/begin CHARACTERISTIC KST_COLD_NMUL "podtverzhdena | mnozhitel koefficienta holodnogo puska po oborotam: stroki -- temperatura OZH, podryad -- oboroty" MAP 0x116EE RL_GRID_UBYTE 0 CM_0p00390625_0 -0 0.996094
 /begin AXIS_DESCR COM_AXIS NO_INPUT_QUANTITY CM_40_0_rpm 4 0 10200 AXIS_PTS_REF AX_116EA_X /end AXIS_DESCR
 /begin AXIS_DESCR COM_AXIS NO_INPUT_QUANTITY CM_0p75_48_GradC 4 0 143.25 AXIS_PTS_REF AX_116E6_Y /end AXIS_DESCR
/end CHARACTERISTIC
/begin CHARACTERISTIC KST_RESTART "podtverzhdena | obednyayuschiy koefficient povtornogo puska: stroki -- velichina 10..1800 (slovnaya os), podryad -- temperatura OZH" MAP 0x15F78 RL_GRID_UBYTE 0 CM_0p0078125_0 -0 1.99219
 /begin AXIS_DESCR COM_AXIS NO_INPUT_QUANTITY CM_0p75_48_GradC 4 0 143.25 AXIS_PTS_REF AX_15F74_X /end AXIS_DESCR
 /begin AXIS_DESCR COM_AXIS NO_INPUT_QUANTITY CM_IDENTITY 4 0 65535 AXIS_PTS_REF AX_15F6C_Y /end AXIS_DESCR
/end CHARACTERISTIC
/begin CHARACTERISTIC KF_TI_NONLIN "podtverzhdena | korrekciya nelineynosti podachi topliva: stroki -- oboroty, podryad -- vremya vpryska (os 1..20, x1/375)" MAP 0x1B694 RL_GRID_UWORD 0 CM_3p051757812En05_0 -0 1.99997
 /begin AXIS_DESCR COM_AXIS NO_INPUT_QUANTITY CM_0p0026666667_0_ms 16 0 174.76 AXIS_PTS_REF AX_1B674_X /end AXIS_DESCR
 /begin AXIS_DESCR COM_AXIS NO_INPUT_QUANTITY CM_40_0_rpm 16 0 10200 AXIS_PTS_REF AX_1B664_Y /end AXIS_DESCR
/end CHARACTERISTIC
/begin CHARACTERISTIC TMOT_ADAPT "podtverzhdena | temperatura OZH, vyshe kotoroy vklyuchaetsya adaptaciya smesi" VALUE 0x11911 RL_GRID_UBYTE 0 CM_0p75_48_GradC -48 143.25 /end CHARACTERISTIC
/begin CHARACTERISTIC NMIN_MISF "podtverzhdena | nizhnyaya granica oborotov diagnostiki propuskov vosplameneniya" VALUE 0x121C9 RL_GRID_UBYTE 0 CM_40_0_rpm -0 10200 /end CHARACTERISTIC
/begin CHARACTERISTIC NMAX_MISF "podtverzhdena | verhnyaya granica oborotov diagnostiki propuskov vosplameneniya" VALUE 0x121CA RL_GRID_UBYTE 0 CM_40_0_rpm -0 10200 /end CHARACTERISTIC
/begin CHARACTERISTIC TMOT_FAN_HYS "podtverzhdena | gisterezis temperatury OZH dlya ventilyatora" VALUE 0x199FF RL_GRID_UBYTE 0 CM_0p75_0_K -0 191.25 /end CHARACTERISTIC
/begin CHARACTERISTIC TAN_FAN "podtverzhdena | porog temperatury vozduha na vpuske dlya vklyucheniya ventilyatora" VALUE 0x19A01 RL_GRID_UBYTE 0 CM_0p75_48_GradC -48 143.25 /end CHARACTERISTIC
/begin CHARACTERISTIC TMOT_FAN1 "podtverzhdena | porog temperatury OZH dlya vklyucheniya ventilyatora, rezhim 1" VALUE 0x19A02 RL_GRID_UBYTE 0 CM_0p75_48_GradC -48 143.25 /end CHARACTERISTIC
/begin CHARACTERISTIC TMOT_FAN2 "podtverzhdena | porog temperatury OZH dlya vklyucheniya ventilyatora, rezhim 2" VALUE 0x19A03 RL_GRID_UBYTE 0 CM_0p75_48_GradC -48 143.25 /end CHARACTERISTIC
/begin CHARACTERISTIC TMOT_FAN3 "podtverzhdena | porog temperatury OZH dlya vklyucheniya ventilyatora, rezhim 3" VALUE 0x19A04 RL_GRID_UBYTE 0 CM_0p75_48_GradC -48 143.25 /end CHARACTERISTIC
/begin CHARACTERISTIC TMOT_FAN4 "podtverzhdena | porog temperatury OZH dlya vklyucheniya ventilyatora, rezhim 4" VALUE 0x19A05 RL_GRID_UBYTE 0 CM_0p75_48_GradC -48 143.25 /end CHARACTERISTIC
/begin CHARACTERISTIC TMOT_FAN5 "podtverzhdena | porog temperatury OZH dlya vklyucheniya ventilyatora, rezhim 5" VALUE 0x19A06 RL_GRID_UBYTE 0 CM_0p75_48_GradC -48 143.25 /end CHARACTERISTIC
/begin CHARACTERISTIC HFM_LIN "podtverzhdena | tarirovka DMRV: rashod po 512 tochkam napryazheniya" CURVE 0x15260 RL_GRID_UWORD 0 CM_0p1_0_kgh -0 6553.5
 /begin AXIS_DESCR FIX_AXIS NO_INPUT_QUANTITY CM_IDENTITY 512 0 511 FIX_AXIS_PAR_DIST 0 1 512 /end AXIS_DESCR
/end CHARACTERISTIC
/begin CHARACTERISTIC HFM_LIN_OFS "podtverzhdena | smeschenie tarirovki DMRV" VALUE 0x15660 RL_GRID_UWORD 0 CM_0p1_0_kgh -0 6553.5 /end CHARACTERISTIC
/begin CHARACTERISTIC LS_CONFIG "podtverzhdena | konfiguraciya lyambda-zondov, bitovoe pole: bit 1 -- zond posle neytralizatora, bank 1" VALUE 0x10022 RL_GRID_UBYTE 0 CM_IDENTITY -0 255 /end CHARACTERISTIC
/begin CHARACTERISTIC KF_LAM_WARM "podtverzhdena | sostav smesi pri progreve, lyambda-regulirovanie aktivno: stroki -- TOZH (0x8AB4), podryad -- TOZH pri puske (0x8AB3)" MAP 0x19344 RL_GRID_UBYTE 0 CM_0p0078125_0 -0 1.99219
 /begin AXIS_DESCR COM_AXIS NO_INPUT_QUANTITY CM_0p75_48_GradC 12 0 143.25 AXIS_PTS_REF AX_1827E_X /end AXIS_DESCR
 /begin AXIS_DESCR COM_AXIS NO_INPUT_QUANTITY CM_0p75_48_GradC 12 0 143.25 AXIS_PTS_REF AX_10176_Y /end AXIS_DESCR
/end CHARACTERISTIC
/begin CHARACTERISTIC KL_LAM_OPEN "podtverzhdena | korrekciya sostava smesi pri neaktivnom lyambda-regulirovanii, po TOZH" CURVE 0x193D4 RL_GRID_SBYTE 0 CM_0p0078125_0 -1 1
 /begin AXIS_DESCR COM_AXIS NO_INPUT_QUANTITY CM_0p75_48_GradC 12 0 143.25 AXIS_PTS_REF AX_10176_Y /end AXIS_DESCR
/end CHARACTERISTIC
/begin CHARACTERISTIC LAM_RICH_MAX "podtverzhdena | predel bogatoy smesi. Vtoroy variant lezhit ryadom, 0x1190E, vybor po bitu 0xFD0C.13" VALUE 0x1190D RL_GRID_UBYTE 0 CM_0p0078125_0 -0 1.99219 /end CHARACTERISTIC
/begin CHARACTERISTIC KABAKL_S "podtverzhdena | koefficient ubyvaniya obogascheniya na razgone, korotkaya sostavlyayuschaya" VALUE 0x118F9 RL_GRID_UBYTE 0 CM_0p00390625_0 -0 0.996094 /end CHARACTERISTIC
/begin CHARACTERISTIC DTH_ACC_ENR "podtverzhdena | porog vklyucheniya obogascheniya pri razgone, po TOZH" CURVE 0x1B4F0 RL_GRID_SWORD 0 CM_0p046875_0 -1536 1536
 /begin AXIS_DESCR COM_AXIS NO_INPUT_QUANTITY CM_0p75_48_GradC 9 0 191.25 AXIS_PTS_REF STM09_WF /end AXIS_DESCR
/end CHARACTERISTIC
/begin CHARACTERISTIC DTH_DEC_LEAN "podtverzhdena | porog vklyucheniya obedneniya pri zamedlenii, po TOZH" CURVE 0x1B502 RL_GRID_SWORD 0 CM_0p046875_0 -1536 1536
 /begin AXIS_DESCR COM_AXIS NO_INPUT_QUANTITY CM_0p75_48_GradC 9 0 191.25 AXIS_PTS_REF STM09_WF /end AXIS_DESCR
/end CHARACTERISTIC
/begin GROUP G_lambda_cat_diag_block "Diagnostika katalizatora"
 /begin REF_CHARACTERISTIC TSTEAA TVLRHMN TVLRHMX ANZDYNSH CWDLSAHK TABGSTG TFRMB TLLASH TSALASH TUSCHUB TUSHSMIN TUSSA USHLEAN USHRICH USHSTGMX USHSTSOLL USSCHUB CWGGLSV ADKATNF AHKATMN AHKATS AHKATSB AHKTMXT APEKTDX AVKATFS CDKATLK DKATCW DRLKTDP DRLKTDPT FALRKTD FALRKTT KATBFMNT KATBFN KATBFNM KATBFNP KATBFSX KATBSG KATBSH KATBSHG NDKTSOT NDKTSUT NKTDX RLDKTOT RLDKTUT TMAXKAT TMINKAT TMNKATT TMSUKTD TWDKATST TWKTDLP ZDKATAD ZDKATAF ZDKATSH ZDKTBD ZDKTBF ZKTDRL PHLSNVMN TABGMSVU TMASO TMNEB TMSV TMSVA TRSA TUSEINV PHLSNHMN THHA THHA2 THHAWU THSHA THVA THVA2 THVAWU TMOHSMN TREHS TVHSH TVHSV TVHSVMX UBHS UHSN /end REF_CHARACTERISTIC
/end GROUP
/begin GROUP G_knock_control "Kontur detonacii"
 /begin REF_CHARACTERISTIC DKROKMX FKEFMC FKELDY FKENDY FKRFTPFMC KRFTP1 KRFTP2 KRFTP3 KRKFKS KRVST REFINI KRDWA KRDWKLA KRDWSA KRLMDY KRNMDY KSZA DYADS DYAFVS DYAVF FKELDYA PZWKRA TMDYNA CWDKRNT CWDKROF DKROKU KRFHT UDKRGOFS CWDKRTP UDKRTP NDSVL QDPSLL RLDSVL /end REF_CHARACTERISTIC
/end GROUP
/begin GROUP G_canister_purge "Adsorber"
 /begin REF_CHARACTERISTIC GRID_528_197BC_10x10 KFQTE TMTE FRHB FTEADAB FTEADMX FTEFHB FTEHB FUMRBRK KHCTEMN KHCTEMX ZBTEML DNDTEO DNDTEU ETAZWTEN FKADPMN IMSDTEVA TC6TECI TC6TECL TC6TECNL TC6TECP TC6TECRF TC6TECRM TC6TECT TTEVAZ TVDTEB TVDTEE TVDTEVP TVDTEVZ /end REF_CHARACTERISTIC
/end GROUP
/begin GROUP G_ctp7_confirmed "ctp7_confirmed"
 /begin REF_CHARACTERISTIC STM12ESUB STS12ESUB KST_COLD KST_HOT KST_HOT_MUL KST_COLD_MUL KST_COLD_NMUL KST_RESTART KF_TI_NONLIN TMOT_ADAPT NMIN_MISF NMAX_MISF TMOT_FAN_HYS TAN_FAN TMOT_FAN1 TMOT_FAN2 TMOT_FAN3 TMOT_FAN4 TMOT_FAN5 HFM_LIN HFM_LIN_OFS LS_CONFIG KF_LAM_WARM KL_LAM_OPEN LAM_RICH_MAX KABAKL_S DTH_ACC_ENR DTH_DEC_LEAN /end REF_CHARACTERISTIC
/end GROUP
/begin GROUP G_mixture_adaptation "mixture_adaptation"
 /begin REF_CHARACTERISTIC TATELL TMSKLH TMSNOGA FRAOMN FRAOMX FRAORN FRAORX FRATMN FRATMX FRAUMN FRAUMX FRAURN FRAURX NO1 NOLRA NU3 RLO2 RLO3 RLO3AC RLU2 RLU2AC RLU3 RLU4 TMFRATMN TMFRATUB CWPKAPP KRKTE CWLAMBTS /end REF_CHARACTERISTIC
/end GROUP
/begin GROUP G_ac_compressor "Kondicioner"
 /begin REF_CHARACTERISTIC LIMTKOA TKOAMNN TKOAMXN TKOEMNN TMKOAO TMKOAU TNACMX TVKOA TVKOE VKOAO VKOAU WDKKOAN_0 WDKKOAN_1 WDKKOEN /end REF_CHARACTERISTIC
/end GROUP
/begin GROUP G_overrun_fuel_cut "Otsechka na prinuditelnom holostom"
 /begin REF_CHARACTERISTIC KSZWE CWSAWE DNSAH DNSAL DNSATIP DNSLL DNVSA DNWEELLS DNWEK DVSA ENSAKHG TKATSA VSAA /end REF_CHARACTERISTIC
/end GROUP
/begin GROUP G_torque_model "Momentnaya model"
 /begin REF_CHARACTERISTIC ETADZW ETALAM_10515 DZWETA KFMIOP KFMIRL KFMDS MDIMX CWMDAPP ETALAM MDLF1 MDLF2 MDLFE1 MDLFE2 /end REF_CHARACTERISTIC
/end GROUP
/begin GROUP G_lambda_control_thresholds "lambda_control_thresholds" /begin REF_CHARACTERISTIC RLLRUN_18AD2 RLLRTMO RLLRUN TARAU TASHS TLRHS TMRA1 TMRA2 /end REF_CHARACTERISTIC /end GROUP
/begin GROUP G_maps "Karty iz opisi" /begin REF_CHARACTERISTIC KFETAZW KFETAZWN KFZWOP KFZWMS KFZW KFZW2 KFZWMN KFLBTS /end REF_CHARACTERISTIC /end GROUP
/begin GROUP G_transient_fuel "Perehodnye rezhimy, plenka"
 /begin REF_CHARACTERISTIC SNM07ESUB STM09ESUB KFABAK KFAVAK KFBAKL KFVAKL KABAKL_L KVAKL_L /end REF_CHARACTERISTIC
/end GROUP
/begin GROUP G_cyclic_charge "Ciklovoe napolnenie" /begin REF_CHARACTERISTIC KUMSRL CWFKMSDKA KIMSALL MSALLMN MSALLMX MSLG RLNOT /end REF_CHARACTERISTIC /end GROUP
/begin GROUP G_full_load_enrichment "full_load_enrichment"
 /begin REF_CHARACTERISTIC WDKSLN_18FCB WDKSLN WDKVLN_0 WDKVLN_1 KLLAMFA_0 KLLAMFA_1 TV_LAMFA /end REF_CHARACTERISTIC
/end GROUP
/begin GROUP G_hfm_path "Vozdushnyy trakt, DMRV" /begin REF_CHARACTERISTIC KFPU KFPUSU KFPUNW KFPUSUNW KFKHFM PUKANS /end REF_CHARACTERISTIC /end GROUP
/begin GROUP G_scalars "Odinochnye velichiny" /begin REF_CHARACTERISTIC DNMAXH NMAX NMAXDV NMXDKPU TNMAXDV /end REF_CHARACTERISTIC /end GROUP
/begin GROUP G_full_load_lambda "Lyambda polnoy nagruzki" /begin REF_CHARACTERISTIC SNM16GKUB_181F8 SRL12GKUB_1821F KFFDLBTS TVLBTS /end REF_CHARACTERISTIC /end GROUP
/begin GROUP G_throttle_air_model "Drossel, model vozduha" /begin REF_CHARACTERISTIC KFMSNWDK WDKUGDN KFRLW /end REF_CHARACTERISTIC /end GROUP
/begin GROUP G_cpv_curves "cpv_curves" /begin REF_CHARACTERISTIC CURVE_19509 CURVE_19515 /end REF_CHARACTERISTIC /end GROUP
/begin GROUP G_fuel_path "Toplivopodacha" /begin REF_CHARACTERISTIC KFLF FRKAP /end REF_CHARACTERISTIC /end GROUP
/begin GROUP G_axes_resolved_from_code "Osi, vosstanovlennye po kodu" /begin REF_CHARACTERISTIC SRL11OPUW /end REF_CHARACTERISTIC /end GROUP
/begin GROUP G_code_found "code_found" /begin REF_CHARACTERISTIC CURVE_11A2E /end REF_CHARACTERISTIC /end GROUP
/begin GROUP G_dtc_table "dtc_table" /begin REF_CHARACTERISTIC DTC_CODES /end REF_CHARACTERISTIC /end GROUP
/begin GROUP G_other_regions "Prochie oblasti" /begin REF_CHARACTERISTIC DIAG_FLAGS /end REF_CHARACTERISTIC /end GROUP
/begin GROUP G_saint_venant "Sen-Venan, rashod cherez drossel" /begin REF_CHARACTERISTIC KLAF /end REF_CHARACTERISTIC /end GROUP
/end MODULE
/end PROJECT
