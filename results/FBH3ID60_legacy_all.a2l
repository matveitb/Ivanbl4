ASAP2_VERSION 1 51
/begin PROJECT FBH3ID60 "Bosch M7.9.7 C167"
/begin HEADER "Kia Spectra 1.6 FBH3ID60" VERSION "1.0" /end HEADER
/begin MODULE FBH3ID60_MOD "Bosch M7.9.7"
/begin MOD_COMMON "little endian, alignment 1" BYTE_ORDER MSB_LAST ALIGNMENT_BYTE 1 ALIGNMENT_WORD 1 ALIGNMENT_LONG 1 /end MOD_COMMON
/begin COMPU_METHOD CM_IDENTITY "raw values" RAT_FUNC "%.3f" "" COEFFS 0 1 0 0 0 1 /end COMPU_METHOD
/begin COMPU_METHOD CM_40_0_rpm "scale 40" RAT_FUNC "%.1f" "rpm" COEFFS 0 1 0 0 0 40 /end COMPU_METHOD
/begin COMPU_METHOD CM_0p75_0 "scale 0.75" RAT_FUNC "%.3f" "%" COEFFS 0 1 0 0 0 0.75 /end COMPU_METHOD
/begin COMPU_METHOD CM_0p0234375_0 "scale 0.0234375" RAT_FUNC "%.3f" "%" COEFFS 0 1 0 0 0 0.0234375 /end COMPU_METHOD
/begin COMPU_METHOD CM_0p75_48_GradC "scale 0.75" RAT_FUNC "%.3f" "Grad C" COEFFS 0 1 48 0 0 0.75 /end COMPU_METHOD
/begin COMPU_METHOD CM_4_0_kgh "scale 4" RAT_FUNC "%.1f" "kg/h" COEFFS 0 1 0 0 0 4 /end COMPU_METHOD
/begin COMPU_METHOD CM_100_0_Umins "scale 100" RAT_FUNC "%.1f" "U/min/s" COEFFS 0 1 0 0 0 100 /end COMPU_METHOD
/begin COMPU_METHOD CM_40_0_Upm "scale 40" RAT_FUNC "%.1f" "Upm" COEFFS 0 1 0 0 0 40 /end COMPU_METHOD
/begin COMPU_METHOD CM_0p0625_0 "scale 0.0625" RAT_FUNC "%.3f" "-" COEFFS 0 1 0 0 0 0.0625 /end COMPU_METHOD
/begin COMPU_METHOD CM_0p5_0 "scale 0.5" RAT_FUNC "%.3f" "%" COEFFS 0 1 0 0 0 0.5 /end COMPU_METHOD
/begin COMPU_METHOD CM_0p390625_0 "scale 0.390625" RAT_FUNC "%.3f" "%" COEFFS 0 1 0 0 0 0.390625 /end COMPU_METHOD
/begin COMPU_METHOD CM_0p217_0_ms2 "scale 0.217" RAT_FUNC "%.3f" "m/s^2" COEFFS 0 1 0 0 0 0.217 /end COMPU_METHOD
/begin COMPU_METHOD CM_0p09803921569_0 "scale 0.0980392" RAT_FUNC "%.3f" "" COEFFS 0 1 0 0 0 0.09803921569 /end COMPU_METHOD
/begin COMPU_METHOD CM_0p03125_0 "scale 0.03125" RAT_FUNC "%.3f" "-" COEFFS 0 1 0 0 0 0.03125 /end COMPU_METHOD
/begin COMPU_METHOD CM_0p0078125_0 "scale 0.0078125" RAT_FUNC "%.3f" "-" COEFFS 0 1 0 0 0 0.0078125 /end COMPU_METHOD
/begin COMPU_METHOD CM_10_0_Umin "scale 10" RAT_FUNC "%.1f" "U/min" COEFFS 0 1 0 0 0 10 /end COMPU_METHOD
/begin COMPU_METHOD CM_0p00390625_0 "scale 0.00390625" RAT_FUNC "%.3f" "-" COEFFS 0 1 0 0 0 0.00390625 /end COMPU_METHOD
/begin COMPU_METHOD CM_0p001525878906_0 "scale 0.00152588" RAT_FUNC "%.3f" "-" COEFFS 0 1 0 0 0 0.001525878906 /end COMPU_METHOD
/begin COMPU_METHOD CM_0p02_0_s "scale 0.02" RAT_FUNC "%.3f" "s" COEFFS 0 1 0 0 0 0.02 /end COMPU_METHOD
/begin COMPU_METHOD CM_0p3921568627_0_DK "scale 0.392157" RAT_FUNC "%.3f" "% DK" COEFFS 0 1 0 0 0 0.3921568627 /end COMPU_METHOD
/begin COMPU_METHOD CM_0p2_0_s "scale 0.2" RAT_FUNC "%.3f" "s" COEFFS 0 1 0 0 0 0.2 /end COMPU_METHOD
/begin COMPU_METHOD CM_0p01_0_s "scale 0.01" RAT_FUNC "%.3f" "s" COEFFS 0 1 0 0 0 0.01 /end COMPU_METHOD
/begin COMPU_METHOD CM_0p001953125_0 "scale 0.00195312" RAT_FUNC "%.3f" "%" COEFFS 0 1 0 0 0 0.001953125 /end COMPU_METHOD
/begin COMPU_METHOD CM_0p000244140625_0 "scale 0.000244141" RAT_FUNC "%.3f" "-" COEFFS 0 1 0 0 0 0.000244140625 /end COMPU_METHOD
/begin COMPU_METHOD CM_0p1_0_s "scale 0.1" RAT_FUNC "%.3f" "s" COEFFS 0 1 0 0 0 0.1 /end COMPU_METHOD
/begin COMPU_METHOD CM_0p015625_0 "scale 0.015625" RAT_FUNC "%.3f" "-" COEFFS 0 1 0 0 0 0.015625 /end COMPU_METHOD
/begin COMPU_METHOD CM_3p2_0_kgh "scale 3.2" RAT_FUNC "%.1f" "kg/h" COEFFS 0 1 0 0 0 3.2 /end COMPU_METHOD
/begin COMPU_METHOD CM_5p96En08_0_Min "scale 5.96e-08" RAT_FUNC "%.3f" "Min" COEFFS 0 1 0 0 0 5.96e-08 /end COMPU_METHOD
/begin COMPU_METHOD CM_1p525878906En05_0 "scale 1.52588e-05" RAT_FUNC "%.3f" "-" COEFFS 0 1 0 0 0 1.525878906e-05 /end COMPU_METHOD
/begin COMPU_METHOD CM_3p051757812En05_0 "scale 3.05176e-05" RAT_FUNC "%.3f" "-" COEFFS 0 1 0 0 0 3.051757812e-05 /end COMPU_METHOD
/begin COMPU_METHOD CM_5_50_GradC "scale 5" RAT_FUNC "%.1f" "Grad C" COEFFS 0 1 50 0 0 5 /end COMPU_METHOD
/begin COMPU_METHOD CM_5_0_GradC "scale 5" RAT_FUNC "%.1f" "Grad C" COEFFS 0 1 0 0 0 5 /end COMPU_METHOD
/begin COMPU_METHOD CM_0p005215686275_0p2_V "scale 0.00521569" RAT_FUNC "%.3f" "V" COEFFS 0 1 0.2 0 0 0.005215686275 /end COMPU_METHOD
/begin COMPU_METHOD CM_0p0390625_0_mss "scale 0.0390625" RAT_FUNC "%.3f" "ms/s" COEFFS 0 1 0 0 0 0.0390625 /end COMPU_METHOD
/begin COMPU_METHOD CM_0p02275555556_0_kg "scale 0.0227556" RAT_FUNC "%.3f" "kg" COEFFS 0 1 0 0 0 0.02275555556 /end COMPU_METHOD
/begin COMPU_METHOD CM_4p768359375En05_0_1s "scale 4.76836e-05" RAT_FUNC "%.3f" "1/s" COEFFS 0 1 0 0 0 4.768359375e-05 /end COMPU_METHOD
/begin COMPU_METHOD CM_0p02392578125_0_1s "scale 0.0239258" RAT_FUNC "%.3f" "1/s" COEFFS 0 1 0 0 0 0.02392578125 /end COMPU_METHOD
/begin COMPU_METHOD CM_0p5_0_ms "scale 0.5" RAT_FUNC "%.3f" "ms" COEFFS 0 1 0 0 0 0.5 /end COMPU_METHOD
/begin COMPU_METHOD CM_20_0_s "scale 20" RAT_FUNC "%.1f" "s" COEFFS 0 1 0 0 0 20 /end COMPU_METHOD
/begin COMPU_METHOD CM_0p09103840683_0_kg "scale 0.0910384" RAT_FUNC "%.3f" "kg" COEFFS 0 1 0 0 0 0.09103840683 /end COMPU_METHOD
/begin COMPU_METHOD CM_0p1_0_kgh "scale 0.1" RAT_FUNC "%.3f" "kg/h" COEFFS 0 1 0 0 0 0.1 /end COMPU_METHOD
/begin COMPU_METHOD CM_0p0390625_0_hPa "scale 0.0390625" RAT_FUNC "%.3f" "hPa" COEFFS 0 1 0 0 0 0.0390625 /end COMPU_METHOD
/begin COMPU_METHOD CM_0p05664148928_0_kJ "scale 0.0566415" RAT_FUNC "%.3f" "kJ" COEFFS 0 1 0 0 0 0.05664148928 /end COMPU_METHOD
/begin COMPU_METHOD CM_3p9062En05_0p05_s "scale 3.9062e-05" RAT_FUNC "%.3f" "s" COEFFS 0 1 0.05 0 0 3.9062e-05 /end COMPU_METHOD
/begin COMPU_METHOD CM_0p125_0 "scale 0.125" RAT_FUNC "%.3f" "-" COEFFS 0 1 0 0 0 0.125 /end COMPU_METHOD
/begin COMPU_METHOD CM_0p000732421875_0_GradC "scale 0.000732422" RAT_FUNC "%.3f" "Grad C" COEFFS 0 1 0 0 0 0.000732421875 /end COMPU_METHOD
/begin COMPU_METHOD CM_0p52_0_mVms "scale 0.52" RAT_FUNC "%.3f" "mV/ms" COEFFS 0 1 0 0 0 0.52 /end COMPU_METHOD
/begin COMPU_METHOD CM_0p09362_0_1V "scale 0.09362" RAT_FUNC "%.3f" "1/V" COEFFS 0 1 0 0 0 0.09362 /end COMPU_METHOD
/begin COMPU_METHOD CM_0p005215686275_0_V "scale 0.00521569" RAT_FUNC "%.3f" "V" COEFFS 0 1 0 0 0 0.005215686275 /end COMPU_METHOD
/begin COMPU_METHOD CM_0p8695652174_0_mg "scale 0.869565" RAT_FUNC "%.3f" "mg" COEFFS 0 1 0 0 0 0.8695652174 /end COMPU_METHOD
/begin COMPU_METHOD CM_0p8695652174_0_mgs "scale 0.869565" RAT_FUNC "%.3f" "mg/s" COEFFS 0 1 0 0 0 0.8695652174 /end COMPU_METHOD
/begin COMPU_METHOD CM_0p05_0_s "scale 0.05" RAT_FUNC "%.3f" "s" COEFFS 0 1 0 0 0 0.05 /end COMPU_METHOD
/begin COMPU_METHOD CM_0p0444_0_g "scale 0.0444" RAT_FUNC "%.3f" "g" COEFFS 0 1 0 0 0 0.0444 /end COMPU_METHOD
/begin COMPU_METHOD CM_1p25_0_kmh "scale 1.25" RAT_FUNC "%.1f" "km/h" COEFFS 0 1 0 0 0 1.25 /end COMPU_METHOD
/begin COMPU_METHOD CM_0p75_0_K "scale 0.75" RAT_FUNC "%.3f" "K" COEFFS 0 1 0 0 0 0.75 /end COMPU_METHOD
/begin RECORD_LAYOUT RL_AXIS_U8 NO_AXIS_PTS_X 1 UBYTE AXIS_PTS_X 2 UBYTE INDEX_INCR DIRECT /end RECORD_LAYOUT
/begin RECORD_LAYOUT RL_GRID_UBYTE FNC_VALUES 1 UBYTE ROW_DIR DIRECT /end RECORD_LAYOUT
/begin RECORD_LAYOUT RL_GRID_SBYTE FNC_VALUES 1 SBYTE ROW_DIR DIRECT /end RECORD_LAYOUT
/begin RECORD_LAYOUT RL_3D_A8_UBYTE NO_AXIS_PTS_Y 1 UBYTE NO_AXIS_PTS_X 2 UBYTE AXIS_PTS_Y 3 UBYTE INDEX_INCR DIRECT AXIS_PTS_X 4 UBYTE INDEX_INCR DIRECT FNC_VALUES 5 UBYTE ROW_DIR DIRECT /end RECORD_LAYOUT
/begin RECORD_LAYOUT RL_2D_A16_UWORD NO_AXIS_PTS_X 1 UBYTE AXIS_PTS_X 2 UWORD INDEX_INCR DIRECT FNC_VALUES 3 UWORD ROW_DIR DIRECT /end RECORD_LAYOUT
/begin RECORD_LAYOUT RL_2D_A8_UBYTE NO_AXIS_PTS_X 1 UBYTE AXIS_PTS_X 2 UBYTE INDEX_INCR DIRECT FNC_VALUES 3 UBYTE ROW_DIR DIRECT /end RECORD_LAYOUT
/begin RECORD_LAYOUT RL_3D_A8_UWORD NO_AXIS_PTS_Y 1 UBYTE NO_AXIS_PTS_X 2 UBYTE AXIS_PTS_Y 3 UBYTE INDEX_INCR DIRECT AXIS_PTS_X 4 UBYTE INDEX_INCR DIRECT FNC_VALUES 5 UWORD ROW_DIR DIRECT /end RECORD_LAYOUT
/begin RECORD_LAYOUT RL_2D_A8_UWORD NO_AXIS_PTS_X 1 UBYTE AXIS_PTS_X 2 UBYTE INDEX_INCR DIRECT FNC_VALUES 3 UWORD ROW_DIR DIRECT /end RECORD_LAYOUT
/begin RECORD_LAYOUT RL_GRID_UWORD FNC_VALUES 1 UWORD ROW_DIR DIRECT /end RECORD_LAYOUT
/begin RECORD_LAYOUT RL_3D_A16_UWORD NO_AXIS_PTS_Y 1 UBYTE NO_AXIS_PTS_X 2 UBYTE AXIS_PTS_Y 3 UWORD INDEX_INCR DIRECT AXIS_PTS_X 4 UWORD INDEX_INCR DIRECT FNC_VALUES 5 UWORD ROW_DIR DIRECT /end RECORD_LAYOUT
/begin RECORD_LAYOUT RL_GRID_SWORD FNC_VALUES 1 SWORD ROW_DIR DIRECT /end RECORD_LAYOUT
/begin RECORD_LAYOUT RL_2D_A16_UBYTE NO_AXIS_PTS_X 1 UBYTE AXIS_PTS_X 2 UWORD INDEX_INCR DIRECT FNC_VALUES 3 UBYTE ROW_DIR DIRECT /end RECORD_LAYOUT
/begin RECORD_LAYOUT RL_AXIS_BARE_UBYTE AXIS_PTS_X 1 UBYTE INDEX_INCR DIRECT /end RECORD_LAYOUT
/begin AXIS_PTS SNM08_KO "engine speed for A/C compressor, 8 points" 0x119D9 NO_INPUT_QUANTITY RL_AXIS_U8 0 CM_40_0_rpm 8 0 10200 /end AXIS_PTS
/begin AXIS_PTS AX_11A2F_Y "Grad C" 0x11A2F NO_INPUT_QUANTITY RL_AXIS_BARE_UBYTE 0 CM_0p75_48_GradC 6 -48 143.25 /end AXIS_PTS
/begin CHARACTERISTIC SGA08MDUB "podtverzhdena damos addr 0x10068 | base point distribution of actual gear 8 b.pt." CURVE 0x10068 RL_GRID_UBYTE 0 CM_IDENTITY 0 255
 /begin AXIS_DESCR FIX_AXIS NO_INPUT_QUANTITY CM_IDENTITY 8 0 7 FIX_AXIS_PAR_DIST 0 1 8 /end AXIS_DESCR
/end CHARACTERISTIC
/begin CHARACTERISTIC SML05DKUB "podtverzhdena damos addr 0x10071 | base point distribution air mass" CURVE 0x10071 RL_GRID_UBYTE 0 CM_4_0_kgh 0 1020
 /begin AXIS_DESCR FIX_AXIS NO_INPUT_QUANTITY CM_IDENTITY 5 0 4 FIX_AXIS_PAR_DIST 0 1 5 /end AXIS_DESCR
/end CHARACTERISTIC
/begin CHARACTERISTIC SML05LKUB "podtverzhdena damos addr 0x10077" CURVE 0x10077 RL_GRID_UBYTE 0 CM_4_0_kgh 0 1020
 /begin AXIS_DESCR FIX_AXIS NO_INPUT_QUANTITY CM_IDENTITY 5 0 4 FIX_AXIS_PAR_DIST 0 1 5 /end AXIS_DESCR
/end CHARACTERISTIC
/begin CHARACTERISTIC SML08LHUB "podtverzhdena damos addr 0x1007D | ml dependet basic point (number 8)" CURVE 0x1007D RL_GRID_UBYTE 0 CM_4_0_kgh 0 1020
 /begin AXIS_DESCR FIX_AXIS NO_INPUT_QUANTITY CM_IDENTITY 8 0 7 FIX_AXIS_PAR_DIST 0 1 8 /end AXIS_DESCR
/end CHARACTERISTIC
/begin CHARACTERISTIC SNG06LLSB "adres podtverzhden damos-veroyatno addr 0x10086 | IMYA NE PODTVERZHDENO, adres: kod: mov r12, #0x85 @0x834C6C | Datapoint distribution, speed gradient, 6 datapoints" CURVE 0x10086 RL_GRID_SBYTE 0 CM_100_0_Umins -12800 12700
 /begin AXIS_DESCR FIX_AXIS NO_INPUT_QUANTITY CM_IDENTITY 6 0 5 FIX_AXIS_PAR_DIST 0 1 6 /end AXIS_DESCR
/end CHARACTERISTIC
/begin CHARACTERISTIC SNM05DKUB "podtverzhdena damos addr 0x1008D | base point distribution nmot" CURVE 0x1008D RL_GRID_UBYTE 0 CM_40_0_Upm 0 10200
 /begin AXIS_DESCR FIX_AXIS NO_INPUT_QUANTITY CM_IDENTITY 5 0 4 FIX_AXIS_PAR_DIST 0 1 5 /end AXIS_DESCR
/end CHARACTERISTIC
/begin CHARACTERISTIC SNM06LLUB "podtverzhdena damos addr 0x10093 | distribution of engine speed" CURVE 0x10093 RL_GRID_UBYTE 0 CM_40_0_Upm 0 10200
 /begin AXIS_DESCR FIX_AXIS NO_INPUT_QUANTITY CM_IDENTITY 6 0 5 FIX_AXIS_PAR_DIST 0 1 6 /end AXIS_DESCR
/end CHARACTERISTIC
/begin CHARACTERISTIC SNM07LRUB "podtverzhdena damos addr 0x1009A" CURVE 0x1009A RL_GRID_UBYTE 0 CM_40_0_Upm 0 10200
 /begin AXIS_DESCR FIX_AXIS NO_INPUT_QUANTITY CM_IDENTITY 7 0 6 FIX_AXIS_PAR_DIST 0 1 7 /end AXIS_DESCR
/end CHARACTERISTIC
/begin CHARACTERISTIC SNM08DMUB "podtverzhdena damos addr 0x100A2 | Datapoint distribution in DMD, 8 speed datapoints" CURVE 0x100A2 RL_GRID_UBYTE 0 CM_40_0_Upm 0 10200
 /begin AXIS_DESCR FIX_AXIS NO_INPUT_QUANTITY CM_IDENTITY 8 0 7 FIX_AXIS_PAR_DIST 0 1 8 /end AXIS_DESCR
/end CHARACTERISTIC
/begin CHARACTERISTIC SNM08LHUB "podtverzhdena damos addr 0x100AB | nmot dependet basic point (number 8)" CURVE 0x100AB RL_GRID_UBYTE 0 CM_40_0_Upm 0 10200
 /begin AXIS_DESCR FIX_AXIS NO_INPUT_QUANTITY CM_IDENTITY 8 0 7 FIX_AXIS_PAR_DIST 0 1 8 /end AXIS_DESCR
/end CHARACTERISTIC
/begin CHARACTERISTIC SNM08__UB "podtverzhdena damos addr 0x100B4 | Base point distribution engine speed, 8 base points" CURVE 0x100B4 RL_GRID_UBYTE 0 CM_40_0_Upm 0 10200
 /begin AXIS_DESCR FIX_AXIS NO_INPUT_QUANTITY CM_IDENTITY 8 0 7 FIX_AXIS_PAR_DIST 0 1 8 /end AXIS_DESCR
/end CHARACTERISTIC
/begin CHARACTERISTIC SNM10FEUB "podtverzhdena damos addr 0x100BD" CURVE 0x100BD RL_GRID_UBYTE 0 CM_40_0_Upm 0 10200
 /begin AXIS_DESCR FIX_AXIS NO_INPUT_QUANTITY CM_IDENTITY 10 0 9 FIX_AXIS_PAR_DIST 0 1 10 /end AXIS_DESCR
/end CHARACTERISTIC
/begin CHARACTERISTIC SNM12ESUB "podtverzhdena damos addr 0x100C8 | Distribution for the engine speed nmot" CURVE 0x100C8 RL_GRID_UBYTE 0 CM_40_0_Upm 0 10200
 /begin AXIS_DESCR FIX_AXIS NO_INPUT_QUANTITY CM_IDENTITY 12 0 11 FIX_AXIS_PAR_DIST 0 1 12 /end AXIS_DESCR
/end CHARACTERISTIC
/begin CHARACTERISTIC SNM12FEUB "podtverzhdena damos addr 0x100D5 | set points of WDKSMX, WDKUGDN" CURVE 0x100D5 RL_GRID_UBYTE 0 CM_40_0_Upm 0 10200
 /begin AXIS_DESCR FIX_AXIS NO_INPUT_QUANTITY CM_IDENTITY 12 0 11 FIX_AXIS_PAR_DIST 0 1 12 /end AXIS_DESCR
/end CHARACTERISTIC
/begin CHARACTERISTIC SNM16CIUB "podtverzhdena damos addr 0x100E2 | Base point distribution of engine speed, 16 base pts." CURVE 0x100E2 RL_GRID_UBYTE 0 CM_40_0_Upm 0 10200
 /begin AXIS_DESCR FIX_AXIS NO_INPUT_QUANTITY CM_IDENTITY 16 0 15 FIX_AXIS_PAR_DIST 0 1 16 /end AXIS_DESCR
/end CHARACTERISTIC
/begin CHARACTERISTIC SNM16OPUB "podtverzhdena damos addr 0x100F3" CURVE 0x100F3 RL_GRID_UBYTE 0 CM_40_0_Upm 0 10200
 /begin AXIS_DESCR FIX_AXIS NO_INPUT_QUANTITY CM_IDENTITY 16 0 15 FIX_AXIS_PAR_DIST 0 1 16 /end AXIS_DESCR
/end CHARACTERISTIC
/begin CHARACTERISTIC SNM16ZUUB "podtverzhdena damos addr 0x10104 | datapoint distribution engine speed, 16 datapoints" CURVE 0x10104 RL_GRID_UBYTE 0 CM_40_0_Upm 0 10200
 /begin AXIS_DESCR FIX_AXIS NO_INPUT_QUANTITY CM_IDENTITY 16 0 15 FIX_AXIS_PAR_DIST 0 1 16 /end AXIS_DESCR
/end CHARACTERISTIC
/begin CHARACTERISTIC SNM24ZUUB "podtverzhdena damos addr 0x10115 | datapoint distribution of engine speed, 24 datapoints" CURVE 0x10115 RL_GRID_UBYTE 0 CM_40_0_Upm 0 10200
 /begin AXIS_DESCR FIX_AXIS NO_INPUT_QUANTITY CM_IDENTITY 24 0 23 FIX_AXIS_PAR_DIST 0 1 24 /end AXIS_DESCR
/end CHARACTERISTIC
/begin CHARACTERISTIC SQM05TEUB "podtverzhdena damos addr 0x1012E | air mass quotient dependet basic point (number =5)" CURVE 0x1012E RL_GRID_UBYTE 0 CM_0p0625_0 0 15.9375
 /begin AXIS_DESCR FIX_AXIS NO_INPUT_QUANTITY CM_IDENTITY 5 0 4 FIX_AXIS_PAR_DIST 0 1 5 /end AXIS_DESCR
/end CHARACTERISTIC
/begin CHARACTERISTIC SRL06LHUB "podtverzhdena damos addr 0x10134" CURVE 0x10134 RL_GRID_UBYTE 0 CM_0p75_0 0 191.25
 /begin AXIS_DESCR FIX_AXIS NO_INPUT_QUANTITY CM_IDENTITY 6 0 5 FIX_AXIS_PAR_DIST 0 1 6 /end AXIS_DESCR
/end CHARACTERISTIC
/begin CHARACTERISTIC SRL06LRUB "podtverzhdena damos addr 0x1013B" CURVE 0x1013B RL_GRID_UBYTE 0 CM_0p75_0 0 191.25
 /begin AXIS_DESCR FIX_AXIS NO_INPUT_QUANTITY CM_IDENTITY 6 0 5 FIX_AXIS_PAR_DIST 0 1 6 /end AXIS_DESCR
/end CHARACTERISTIC
/begin CHARACTERISTIC SRL08DMUB "podtverzhdena damos addr 0x10142" CURVE 0x10142 RL_GRID_UBYTE 0 CM_0p75_0 0 191.25
 /begin AXIS_DESCR FIX_AXIS NO_INPUT_QUANTITY CM_IDENTITY 8 0 7 FIX_AXIS_PAR_DIST 0 1 8 /end AXIS_DESCR
/end CHARACTERISTIC
/begin CHARACTERISTIC SRL12ESUB "podtverzhdena damos addr 0x1014B | Distribution for the relative air charge rl" CURVE 0x1014B RL_GRID_UBYTE 0 CM_0p75_0 0 191.25
 /begin AXIS_DESCR FIX_AXIS NO_INPUT_QUANTITY CM_IDENTITY 12 0 11 FIX_AXIS_PAR_DIST 0 1 12 /end AXIS_DESCR
/end CHARACTERISTIC
/begin CHARACTERISTIC SRL12ZUUB "podtverzhdena damos addr 0x10158 | datapoint distribution relative air charge, 12 datapoints" CURVE 0x10158 RL_GRID_UBYTE 0 CM_0p75_0 0 191.25
 /begin AXIS_DESCR FIX_AXIS NO_INPUT_QUANTITY CM_IDENTITY 12 0 11 FIX_AXIS_PAR_DIST 0 1 12 /end AXIS_DESCR
/end CHARACTERISTIC
/begin CHARACTERISTIC SRL16ZUUB "podtverzhdena damos addr 0x10165 | datapoint distribution relative charge, 16 datapoints" CURVE 0x10165 RL_GRID_UBYTE 0 CM_0p75_0 0 191.25
 /begin AXIS_DESCR FIX_AXIS NO_INPUT_QUANTITY CM_IDENTITY 16 0 15 FIX_AXIS_PAR_DIST 0 1 16 /end AXIS_DESCR
/end CHARACTERISTIC
/begin CHARACTERISTIC STM12ESUB "podtverzhdena damos addr 0x10176 | Distribution for the engine coolant temperature tmot" CURVE 0x10176 RL_GRID_UBYTE 0 CM_0p75_48_GradC -48 143.25
 /begin AXIS_DESCR FIX_AXIS NO_INPUT_QUANTITY CM_IDENTITY 12 0 11 FIX_AXIS_PAR_DIST 0 1 12 /end AXIS_DESCR
/end CHARACTERISTIC
/begin CHARACTERISTIC SBF02MFSB "podtverzhdena damos addr 0x1062A" CURVE 0x1062A RL_GRID_SBYTE 0 CM_0p217_0_ms2 -27.776 27.559
 /begin AXIS_DESCR FIX_AXIS NO_INPUT_QUANTITY CM_IDENTITY 2 0 1 FIX_AXIS_PAR_DIST 0 1 2 /end AXIS_DESCR
/end CHARACTERISTIC
/begin CHARACTERISTIC FSWALUV "adres podtverzhden damos-veroyatno addr 0x10631 | IMYA NE PODTVERZHDENO, adres: kod: mov r12, #0x630 @0x83C672 | rough road detection threshold = f (vehicle speed)" CURVE 0x10631 RL_GRID_UBYTE 0 CM_0p09803921569_0 0 25
 /begin AXIS_DESCR FIX_AXIS NO_INPUT_QUANTITY CM_IDENTITY 4 0 3 FIX_AXIS_PAR_DIST 0 1 4 /end AXIS_DESCR
/end CHARACTERISTIC
/begin CHARACTERISTIC FUGKUE "adres podtverzhden damos-veroyatno addr 0x10639 | IMYA NE PODTVERZHDENO, adres: kod: movb RL5, [r4+#0x639] @0x83C9AA | Gear box ratio detection" CURVE 0x10639 RL_GRID_UBYTE 0 CM_IDENTITY 0 255
 /begin AXIS_DESCR FIX_AXIS NO_INPUT_QUANTITY CM_IDENTITY 255 0 254 FIX_AXIS_PAR_DIST 0 1 255 /end AXIS_DESCR
/end CHARACTERISTIC
/begin CHARACTERISTIC MAP_056_10D9A_6 "veroyatnaya mapscan addr 0x10D9A" CURVE 0x10D9A RL_2D_A16_UWORD 0 CM_IDENTITY 0 65535 /begin AXIS_DESCR STD_AXIS NO_INPUT_QUANTITY CM_IDENTITY 6 0 65535 /end AXIS_DESCR /end CHARACTERISTIC
/begin CHARACTERISTIC SNS06LLSB "adres podtverzhden damos-veroyatno addr 0x10F02 | IMYA NE PODTVERZHDENO, adres: kod: mov r12, #0xf01 @0x83F1DE | Datapoint distribution, set-speed deviation, 06 datapoints., idle-speed control." CURVE 0x10F02 RL_GRID_SBYTE 0 CM_10_0_Umin -1280 1270
 /begin AXIS_DESCR FIX_AXIS NO_INPUT_QUANTITY CM_IDENTITY 6 0 5 FIX_AXIS_PAR_DIST 0 1 6 /end AXIS_DESCR
/end CHARACTERISTIC
/begin CHARACTERISTIC SDN06LLSB "adres podtverzhden damos-veroyatno addr 0x10F90 | IMYA NE PODTVERZHDENO, adres: kod: mov r12, #0xf8f @0x83F266 | 10 Sst." CURVE 0x10F90 RL_GRID_SBYTE 0 CM_10_0_Umin -1280 1270
 /begin AXIS_DESCR FIX_AXIS NO_INPUT_QUANTITY CM_IDENTITY 6 0 5 FIX_AXIS_PAR_DIST 0 1 6 /end AXIS_DESCR
/end CHARACTERISTIC
/begin CHARACTERISTIC PLRHAV "neodnoznachnaya damos-somnitelno addr 0x111F1 | Weighting factor of P-part LRHK depending on catalyst age" CURVE 0x111F1 RL_GRID_UBYTE 0 CM_0p00390625_0 0 0.996094
 /begin AXIS_DESCR FIX_AXIS NO_INPUT_QUANTITY CM_IDENTITY 8 0 7 FIX_AXIS_PAR_DIST 0 1 8 /end AXIS_DESCR
/end CHARACTERISTIC
/begin CHARACTERISTIC MAP_115_112C2_14 "adres podtverzhden mapscan addr 0x112C2 | IMYA NE PODTVERZHDENO, adres: kod: mov r12, #0x12c1 @0x842B94" CURVE 0x112C2 RL_2D_A8_UBYTE 0 CM_IDENTITY 0 255 /begin AXIS_DESCR STD_AXIS NO_INPUT_QUANTITY CM_IDENTITY 14 0 255 /end AXIS_DESCR /end CHARACTERISTIC
/begin CHARACTERISTIC MAP_120_11567_8 "adres podtverzhden mapscan addr 0x11567 | IMYA NE PODTVERZHDENO, adres: kod: mov r12, #0x1567 @0x842BFE" CURVE 0x11567 RL_2D_A8_UBYTE 0 CM_IDENTITY 0 255 /begin AXIS_DESCR STD_AXIS NO_INPUT_QUANTITY CM_IDENTITY 8 0 255 /end AXIS_DESCR /end CHARACTERISTIC
/begin CHARACTERISTIC MAP_123_11595_8 "adres podtverzhden mapscan addr 0x11595 | IMYA NE PODTVERZHDENO, adres: kod: mov r12, #0x1595 @0x845110" CURVE 0x11595 RL_2D_A8_UBYTE 0 CM_IDENTITY 0 255 /begin AXIS_DESCR STD_AXIS NO_INPUT_QUANTITY CM_IDENTITY 8 0 255 /end AXIS_DESCR /end CHARACTERISTIC
/begin CHARACTERISTIC MAP_124_115EC_7 "adres podtverzhden mapscan addr 0x115EC | IMYA NE PODTVERZHDENO, adres: kod: mov r12, #0x15ec @0x84AD12" CURVE 0x115EC RL_2D_A8_UBYTE 0 CM_IDENTITY 0 255 /begin AXIS_DESCR STD_AXIS NO_INPUT_QUANTITY CM_IDENTITY 7 0 255 /end AXIS_DESCR /end CHARACTERISTIC
/begin CHARACTERISTIC MAP_125_115FB_7 "veroyatnaya mapscan addr 0x115FB" CURVE 0x115FB RL_2D_A8_UBYTE 0 CM_IDENTITY 0 255 /begin AXIS_DESCR STD_AXIS NO_INPUT_QUANTITY CM_IDENTITY 7 0 255 /end AXIS_DESCR /end CHARACTERISTIC
/begin CHARACTERISTIC FAGRH "veroyatnaya damos-veroyatno addr 0x11612 | altitude correction of EGR set value" CURVE 0x11612 RL_GRID_UBYTE 0 CM_0p0078125_0 0 1.99219
 /begin AXIS_DESCR FIX_AXIS NO_INPUT_QUANTITY CM_IDENTITY 4 0 3 FIX_AXIS_PAR_DIST 0 1 4 /end AXIS_DESCR
/end CHARACTERISTIC
/begin CHARACTERISTIC MAP_127_11616_8 "adres podtverzhden mapscan addr 0x11616 | IMYA NE PODTVERZHDENO, adres: kod: mov r12, #0x1616 @0x84C188" CURVE 0x11616 RL_2D_A8_UBYTE 0 CM_IDENTITY 0 255 /begin AXIS_DESCR STD_AXIS NO_INPUT_QUANTITY CM_IDENTITY 8 0 255 /end AXIS_DESCR /end CHARACTERISTIC
/begin CHARACTERISTIC MAP_128_11673_6 "adres podtverzhden mapscan addr 0x11673 | IMYA NE PODTVERZHDENO, adres: kod: mov r12, #0x1673 @0x850670" CURVE 0x11673 RL_2D_A8_UBYTE 0 CM_IDENTITY 0 255 /begin AXIS_DESCR STD_AXIS NO_INPUT_QUANTITY CM_IDENTITY 6 0 255 /end AXIS_DESCR /end CHARACTERISTIC
/begin CHARACTERISTIC MAP_132_116E5_4 "adres podtverzhden mapscan addr 0x116E5 | IMYA NE PODTVERZHDENO, adres: kod: mov r12, #0x16e4 @0x851A3E" CURVE 0x116E5 RL_2D_A8_UBYTE 0 CM_IDENTITY 0 255 /begin AXIS_DESCR STD_AXIS NO_INPUT_QUANTITY CM_IDENTITY 4 0 255 /end AXIS_DESCR /end CHARACTERISTIC
/begin CHARACTERISTIC MAP_134_11986_5x6 "adres podtverzhden mapscan addr 0x11986 | IMYA NE PODTVERZHDENO, adres: kod: mov r12, #0x1985 @0x855EC2" MAP 0x11986 RL_3D_A8_UBYTE 0 CM_IDENTITY 0 255 /begin AXIS_DESCR STD_AXIS NO_INPUT_QUANTITY CM_IDENTITY 6 0 255 /end AXIS_DESCR /begin AXIS_DESCR STD_AXIS NO_INPUT_QUANTITY CM_IDENTITY 5 0 255 /end AXIS_DESCR /end CHARACTERISTIC
/begin CHARACTERISTIC MAP_137_11A1A_6 "adres podtverzhden mapscan addr 0x11A1A | IMYA NE PODTVERZHDENO, adres: kod: mov r12, #0x1a1a @0x8572A2" CURVE 0x11A1A RL_2D_A8_UBYTE 0 CM_IDENTITY 0 255 /begin AXIS_DESCR STD_AXIS NO_INPUT_QUANTITY CM_IDENTITY 6 0 255 /end AXIS_DESCR /end CHARACTERISTIC
/begin CHARACTERISTIC MAP_139_11A40_10x10 "adres podtverzhden mapscan addr 0x11A40 | IMYA NE PODTVERZHDENO, adres: kod: mov r12, #0x1a40 @0x858D00" MAP 0x11A40 RL_3D_A8_UBYTE 0 CM_IDENTITY 0 255 /begin AXIS_DESCR STD_AXIS NO_INPUT_QUANTITY CM_IDENTITY 10 0 255 /end AXIS_DESCR /begin AXIS_DESCR STD_AXIS NO_INPUT_QUANTITY CM_IDENTITY 10 0 255 /end AXIS_DESCR /end CHARACTERISTIC
/begin CHARACTERISTIC FFTEV6 "adres podtverzhden damos-veroyatno addr 0x11ABB | IMYA NE PODTVERZHDENO, adres: kod: movbz r4, 0x1abb @0x859B1E | freeze frame table: injector power stage 6" CURVE 0x11ABB RL_GRID_UBYTE 0 CM_IDENTITY 0 255
 /begin AXIS_DESCR FIX_AXIS NO_INPUT_QUANTITY CM_IDENTITY 2 0 1 FIX_AXIS_PAR_DIST 0 1 2 /end AXIS_DESCR
/end CHARACTERISTIC
/begin CHARACTERISTIC FFTFRAO "adres podtverzhden damos-veroyatno addr 0x11ABD | IMYA NE PODTVERZHDENO, adres: kod: movbz r13, 0x1abd @0x859DB4 | freeze frame table: FRAO mixture adaptation" CURVE 0x11ABD RL_GRID_UBYTE 0 CM_IDENTITY 0 255
 /begin AXIS_DESCR FIX_AXIS NO_INPUT_QUANTITY CM_IDENTITY 2 0 1 FIX_AXIS_PAR_DIST 0 1 2 /end AXIS_DESCR
/end CHARACTERISTIC
/begin CHARACTERISTIC FFTFRAU "adres podtverzhden damos-veroyatno addr 0x11ABF | IMYA NE PODTVERZHDENO, adres: kod: movbz r13, 0x1abf @0x859D2A | freeze frame table: FRAU mixture adaptation" CURVE 0x11ABF RL_GRID_UBYTE 0 CM_IDENTITY 0 255
 /begin AXIS_DESCR FIX_AXIS NO_INPUT_QUANTITY CM_IDENTITY 2 0 1 FIX_AXIS_PAR_DIST 0 1 2 /end AXIS_DESCR
/end CHARACTERISTIC
/begin CHARACTERISTIC FFTFRST "adres podtverzhden damos-veroyatno addr 0x11AC1 | IMYA NE PODTVERZHDENO, adres: kod: movbz r13, 0x1ac1 @0x859D86 | freeze frame table: deviation of lambda loop control" CURVE 0x11AC1 RL_GRID_UBYTE 0 CM_IDENTITY 0 255
 /begin AXIS_DESCR FIX_AXIS NO_INPUT_QUANTITY CM_IDENTITY 2 0 1 FIX_AXIS_PAR_DIST 0 1 2 /end AXIS_DESCR
/end CHARACTERISTIC
/begin CHARACTERISTIC FFTGE "adres podtverzhden damos-veroyatno addr 0x11AC3 | IMYA NE PODTVERZHDENO, adres: kod: mov r12, #0x1ac2 @0x859F5E | freeze frame table: transmission intervention" CURVE 0x11AC3 RL_GRID_UBYTE 0 CM_IDENTITY 0 255
 /begin AXIS_DESCR FIX_AXIS NO_INPUT_QUANTITY CM_IDENTITY 2 0 1 FIX_AXIS_PAR_DIST 0 1 2 /end AXIS_DESCR
/end CHARACTERISTIC
/begin CHARACTERISTIC FFTHSH "adres podtverzhden damos-veroyatno addr 0x11AC5 | IMYA NE PODTVERZHDENO, adres: kod: cmpb RL3, 0x1ac5 @0x86175C | Table of ambient condition for heating O2-sensor post cat" CURVE 0x11AC5 RL_GRID_UBYTE 0 CM_IDENTITY 0 255
 /begin AXIS_DESCR FIX_AXIS NO_INPUT_QUANTITY CM_IDENTITY 2 0 1 FIX_AXIS_PAR_DIST 0 1 2 /end AXIS_DESCR
/end CHARACTERISTIC
/begin CHARACTERISTIC FFTHSHE "adres podtverzhden damos-veroyatno addr 0x11AC7 | IMYA NE PODTVERZHDENO, adres: kod: movb RL4, 0x1ac7 @0x8615BE | Table of environmental cond.for output stage heating lambda sens. downstr.of cat" CURVE 0x11AC7 RL_GRID_UBYTE 0 CM_IDENTITY 0 255
 /begin AXIS_DESCR FIX_AXIS NO_INPUT_QUANTITY CM_IDENTITY 2 0 1 FIX_AXIS_PAR_DIST 0 1 2 /end AXIS_DESCR
/end CHARACTERISTIC
/begin CHARACTERISTIC FFTHSV "adres podtverzhden damos-veroyatno addr 0x11AC9 | IMYA NE PODTVERZHDENO, adres: kod: cmpb RL4, 0x1ac9 @0x861740 | Table of ambient condition for heating O2-sensor pre cat" CURVE 0x11AC9 RL_GRID_UBYTE 0 CM_IDENTITY 0 255
 /begin AXIS_DESCR FIX_AXIS NO_INPUT_QUANTITY CM_IDENTITY 2 0 1 FIX_AXIS_PAR_DIST 0 1 2 /end AXIS_DESCR
/end CHARACTERISTIC
/begin CHARACTERISTIC FFTHSVE "adres podtverzhden damos-veroyatno addr 0x11ACB | IMYA NE PODTVERZHDENO, adres: kod: mov r12, #0x1acb @0x859F74 | Freeze frame table: 02 Sensor Heater power stage" CURVE 0x11ACB RL_GRID_UBYTE 0 CM_IDENTITY 0 255
 /begin AXIS_DESCR FIX_AXIS NO_INPUT_QUANTITY CM_IDENTITY 2 0 1 FIX_AXIS_PAR_DIST 0 1 2 /end AXIS_DESCR
/end CHARACTERISTIC
/begin CHARACTERISTIC FFTKAT "adres podtverzhden damos-veroyatno addr 0x11ACD | IMYA NE PODTVERZHDENO, adres: kod: cmpb RL1, 0x1acd @0x861778 | Freeze frame table: catalyst" CURVE 0x11ACD RL_GRID_UBYTE 0 CM_IDENTITY 0 255
 /begin AXIS_DESCR FIX_AXIS NO_INPUT_QUANTITY CM_IDENTITY 2 0 1 FIX_AXIS_PAR_DIST 0 1 2 /end AXIS_DESCR
/end CHARACTERISTIC
/begin CHARACTERISTIC FFTKOSE "adres podtverzhden damos-veroyatno addr 0x11ACF | IMYA NE PODTVERZHDENO, adres: kod: movb RL5, 0x1acf @0x8641EC | Freeze frame table: A/C compressor control power stage" CURVE 0x11ACF RL_GRID_UBYTE 0 CM_IDENTITY 0 255
 /begin AXIS_DESCR FIX_AXIS NO_INPUT_QUANTITY CM_IDENTITY 2 0 1 FIX_AXIS_PAR_DIST 0 1 2 /end AXIS_DESCR
/end CHARACTERISTIC
/begin CHARACTERISTIC FFTKPE "adres podtverzhden damos-veroyatno addr 0x11AD1 | IMYA NE PODTVERZHDENO, adres: kod: movb RL4, 0x1ad1 @0x866212 | Freeze frame table: fuel pump relay power stage" CURVE 0x11AD1 RL_GRID_UBYTE 0 CM_IDENTITY 0 255
 /begin AXIS_DESCR FIX_AXIS NO_INPUT_QUANTITY CM_IDENTITY 2 0 1 FIX_AXIS_PAR_DIST 0 1 2 /end AXIS_DESCR
/end CHARACTERISTIC
/begin CHARACTERISTIC MAP_152_11AD4_16x12 "adres podtverzhden mapscan addr 0x11AD4 | IMYA NE PODTVERZHDENO, adres: kod: mov r12, #0x1ad4 @0x859F38" MAP 0x11AD4 RL_3D_A8_UWORD 0 CM_IDENTITY 0 65535 /begin AXIS_DESCR STD_AXIS NO_INPUT_QUANTITY CM_IDENTITY 12 0 255 /end AXIS_DESCR /begin AXIS_DESCR STD_AXIS NO_INPUT_QUANTITY CM_IDENTITY 16 0 255 /end AXIS_DESCR /end CHARACTERISTIC
/begin CHARACTERISTIC KFLUAR2 "somnitelnaya damos-somnitelno addr 0x11CB0 | map for engine roughness distance reference value" MAP 0x11CB0 RL_GRID_UBYTE 0 CM_IDENTITY 0 255
 /begin AXIS_DESCR FIX_AXIS NO_INPUT_QUANTITY CM_IDENTITY 8 0 7 FIX_AXIS_PAR_DIST 0 1 8 /end AXIS_DESCR
 /begin AXIS_DESCR FIX_AXIS NO_INPUT_QUANTITY CM_IDENTITY 8 0 7 FIX_AXIS_PAR_DIST 0 1 8 /end AXIS_DESCR
/end CHARACTERISTIC
/begin CHARACTERISTIC KFLUARZ "somnitelnaya damos-somnitelno addr 0x11CF0 | map for engine roughness distance reference value at ZAS (cylinder cut-off)" MAP 0x11CF0 RL_GRID_UBYTE 0 CM_IDENTITY 0 255
 /begin AXIS_DESCR FIX_AXIS NO_INPUT_QUANTITY CM_IDENTITY 8 0 7 FIX_AXIS_PAR_DIST 0 1 8 /end AXIS_DESCR
 /begin AXIS_DESCR FIX_AXIS NO_INPUT_QUANTITY CM_IDENTITY 8 0 7 FIX_AXIS_PAR_DIST 0 1 8 /end AXIS_DESCR
/end CHARACTERISTIC
/begin CHARACTERISTIC DLURMIN "veroyatnaya damos-veroyatno addr 0x11D30 | speed dependensy of engine roughness referenz minimum value 1" CURVE 0x11D30 RL_GRID_SBYTE 0 CM_IDENTITY -128 127
 /begin AXIS_DESCR FIX_AXIS NO_INPUT_QUANTITY CM_IDENTITY 8 0 7 FIX_AXIS_PAR_DIST 0 1 8 /end AXIS_DESCR
/end CHARACTERISTIC
/begin CHARACTERISTIC KFDLUR2 "somnitelnaya damos-somnitelno addr 0x11DF9 | map engine roughness difference dluts referenz value" MAP 0x11DF9 RL_GRID_SBYTE 0 CM_IDENTITY -128 127
 /begin AXIS_DESCR FIX_AXIS NO_INPUT_QUANTITY CM_IDENTITY 8 0 7 FIX_AXIS_PAR_DIST 0 1 8 /end AXIS_DESCR
 /begin AXIS_DESCR FIX_AXIS NO_INPUT_QUANTITY CM_IDENTITY 8 0 7 FIX_AXIS_PAR_DIST 0 1 8 /end AXIS_DESCR
/end CHARACTERISTIC
/begin CHARACTERISTIC KFDLURZ "podtverzhdena damos-tochno addr 0x11E39 | map engine roughness difference dluts referenz value at ZAS (cylinder cut-off)" MAP 0x11E39 RL_GRID_SBYTE 0 CM_IDENTITY -128 127
 /begin AXIS_DESCR FIX_AXIS NO_INPUT_QUANTITY CM_IDENTITY 8 0 7 FIX_AXIS_PAR_DIST 0 1 8 /end AXIS_DESCR
 /begin AXIS_DESCR FIX_AXIS NO_INPUT_QUANTITY CM_IDENTITY 8 0 7 FIX_AXIS_PAR_DIST 0 1 8 /end AXIS_DESCR
/end CHARACTERISTIC
/begin CHARACTERISTIC ANALUN "adres podtverzhden damos-veroyatno addr 0x11E91 | IMYA NE PODTVERZHDENO, adres: kod: mov r4, #0x1e90 @0x869A04 | number of combustions for deactivation after detected misfire" CURVE 0x11E91 RL_GRID_UBYTE 0 CM_IDENTITY 0 255
 /begin AXIS_DESCR FIX_AXIS NO_INPUT_QUANTITY CM_IDENTITY 8 0 7 FIX_AXIS_PAR_DIST 0 1 8 /end AXIS_DESCR
/end CHARACTERISTIC
/begin CHARACTERISTIC KFLURB1 "somnitelnaya damos-somnitelno addr 0x11FDE | map for engine roughness - reference base value" MAP 0x11FDE RL_GRID_SBYTE 0 CM_IDENTITY -128 127
 /begin AXIS_DESCR FIX_AXIS NO_INPUT_QUANTITY CM_IDENTITY 8 0 7 FIX_AXIS_PAR_DIST 0 1 8 /end AXIS_DESCR
 /begin AXIS_DESCR FIX_AXIS NO_INPUT_QUANTITY CM_IDENTITY 8 0 7 FIX_AXIS_PAR_DIST 0 1 8 /end AXIS_DESCR
/end CHARACTERISTIC
/begin CHARACTERISTIC KFLURB2 "veroyatnaya damos-veroyatno addr 0x1201E | map for engine roughness - reference base value" MAP 0x1201E RL_GRID_SBYTE 0 CM_IDENTITY -128 127
 /begin AXIS_DESCR FIX_AXIS NO_INPUT_QUANTITY CM_IDENTITY 8 0 7 FIX_AXIS_PAR_DIST 0 1 8 /end AXIS_DESCR
 /begin AXIS_DESCR FIX_AXIS NO_INPUT_QUANTITY CM_IDENTITY 8 0 7 FIX_AXIS_PAR_DIST 0 1 8 /end AXIS_DESCR
/end CHARACTERISTIC
/begin CHARACTERISTIC KFLURBZ "somnitelnaya damos-somnitelno addr 0x1205E | map for engine roughness base value, in case of ZAS" MAP 0x1205E RL_GRID_SBYTE 0 CM_IDENTITY -128 127
 /begin AXIS_DESCR FIX_AXIS NO_INPUT_QUANTITY CM_IDENTITY 8 0 7 FIX_AXIS_PAR_DIST 0 1 8 /end AXIS_DESCR
 /begin AXIS_DESCR FIX_AXIS NO_INPUT_QUANTITY CM_IDENTITY 8 0 7 FIX_AXIS_PAR_DIST 0 1 8 /end AXIS_DESCR
/end CHARACTERISTIC
/begin CHARACTERISTIC KFLURM1 "podtverzhdena damos-tochno addr 0x1211E | reference base value map for engine roughness for misfire detection" MAP 0x1211E RL_GRID_SBYTE 0 CM_IDENTITY -128 127
 /begin AXIS_DESCR FIX_AXIS NO_INPUT_QUANTITY CM_IDENTITY 8 0 7 FIX_AXIS_PAR_DIST 0 1 8 /end AXIS_DESCR
 /begin AXIS_DESCR FIX_AXIS NO_INPUT_QUANTITY CM_IDENTITY 8 0 7 FIX_AXIS_PAR_DIST 0 1 8 /end AXIS_DESCR
/end CHARACTERISTIC
/begin CHARACTERISTIC LURKTM "veroyatnaya damos-veroyatno addr 0x1215E | Tmot-dependent engine roughness reference correcting value" CURVE 0x1215E RL_GRID_SBYTE 0 CM_IDENTITY -128 127
 /begin AXIS_DESCR FIX_AXIS NO_INPUT_QUANTITY CM_IDENTITY 8 0 7 FIX_AXIS_PAR_DIST 0 1 8 /end AXIS_DESCR
/end CHARACTERISTIC
/begin CHARACTERISTIC LURMIN1 "veroyatnaya damos-veroyatno addr 0x12166 | speed dependensy of engine roughness referenz minimum value 1" CURVE 0x12166 RL_GRID_SBYTE 0 CM_IDENTITY -128 127
 /begin AXIS_DESCR FIX_AXIS NO_INPUT_QUANTITY CM_IDENTITY 8 0 7 FIX_AXIS_PAR_DIST 0 1 8 /end AXIS_DESCR
/end CHARACTERISTIC
/begin CHARACTERISTIC LURMIN2 "veroyatnaya damos-veroyatno addr 0x1216E | speed dependensy of engine roughness referenz minimum value 2" CURVE 0x1216E RL_GRID_SBYTE 0 CM_IDENTITY -128 127
 /begin AXIS_DESCR FIX_AXIS NO_INPUT_QUANTITY CM_IDENTITY 8 0 7 FIX_AXIS_PAR_DIST 0 1 8 /end AXIS_DESCR
/end CHARACTERISTIC
/begin CHARACTERISTIC LURMIN3 "veroyatnaya damos-veroyatno addr 0x12176 | speed dependensy of engine roughness referenz minimum value 3" CURVE 0x12176 RL_GRID_SBYTE 0 CM_IDENTITY -128 127
 /begin AXIS_DESCR FIX_AXIS NO_INPUT_QUANTITY CM_IDENTITY 8 0 7 FIX_AXIS_PAR_DIST 0 1 8 /end AXIS_DESCR
/end CHARACTERISTIC
/begin CHARACTERISTIC KFKSWF "veroyatnaya damos-veroyatno addr 0x12192 | map for catalyst protection, weighting factors" MAP 0x12192 RL_GRID_UBYTE 0 CM_IDENTITY 0 255
 /begin AXIS_DESCR FIX_AXIS NO_INPUT_QUANTITY CM_IDENTITY 6 0 5 FIX_AXIS_PAR_DIST 0 1 6 /end AXIS_DESCR
 /begin AXIS_DESCR FIX_AXIS NO_INPUT_QUANTITY CM_IDENTITY 6 0 5 FIX_AXIS_PAR_DIST 0 1 6 /end AXIS_DESCR
/end CHARACTERISTIC
/begin CHARACTERISTIC MAP_171_124D4_6 "adres podtverzhden mapscan addr 0x124D4 | IMYA NE PODTVERZHDENO, adres: kod: mov r12, #0x24d3 @0x868944" CURVE 0x124D4 RL_2D_A8_UBYTE 0 CM_IDENTITY 0 255 /begin AXIS_DESCR STD_AXIS NO_INPUT_QUANTITY CM_IDENTITY 6 0 255 /end AXIS_DESCR /end CHARACTERISTIC
/begin CHARACTERISTIC MAP_172_128BD_21 "adres podtverzhden mapscan addr 0x128BD | IMYA NE PODTVERZHDENO, adres: kod: add r4, #0x28e8 @0x84CA72" CURVE 0x128BD RL_2D_A16_UWORD 0 CM_IDENTITY 0 65535 /begin AXIS_DESCR STD_AXIS NO_INPUT_QUANTITY CM_IDENTITY 21 0 65535 /end AXIS_DESCR /end CHARACTERISTIC
/begin CHARACTERISTIC SAN12ESUW "veroyatnaya damos-veroyatno addr 0x148B8 | Distribution for the limited injection counter anztib_w" CURVE 0x148B8 RL_GRID_UBYTE 0 CM_IDENTITY 0 255
 /begin AXIS_DESCR FIX_AXIS NO_INPUT_QUANTITY CM_IDENTITY 12 0 11 FIX_AXIS_PAR_DIST 0 1 12 /end AXIS_DESCR
/end CHARACTERISTIC
/begin CHARACTERISTIC MAP_175_14915_6 "veroyatnaya mapscan addr 0x14915" CURVE 0x14915 RL_2D_A16_UWORD 0 CM_IDENTITY 0 65535 /begin AXIS_DESCR STD_AXIS NO_INPUT_QUANTITY CM_IDENTITY 6 0 65535 /end AXIS_DESCR /end CHARACTERISTIC
/begin CHARACTERISTIC MAP_181_14998_10 "veroyatnaya mapscan addr 0x14998" CURVE 0x14998 RL_2D_A8_UWORD 0 CM_IDENTITY 0 65535 /begin AXIS_DESCR STD_AXIS NO_INPUT_QUANTITY CM_IDENTITY 10 0 255 /end AXIS_DESCR /end CHARACTERISTIC
/begin CHARACTERISTIC MAP_182_149B8_10 "veroyatnaya mapscan addr 0x149B8" CURVE 0x149B8 RL_2D_A8_UWORD 0 CM_IDENTITY 0 65535 /begin AXIS_DESCR STD_AXIS NO_INPUT_QUANTITY CM_IDENTITY 10 0 255 /end AXIS_DESCR /end CHARACTERISTIC
/begin CHARACTERISTIC MAP_183_149D8_10 "adres podtverzhden mapscan addr 0x149D8 | IMYA NE PODTVERZHDENO, adres: kod: mov r14, #0x49e3 @0x83B654" CURVE 0x149D8 RL_2D_A8_UWORD 0 CM_IDENTITY 0 65535 /begin AXIS_DESCR STD_AXIS NO_INPUT_QUANTITY CM_IDENTITY 10 0 255 /end AXIS_DESCR /end CHARACTERISTIC
/begin CHARACTERISTIC MAP_189_14BC5_12 "veroyatnaya mapscan addr 0x14BC5" CURVE 0x14BC5 RL_2D_A16_UWORD 0 CM_IDENTITY 0 65535 /begin AXIS_DESCR STD_AXIS NO_INPUT_QUANTITY CM_IDENTITY 12 0 65535 /end AXIS_DESCR /end CHARACTERISTIC
/begin CHARACTERISTIC SRL03MFUW "adres podtverzhden damos-veroyatno addr 0x14D7A | IMYA NE PODTVERZHDENO, adres: kod: mov r12, #0x4d78 @0x83C3B2" CURVE 0x14D7A RL_GRID_UBYTE 0 CM_0p0234375_0 0 5.97656
 /begin AXIS_DESCR FIX_AXIS NO_INPUT_QUANTITY CM_IDENTITY 3 0 2 FIX_AXIS_PAR_DIST 0 1 3 /end AXIS_DESCR
/end CHARACTERISTIC
/begin CHARACTERISTIC MAP_208_14F60_8 "veroyatnaya mapscan addr 0x14F60" CURVE 0x14F60 RL_2D_A8_UWORD 0 CM_IDENTITY 0 65535 /begin AXIS_DESCR STD_AXIS NO_INPUT_QUANTITY CM_IDENTITY 8 0 255 /end AXIS_DESCR /end CHARACTERISTIC
/begin CHARACTERISTIC MAP_209_14F7F_6 "veroyatnaya mapscan addr 0x14F7F" CURVE 0x14F7F RL_2D_A8_UBYTE 0 CM_IDENTITY 0 255 /begin AXIS_DESCR STD_AXIS NO_INPUT_QUANTITY CM_IDENTITY 6 0 255 /end AXIS_DESCR /end CHARACTERISTIC
/begin CHARACTERISTIC MAP_211_14FF7_5 "adres podtverzhden mapscan addr 0x14FF7 | IMYA NE PODTVERZHDENO, adres: kod: mov r13, #0x4ff7 @0x83E4B8" CURVE 0x14FF7 RL_2D_A8_UBYTE 0 CM_IDENTITY 0 255 /begin AXIS_DESCR STD_AXIS NO_INPUT_QUANTITY CM_IDENTITY 5 0 255 /end AXIS_DESCR /end CHARACTERISTIC
/begin CHARACTERISTIC MAP_212_15005_6 "veroyatnaya mapscan addr 0x15005" CURVE 0x15005 RL_2D_A8_UBYTE 0 CM_IDENTITY 0 255 /begin AXIS_DESCR STD_AXIS NO_INPUT_QUANTITY CM_IDENTITY 6 0 255 /end AXIS_DESCR /end CHARACTERISTIC
/begin CHARACTERISTIC MAP_247_15BCB_7 "veroyatnaya mapscan addr 0x15BCB" CURVE 0x15BCB RL_2D_A16_UWORD 0 CM_IDENTITY 0 65535 /begin AXIS_DESCR STD_AXIS NO_INPUT_QUANTITY CM_IDENTITY 7 0 65535 /end AXIS_DESCR /end CHARACTERISTIC
/begin CHARACTERISTIC MAP_248_15C2D_7 "veroyatnaya mapscan addr 0x15C2D" CURVE 0x15C2D RL_2D_A16_UWORD 0 CM_IDENTITY 0 65535 /begin AXIS_DESCR STD_AXIS NO_INPUT_QUANTITY CM_IDENTITY 7 0 65535 /end AXIS_DESCR /end CHARACTERISTIC
/begin CHARACTERISTIC DMSTES "podtverzhdena damos addr 0x15EAB | characteristic line maximum increase of purge mass flow" CURVE 0x15EAB RL_GRID_UBYTE 0 CM_3p2_0_kgh 0 816
 /begin AXIS_DESCR FIX_AXIS NO_INPUT_QUANTITY CM_IDENTITY 6 0 5 FIX_AXIS_PAR_DIST 0 1 6 /end AXIS_DESCR
/end CHARACTERISTIC
/begin CHARACTERISTIC FVERZDYN "veroyatnaya damos-veroyatno addr 0x15EC6 | dynamic factor delay of purge flow in the manifold" CURVE 0x15EC6 RL_GRID_UBYTE 0 CM_5p96En08_0_Min 0 1.5198e-05
 /begin AXIS_DESCR FIX_AXIS NO_INPUT_QUANTITY CM_IDENTITY 5 0 4 FIX_AXIS_PAR_DIST 0 1 5 /end AXIS_DESCR
/end CHARACTERISTIC
/begin CHARACTERISTIC KFTADMS "somnitelnaya damos-somnitelno addr 0x15EDB | dynamic evaluation factor for close off of PCV" MAP 0x15EDB RL_GRID_UBYTE 0 CM_0p0078125_0 0 1.99219
 /begin AXIS_DESCR FIX_AXIS NO_INPUT_QUANTITY CM_IDENTITY 4 0 3 FIX_AXIS_PAR_DIST 0 1 4 /end AXIS_DESCR
 /begin AXIS_DESCR FIX_AXIS NO_INPUT_QUANTITY CM_IDENTITY 5 0 4 FIX_AXIS_PAR_DIST 0 1 5 /end AXIS_DESCR
/end CHARACTERISTIC
/begin CHARACTERISTIC TATEMSN "veroyatnaya damos-veroyatno addr 0x15F14 | characteristic line of the PCV duty-cycle depending on the desired mass-flow" CURVE 0x15F14 RL_GRID_UWORD 0 CM_0p001525878906_0 0 99.9985
 /begin AXIS_DESCR FIX_AXIS NO_INPUT_QUANTITY CM_IDENTITY 10 0 9 FIX_AXIS_PAR_DIST 0 1 10 /end AXIS_DESCR
/end CHARACTERISTIC
/begin CHARACTERISTIC AGREDRLS "podtverzhdena damos addr 0x15F40 | EGR-reduction depending on drlsol" CURVE 0x15F40 RL_GRID_UWORD 0 CM_1p525878906En05_0 0 0.999985
 /begin AXIS_DESCR FIX_AXIS NO_INPUT_QUANTITY CM_IDENTITY 5 0 4 FIX_AXIS_PAR_DIST 0 1 5 /end AXIS_DESCR
/end CHARACTERISTIC
/begin CHARACTERISTIC KLAFTE "adres podtverzhden damos-veroyatno addr 0x15F4C | IMYA NE PODTVERZHDENO, adres: kod: mov r12, [r5+#0x5f4c] @0x8506BE | characteristic of Saint-Venant of purge control valve an line AKF-TEV" CURVE 0x15F4C RL_GRID_UWORD 0 CM_3p051757812En05_0 0 1.99997
 /begin AXIS_DESCR FIX_AXIS NO_INPUT_QUANTITY CM_IDENTITY 14 0 13 FIX_AXIS_PAR_DIST 0 1 14 /end AXIS_DESCR
/end CHARACTERISTIC
/begin CHARACTERISTIC MAP_261_15F88_12 "adres podtverzhden mapscan addr 0x15F88 | IMYA NE PODTVERZHDENO, adres: kod: mov r12, #0x5f88 @0x85182E" CURVE 0x15F88 RL_2D_A16_UWORD 0 CM_IDENTITY 0 65535 /begin AXIS_DESCR STD_AXIS NO_INPUT_QUANTITY CM_IDENTITY 12 0 65535 /end AXIS_DESCR /end CHARACTERISTIC
/begin CHARACTERISTIC CDCAAA "veroyatnaya damos-veroyatno addr 0x15FD1 | Dummy: top of table" CURVE 0x15FD1 RL_GRID_UBYTE 0 CM_IDENTITY 0 255
 /begin AXIS_DESCR FIX_AXIS NO_INPUT_QUANTITY CM_IDENTITY 4 0 3 FIX_AXIS_PAR_DIST 0 1 4 /end AXIS_DESCR
/end CHARACTERISTIC
/begin CHARACTERISTIC CDCAGRF "veroyatnaya damos-veroyatno addr 0x15FD9 | code word CARB: EGR flow monitoring" CURVE 0x15FD9 RL_GRID_UBYTE 0 CM_IDENTITY 0 255
 /begin AXIS_DESCR FIX_AXIS NO_INPUT_QUANTITY CM_IDENTITY 4 0 3 FIX_AXIS_PAR_DIST 0 1 4 /end AXIS_DESCR
/end CHARACTERISTIC
/begin CHARACTERISTIC CDCAGRL "veroyatnaya damos-veroyatno addr 0x15FE1 | code word CARB: EGR valve position sensor" CURVE 0x15FE1 RL_GRID_UBYTE 0 CM_IDENTITY 0 255
 /begin AXIS_DESCR FIX_AXIS NO_INPUT_QUANTITY CM_IDENTITY 4 0 3 FIX_AXIS_PAR_DIST 0 1 4 /end AXIS_DESCR
/end CHARACTERISTIC
/begin CHARACTERISTIC CDCAGRV "veroyatnaya damos-veroyatno addr 0x15FE9 | code word CARB: diagnosis EGR valve" CURVE 0x15FE9 RL_GRID_UBYTE 0 CM_IDENTITY 0 255
 /begin AXIS_DESCR FIX_AXIS NO_INPUT_QUANTITY CM_IDENTITY 4 0 3 FIX_AXIS_PAR_DIST 0 1 4 /end AXIS_DESCR
/end CHARACTERISTIC
/begin CHARACTERISTIC CDCAHC "veroyatnaya damos-veroyatno addr 0x15FF1 | code word CARB: MT/AT encoding" CURVE 0x15FF1 RL_GRID_UBYTE 0 CM_IDENTITY 0 255
 /begin AXIS_DESCR FIX_AXIS NO_INPUT_QUANTITY CM_IDENTITY 4 0 3 FIX_AXIS_PAR_DIST 0 1 4 /end AXIS_DESCR
/end CHARACTERISTIC
/begin CHARACTERISTIC CDCBM "veroyatnaya damos-veroyatno addr 0x15FF9 | code word CARB: reference mark sensor" CURVE 0x15FF9 RL_GRID_UBYTE 0 CM_IDENTITY 0 255
 /begin AXIS_DESCR FIX_AXIS NO_INPUT_QUANTITY CM_IDENTITY 4 0 3 FIX_AXIS_PAR_DIST 0 1 4 /end AXIS_DESCR
/end CHARACTERISTIC
/begin CHARACTERISTIC CDCDK "adres podtverzhden damos-veroyatno addr 0x16001 | IMYA NE PODTVERZHDENO, adres: kod: mov r12, #0x6000 @0x831D08 | code word CARB: throttle position sensor" CURVE 0x16001 RL_GRID_UBYTE 0 CM_IDENTITY 0 255
 /begin AXIS_DESCR FIX_AXIS NO_INPUT_QUANTITY CM_IDENTITY 4 0 3 FIX_AXIS_PAR_DIST 0 1 4 /end AXIS_DESCR
/end CHARACTERISTIC
/begin CHARACTERISTIC CDCDUMMY "veroyatnaya damos-veroyatno addr 0x16009" CURVE 0x16009 RL_GRID_UBYTE 0 CM_IDENTITY 0 255
 /begin AXIS_DESCR FIX_AXIS NO_INPUT_QUANTITY CM_IDENTITY 4 0 3 FIX_AXIS_PAR_DIST 0 1 4 /end AXIS_DESCR
/end CHARACTERISTIC
/begin CHARACTERISTIC CDCEGFE "veroyatnaya damos-veroyatno addr 0x16011 | code word CARB: charge detection" CURVE 0x16011 RL_GRID_UBYTE 0 CM_IDENTITY 0 255
 /begin AXIS_DESCR FIX_AXIS NO_INPUT_QUANTITY CM_IDENTITY 4 0 3 FIX_AXIS_PAR_DIST 0 1 4 /end AXIS_DESCR
/end CHARACTERISTIC
/begin CHARACTERISTIC CDCEV1 "veroyatnaya damos-veroyatno addr 0x16019 | code word CARB: injector 1" CURVE 0x16019 RL_GRID_UBYTE 0 CM_IDENTITY 0 255
 /begin AXIS_DESCR FIX_AXIS NO_INPUT_QUANTITY CM_IDENTITY 4 0 3 FIX_AXIS_PAR_DIST 0 1 4 /end AXIS_DESCR
/end CHARACTERISTIC
/begin CHARACTERISTIC CDCEV2 "veroyatnaya damos-veroyatno addr 0x16021 | code word CARB: injector 2" CURVE 0x16021 RL_GRID_UBYTE 0 CM_IDENTITY 0 255
 /begin AXIS_DESCR FIX_AXIS NO_INPUT_QUANTITY CM_IDENTITY 4 0 3 FIX_AXIS_PAR_DIST 0 1 4 /end AXIS_DESCR
/end CHARACTERISTIC
/begin CHARACTERISTIC CDCEV3 "veroyatnaya damos-veroyatno addr 0x16029 | code word CARB: injector 3" CURVE 0x16029 RL_GRID_UBYTE 0 CM_IDENTITY 0 255
 /begin AXIS_DESCR FIX_AXIS NO_INPUT_QUANTITY CM_IDENTITY 4 0 3 FIX_AXIS_PAR_DIST 0 1 4 /end AXIS_DESCR
/end CHARACTERISTIC
/begin CHARACTERISTIC CDCEV4 "veroyatnaya damos-veroyatno addr 0x16031 | code word CARB: injector 4" CURVE 0x16031 RL_GRID_UBYTE 0 CM_IDENTITY 0 255
 /begin AXIS_DESCR FIX_AXIS NO_INPUT_QUANTITY CM_IDENTITY 4 0 3 FIX_AXIS_PAR_DIST 0 1 4 /end AXIS_DESCR
/end CHARACTERISTIC
/begin CHARACTERISTIC CDCEV5 "veroyatnaya damos-veroyatno addr 0x16039 | code word CARB: injector 5" CURVE 0x16039 RL_GRID_UBYTE 0 CM_IDENTITY 0 255
 /begin AXIS_DESCR FIX_AXIS NO_INPUT_QUANTITY CM_IDENTITY 4 0 3 FIX_AXIS_PAR_DIST 0 1 4 /end AXIS_DESCR
/end CHARACTERISTIC
/begin CHARACTERISTIC CDCEV6 "veroyatnaya damos-veroyatno addr 0x16041 | code word CARB: injector 6" CURVE 0x16041 RL_GRID_UBYTE 0 CM_IDENTITY 0 255
 /begin AXIS_DESCR FIX_AXIS NO_INPUT_QUANTITY CM_IDENTITY 4 0 3 FIX_AXIS_PAR_DIST 0 1 4 /end AXIS_DESCR
/end CHARACTERISTIC
/begin CHARACTERISTIC CDCFRAO "veroyatnaya damos-veroyatno addr 0x16049 | code word CARB: mixture adaptation factor frao" CURVE 0x16049 RL_GRID_UBYTE 0 CM_IDENTITY 0 255
 /begin AXIS_DESCR FIX_AXIS NO_INPUT_QUANTITY CM_IDENTITY 4 0 3 FIX_AXIS_PAR_DIST 0 1 4 /end AXIS_DESCR
/end CHARACTERISTIC
/begin CHARACTERISTIC CDCFRAU "veroyatnaya damos-veroyatno addr 0x16051 | code word CARB: mixture adaptation factor frau" CURVE 0x16051 RL_GRID_UBYTE 0 CM_IDENTITY 0 255
 /begin AXIS_DESCR FIX_AXIS NO_INPUT_QUANTITY CM_IDENTITY 4 0 3 FIX_AXIS_PAR_DIST 0 1 4 /end AXIS_DESCR
/end CHARACTERISTIC
/begin CHARACTERISTIC CDCFRST "veroyatnaya damos-veroyatno addr 0x16059 | code word CARB: deiation of lambda loop control" CURVE 0x16059 RL_GRID_UBYTE 0 CM_IDENTITY 0 255
 /begin AXIS_DESCR FIX_AXIS NO_INPUT_QUANTITY CM_IDENTITY 4 0 3 FIX_AXIS_PAR_DIST 0 1 4 /end AXIS_DESCR
/end CHARACTERISTIC
/begin CHARACTERISTIC CDCGE "veroyatnaya damos-veroyatno addr 0x16061 | code word CARB: transmission controlled spark advance GE" CURVE 0x16061 RL_GRID_UBYTE 0 CM_IDENTITY 0 255
 /begin AXIS_DESCR FIX_AXIS NO_INPUT_QUANTITY CM_IDENTITY 4 0 3 FIX_AXIS_PAR_DIST 0 1 4 /end AXIS_DESCR
/end CHARACTERISTIC
/begin CHARACTERISTIC CDCHSH "veroyatnaya damos-veroyatno addr 0x16069 | code word CARB: lambda sensor heating downstream cat" CURVE 0x16069 RL_GRID_UBYTE 0 CM_IDENTITY 0 255
 /begin AXIS_DESCR FIX_AXIS NO_INPUT_QUANTITY CM_IDENTITY 4 0 3 FIX_AXIS_PAR_DIST 0 1 4 /end AXIS_DESCR
/end CHARACTERISTIC
/begin CHARACTERISTIC CDCHSHE "veroyatnaya damos-veroyatno addr 0x16071 | Code word CARB: O2 Sensor Heater power stage" CURVE 0x16071 RL_GRID_UBYTE 0 CM_IDENTITY 0 255
 /begin AXIS_DESCR FIX_AXIS NO_INPUT_QUANTITY CM_IDENTITY 4 0 3 FIX_AXIS_PAR_DIST 0 1 4 /end AXIS_DESCR
/end CHARACTERISTIC
/begin CHARACTERISTIC CDCHSV "veroyatnaya damos-veroyatno addr 0x16079 | code word CARB: lambda sensor heating upstream cat" CURVE 0x16079 RL_GRID_UBYTE 0 CM_IDENTITY 0 255
 /begin AXIS_DESCR FIX_AXIS NO_INPUT_QUANTITY CM_IDENTITY 4 0 3 FIX_AXIS_PAR_DIST 0 1 4 /end AXIS_DESCR
/end CHARACTERISTIC
/begin CHARACTERISTIC CDCHSVE "veroyatnaya damos-veroyatno addr 0x16081 | code word CARB: lambda sensor heating power stage upstream cat" CURVE 0x16081 RL_GRID_UBYTE 0 CM_IDENTITY 0 255
 /begin AXIS_DESCR FIX_AXIS NO_INPUT_QUANTITY CM_IDENTITY 4 0 3 FIX_AXIS_PAR_DIST 0 1 4 /end AXIS_DESCR
/end CHARACTERISTIC
/begin CHARACTERISTIC CDCKAT "veroyatnaya damos-veroyatno addr 0x16089 | code word CARB: catalyst conversion" CURVE 0x16089 RL_GRID_UBYTE 0 CM_IDENTITY 0 255
 /begin AXIS_DESCR FIX_AXIS NO_INPUT_QUANTITY CM_IDENTITY 4 0 3 FIX_AXIS_PAR_DIST 0 1 4 /end AXIS_DESCR
/end CHARACTERISTIC
/begin CHARACTERISTIC CDCKOSE "veroyatnaya damos-veroyatno addr 0x16091 | Code word CARB: A/C control power stage" CURVE 0x16091 RL_GRID_UBYTE 0 CM_IDENTITY 0 255
 /begin AXIS_DESCR FIX_AXIS NO_INPUT_QUANTITY CM_IDENTITY 4 0 3 FIX_AXIS_PAR_DIST 0 1 4 /end AXIS_DESCR
/end CHARACTERISTIC
/begin CHARACTERISTIC CDCKPE "veroyatnaya damos-veroyatno addr 0x16099 | Code word CARB: fuel pump relay power stage" CURVE 0x16099 RL_GRID_UBYTE 0 CM_IDENTITY 0 255
 /begin AXIS_DESCR FIX_AXIS NO_INPUT_QUANTITY CM_IDENTITY 4 0 3 FIX_AXIS_PAR_DIST 0 1 4 /end AXIS_DESCR
/end CHARACTERISTIC
/begin CHARACTERISTIC CDCKRNT "veroyatnaya damos-veroyatno addr 0x160A1 | code word CARB: knock control zero test pulse" CURVE 0x160A1 RL_GRID_UBYTE 0 CM_IDENTITY 0 255
 /begin AXIS_DESCR FIX_AXIS NO_INPUT_QUANTITY CM_IDENTITY 4 0 3 FIX_AXIS_PAR_DIST 0 1 4 /end AXIS_DESCR
/end CHARACTERISTIC
/begin CHARACTERISTIC CDCKROF "veroyatnaya damos-veroyatno addr 0x160A9 | codeword CARB: knock control offset" CURVE 0x160A9 RL_GRID_UBYTE 0 CM_IDENTITY 0 255
 /begin AXIS_DESCR FIX_AXIS NO_INPUT_QUANTITY CM_IDENTITY 4 0 3 FIX_AXIS_PAR_DIST 0 1 4 /end AXIS_DESCR
/end CHARACTERISTIC
/begin CHARACTERISTIC CDCKRTP "veroyatnaya damos-veroyatno addr 0x160B1 | code word CARB: knock control test pulse" CURVE 0x160B1 RL_GRID_UBYTE 0 CM_IDENTITY 0 255
 /begin AXIS_DESCR FIX_AXIS NO_INPUT_QUANTITY CM_IDENTITY 4 0 3 FIX_AXIS_PAR_DIST 0 1 4 /end AXIS_DESCR
/end CHARACTERISTIC
/begin CHARACTERISTIC CDCKS1 "veroyatnaya damos-veroyatno addr 0x160B9 | code word CARB: knock sensor 1" CURVE 0x160B9 RL_GRID_UBYTE 0 CM_IDENTITY 0 255
 /begin AXIS_DESCR FIX_AXIS NO_INPUT_QUANTITY CM_IDENTITY 4 0 3 FIX_AXIS_PAR_DIST 0 1 4 /end AXIS_DESCR
/end CHARACTERISTIC
/begin CHARACTERISTIC CDCKS2 "veroyatnaya damos-veroyatno addr 0x160C1 | code word CARB: knock sensor 2" CURVE 0x160C1 RL_GRID_UBYTE 0 CM_IDENTITY 0 255
 /begin AXIS_DESCR FIX_AXIS NO_INPUT_QUANTITY CM_IDENTITY 4 0 3 FIX_AXIS_PAR_DIST 0 1 4 /end AXIS_DESCR
/end CHARACTERISTIC
/begin CHARACTERISTIC CDCKS3 "veroyatnaya damos-veroyatno addr 0x160C9 | code word CARB: knock sensor 3" CURVE 0x160C9 RL_GRID_UBYTE 0 CM_IDENTITY 0 255
 /begin AXIS_DESCR FIX_AXIS NO_INPUT_QUANTITY CM_IDENTITY 4 0 3 FIX_AXIS_PAR_DIST 0 1 4 /end AXIS_DESCR
/end CHARACTERISTIC
/begin CHARACTERISTIC CDCKS4 "veroyatnaya damos-veroyatno addr 0x160D1 | code word CARB: knock sensor 4" CURVE 0x160D1 RL_GRID_UBYTE 0 CM_IDENTITY 0 255
 /begin AXIS_DESCR FIX_AXIS NO_INPUT_QUANTITY CM_IDENTITY 4 0 3 FIX_AXIS_PAR_DIST 0 1 4 /end AXIS_DESCR
/end CHARACTERISTIC
/begin CHARACTERISTIC CDCLASH "veroyatnaya damos-veroyatno addr 0x160D9 | code word CARB: lambda sensor aging downstream cat" CURVE 0x160D9 RL_GRID_UBYTE 0 CM_IDENTITY 0 255
 /begin AXIS_DESCR FIX_AXIS NO_INPUT_QUANTITY CM_IDENTITY 4 0 3 FIX_AXIS_PAR_DIST 0 1 4 /end AXIS_DESCR
/end CHARACTERISTIC
/begin CHARACTERISTIC CDCLATP "veroyatnaya damos-veroyatno addr 0x160E1 | code word CARB: lambda sensor aging tp" CURVE 0x160E1 RL_GRID_UBYTE 0 CM_IDENTITY 0 255
 /begin AXIS_DESCR FIX_AXIS NO_INPUT_QUANTITY CM_IDENTITY 4 0 3 FIX_AXIS_PAR_DIST 0 1 4 /end AXIS_DESCR
/end CHARACTERISTIC
/begin CHARACTERISTIC CDCLATV "veroyatnaya damos-veroyatno addr 0x160E9 | code word CARB: lambda sensor aging tv" CURVE 0x160E9 RL_GRID_UBYTE 0 CM_IDENTITY 0 255
 /begin AXIS_DESCR FIX_AXIS NO_INPUT_QUANTITY CM_IDENTITY 4 0 3 FIX_AXIS_PAR_DIST 0 1 4 /end AXIS_DESCR
/end CHARACTERISTIC
/begin CHARACTERISTIC CDCLLR "veroyatnaya damos-veroyatno addr 0x160F1 | code word CARB: idle speed control at limit" CURVE 0x160F1 RL_GRID_UBYTE 0 CM_IDENTITY 0 255
 /begin AXIS_DESCR FIX_AXIS NO_INPUT_QUANTITY CM_IDENTITY 4 0 3 FIX_AXIS_PAR_DIST 0 1 4 /end AXIS_DESCR
/end CHARACTERISTIC
/begin CHARACTERISTIC CDCLM "veroyatnaya damos-veroyatno addr 0x160F9 | code word CARB: air flow sensor" CURVE 0x160F9 RL_GRID_UBYTE 0 CM_IDENTITY 0 255
 /begin AXIS_DESCR FIX_AXIS NO_INPUT_QUANTITY CM_IDENTITY 4 0 3 FIX_AXIS_PAR_DIST 0 1 4 /end AXIS_DESCR
/end CHARACTERISTIC
/begin CHARACTERISTIC CDCLSH "adres podtverzhden damos-veroyatno addr 0x16101 | IMYA NE PODTVERZHDENO, adres: kod: mov r13, [r2+#0x6100] @0x85219C | code word CARB: lambda sensor downstream catalyst" CURVE 0x16101 RL_GRID_UBYTE 0 CM_IDENTITY 0 255
 /begin AXIS_DESCR FIX_AXIS NO_INPUT_QUANTITY CM_IDENTITY 4 0 3 FIX_AXIS_PAR_DIST 0 1 4 /end AXIS_DESCR
/end CHARACTERISTIC
/begin CHARACTERISTIC CDCLSV "veroyatnaya damos-veroyatno addr 0x16109 | code word CARB: lambda sensor upstream cat" CURVE 0x16109 RL_GRID_UBYTE 0 CM_IDENTITY 0 255
 /begin AXIS_DESCR FIX_AXIS NO_INPUT_QUANTITY CM_IDENTITY 4 0 3 FIX_AXIS_PAR_DIST 0 1 4 /end AXIS_DESCR
/end CHARACTERISTIC
/begin CHARACTERISTIC CDCLUEA "veroyatnaya damos-veroyatno addr 0x16111 | code word CARB: Power stage engine fan A" CURVE 0x16111 RL_GRID_UBYTE 0 CM_IDENTITY 0 255
 /begin AXIS_DESCR FIX_AXIS NO_INPUT_QUANTITY CM_IDENTITY 4 0 3 FIX_AXIS_PAR_DIST 0 1 4 /end AXIS_DESCR
/end CHARACTERISTIC
/begin CHARACTERISTIC MAP_303_1611B_4 "veroyatnaya mapscan addr 0x1611B" CURVE 0x1611B RL_2D_A16_UWORD 0 CM_IDENTITY 0 65535 /begin AXIS_DESCR STD_AXIS NO_INPUT_QUANTITY CM_IDENTITY 4 0 65535 /end AXIS_DESCR /end CHARACTERISTIC
/begin CHARACTERISTIC CDCMD01 "veroyatnaya damos-veroyatno addr 0x16131 | Code word CARB: misfire cyl. 1" CURVE 0x16131 RL_GRID_UBYTE 0 CM_IDENTITY 0 255
 /begin AXIS_DESCR FIX_AXIS NO_INPUT_QUANTITY CM_IDENTITY 4 0 3 FIX_AXIS_PAR_DIST 0 1 4 /end AXIS_DESCR
/end CHARACTERISTIC
/begin CHARACTERISTIC CDCMD02 "veroyatnaya damos-veroyatno addr 0x16139 | Code word CARB: misfire cylinder 2" CURVE 0x16139 RL_GRID_UBYTE 0 CM_IDENTITY 0 255
 /begin AXIS_DESCR FIX_AXIS NO_INPUT_QUANTITY CM_IDENTITY 4 0 3 FIX_AXIS_PAR_DIST 0 1 4 /end AXIS_DESCR
/end CHARACTERISTIC
/begin CHARACTERISTIC CDCMD03 "veroyatnaya damos-veroyatno addr 0x16141 | Code word CARB: misfire cylinder 3" CURVE 0x16141 RL_GRID_UBYTE 0 CM_IDENTITY 0 255
 /begin AXIS_DESCR FIX_AXIS NO_INPUT_QUANTITY CM_IDENTITY 4 0 3 FIX_AXIS_PAR_DIST 0 1 4 /end AXIS_DESCR
/end CHARACTERISTIC
/begin CHARACTERISTIC CDCMFA "veroyatnaya damos-veroyatno addr 0x16149 | code word CARB: MIL not local fixed" CURVE 0x16149 RL_GRID_UBYTE 0 CM_IDENTITY 0 255
 /begin AXIS_DESCR FIX_AXIS NO_INPUT_QUANTITY CM_IDENTITY 4 0 3 FIX_AXIS_PAR_DIST 0 1 4 /end AXIS_DESCR
/end CHARACTERISTIC
/begin CHARACTERISTIC CDCMFB "veroyatnaya damos-veroyatno addr 0x16151 | code word CARB: MIL external request" CURVE 0x16151 RL_GRID_UBYTE 0 CM_IDENTITY 0 255
 /begin AXIS_DESCR FIX_AXIS NO_INPUT_QUANTITY CM_IDENTITY 4 0 3 FIX_AXIS_PAR_DIST 0 1 4 /end AXIS_DESCR
/end CHARACTERISTIC
/begin CHARACTERISTIC MAP_309_16156_5 "adres podtverzhden mapscan addr 0x16156 | IMYA NE PODTVERZHDENO, adres: kod: mov r14, #0x615c @0x85502A" CURVE 0x16156 RL_2D_A8_UWORD 0 CM_IDENTITY 0 65535 /begin AXIS_DESCR STD_AXIS NO_INPUT_QUANTITY CM_IDENTITY 5 0 255 /end AXIS_DESCR /end CHARACTERISTIC
/begin CHARACTERISTIC CDCPH "veroyatnaya damos-veroyatno addr 0x16169 | code word CARB: phase sensor" CURVE 0x16169 RL_GRID_UBYTE 0 CM_IDENTITY 0 255
 /begin AXIS_DESCR FIX_AXIS NO_INPUT_QUANTITY CM_IDENTITY 4 0 3 FIX_AXIS_PAR_DIST 0 1 4 /end AXIS_DESCR
/end CHARACTERISTIC
/begin CHARACTERISTIC CDCPUA "veroyatnaya damos-veroyatno addr 0x16171 | Code word CARB: ambient pressure adaptation" CURVE 0x16171 RL_GRID_UBYTE 0 CM_IDENTITY 0 255
 /begin AXIS_DESCR FIX_AXIS NO_INPUT_QUANTITY CM_IDENTITY 4 0 3 FIX_AXIS_PAR_DIST 0 1 4 /end AXIS_DESCR
/end CHARACTERISTIC
/begin CHARACTERISTIC CDCRKAT "veroyatnaya damos-veroyatno addr 0x16179 | code word CARB: additive adaptive mixture correction rkat" CURVE 0x16179 RL_GRID_UBYTE 0 CM_IDENTITY 0 255
 /begin AXIS_DESCR FIX_AXIS NO_INPUT_QUANTITY CM_IDENTITY 4 0 3 FIX_AXIS_PAR_DIST 0 1 4 /end AXIS_DESCR
/end CHARACTERISTIC
/begin CHARACTERISTIC CDCRKAZ "veroyatnaya damos-veroyatno addr 0x16181 | code word CARB: additive adaptive mixture correction rkaz" CURVE 0x16181 RL_GRID_UBYTE 0 CM_IDENTITY 0 255
 /begin AXIS_DESCR FIX_AXIS NO_INPUT_QUANTITY CM_IDENTITY 4 0 3 FIX_AXIS_PAR_DIST 0 1 4 /end AXIS_DESCR
/end CHARACTERISTIC
/begin CHARACTERISTIC CDCSGROM "veroyatnaya damos-veroyatno addr 0x16189 | code word CARB: control unit defective (ROM)" CURVE 0x16189 RL_GRID_UBYTE 0 CM_IDENTITY 0 255
 /begin AXIS_DESCR FIX_AXIS NO_INPUT_QUANTITY CM_IDENTITY 4 0 3 FIX_AXIS_PAR_DIST 0 1 4 /end AXIS_DESCR
/end CHARACTERISTIC
/begin CHARACTERISTIC CDCSWE "veroyatnaya damos-veroyatno addr 0x16191 | code word CARB: acceleration sensor for rough surface detection" CURVE 0x16191 RL_GRID_UBYTE 0 CM_IDENTITY 0 255
 /begin AXIS_DESCR FIX_AXIS NO_INPUT_QUANTITY CM_IDENTITY 4 0 3 FIX_AXIS_PAR_DIST 0 1 4 /end AXIS_DESCR
/end CHARACTERISTIC
/begin CHARACTERISTIC CDCTA "veroyatnaya damos-veroyatno addr 0x16199 | code word CARB: intake air temperature" CURVE 0x16199 RL_GRID_UBYTE 0 CM_IDENTITY 0 255
 /begin AXIS_DESCR FIX_AXIS NO_INPUT_QUANTITY CM_IDENTITY 4 0 3 FIX_AXIS_PAR_DIST 0 1 4 /end AXIS_DESCR
/end CHARACTERISTIC
/begin CHARACTERISTIC CDCTES "adres podtverzhden damos-veroyatno addr 0x161A1 | IMYA NE PODTVERZHDENO, adres: kod: mov r13, #0x61a1 @0x8564E0 | code word CARB: canister purge system" CURVE 0x161A1 RL_GRID_UBYTE 0 CM_IDENTITY 0 255
 /begin AXIS_DESCR FIX_AXIS NO_INPUT_QUANTITY CM_IDENTITY 4 0 3 FIX_AXIS_PAR_DIST 0 1 4 /end AXIS_DESCR
/end CHARACTERISTIC
/begin CHARACTERISTIC CDCTEVE "adres podtverzhden damos-veroyatno addr 0x161A9 | IMYA NE PODTVERZHDENO, adres: kod: mov r13, #0x61a8 @0x83E582 | code word CARB: canister purge valve power stage" CURVE 0x161A9 RL_GRID_UBYTE 0 CM_IDENTITY 0 255
 /begin AXIS_DESCR FIX_AXIS NO_INPUT_QUANTITY CM_IDENTITY 4 0 3 FIX_AXIS_PAR_DIST 0 1 4 /end AXIS_DESCR
/end CHARACTERISTIC
/begin CHARACTERISTIC CDCTHM "veroyatnaya damos-veroyatno addr 0x161B1 | code word CARB: engine thermostat monitoring THM" CURVE 0x161B1 RL_GRID_UBYTE 0 CM_IDENTITY 0 255
 /begin AXIS_DESCR FIX_AXIS NO_INPUT_QUANTITY CM_IDENTITY 4 0 3 FIX_AXIS_PAR_DIST 0 1 4 /end AXIS_DESCR
/end CHARACTERISTIC
/begin CHARACTERISTIC CDCTM "veroyatnaya damos-veroyatno addr 0x161B9 | code word CARB: engine coolant temperature TMOT" CURVE 0x161B9 RL_GRID_UBYTE 0 CM_IDENTITY 0 255
 /begin AXIS_DESCR FIX_AXIS NO_INPUT_QUANTITY CM_IDENTITY 4 0 3 FIX_AXIS_PAR_DIST 0 1 4 /end AXIS_DESCR
/end CHARACTERISTIC
/begin CHARACTERISTIC CDCUB "veroyatnaya damos-veroyatno addr 0x161C1 | code word CARB: battery voltage UB (onboard)" CURVE 0x161C1 RL_GRID_UBYTE 0 CM_IDENTITY 0 255
 /begin AXIS_DESCR FIX_AXIS NO_INPUT_QUANTITY CM_IDENTITY 4 0 3 FIX_AXIS_PAR_DIST 0 1 4 /end AXIS_DESCR
/end CHARACTERISTIC
/begin CHARACTERISTIC CDCVFZ "veroyatnaya damos-veroyatno addr 0x161C9 | code word CARB: vehicle speed signal" CURVE 0x161C9 RL_GRID_UBYTE 0 CM_IDENTITY 0 255
 /begin AXIS_DESCR FIX_AXIS NO_INPUT_QUANTITY CM_IDENTITY 4 0 3 FIX_AXIS_PAR_DIST 0 1 4 /end AXIS_DESCR
/end CHARACTERISTIC
/begin CHARACTERISTIC CDCZOE "veroyatnaya damos-veroyatno addr 0x161D1 | code word CARB: idle speed actuator opening" CURVE 0x161D1 RL_GRID_UBYTE 0 CM_IDENTITY 0 255
 /begin AXIS_DESCR FIX_AXIS NO_INPUT_QUANTITY CM_IDENTITY 4 0 3 FIX_AXIS_PAR_DIST 0 1 4 /end AXIS_DESCR
/end CHARACTERISTIC
/begin CHARACTERISTIC CDCZSE "veroyatnaya damos-veroyatno addr 0x161D9 | code word CARB: idle speed actuator closing" CURVE 0x161D9 RL_GRID_UBYTE 0 CM_IDENTITY 0 255
 /begin AXIS_DESCR FIX_AXIS NO_INPUT_QUANTITY CM_IDENTITY 4 0 3 FIX_AXIS_PAR_DIST 0 1 4 /end AXIS_DESCR
/end CHARACTERISTIC
/begin CHARACTERISTIC CDCZZZ "veroyatnaya damos-veroyatno addr 0x161E1 | Dummy: end of table" CURVE 0x161E1 RL_GRID_UBYTE 0 CM_IDENTITY 0 255
 /begin AXIS_DESCR FIX_AXIS NO_INPUT_QUANTITY CM_IDENTITY 4 0 3 FIX_AXIS_PAR_DIST 0 1 4 /end AXIS_DESCR
/end CHARACTERISTIC
/begin CHARACTERISTIC GRID_326_1637C_16x7 "veroyatnaya gridscan addr 0x1637C" MAP 0x1637C RL_GRID_UBYTE 0 CM_IDENTITY 0 255
 /begin AXIS_DESCR FIX_AXIS NO_INPUT_QUANTITY CM_IDENTITY 16 0 15 FIX_AXIS_PAR_DIST 0 1 16 /end AXIS_DESCR
 /begin AXIS_DESCR FIX_AXIS NO_INPUT_QUANTITY CM_IDENTITY 7 0 6 FIX_AXIS_PAR_DIST 0 1 7 /end AXIS_DESCR
/end CHARACTERISTIC
/begin CHARACTERISTIC SDK10TEUB "podtverzhdena damos addr 0x181A3 | wdkba dependet basic point (number 10)" CURVE 0x181A3 RL_GRID_UBYTE 0 CM_0p3921568627_0_DK 0 100
 /begin AXIS_DESCR FIX_AXIS NO_INPUT_QUANTITY CM_IDENTITY 10 0 9 FIX_AXIS_PAR_DIST 0 1 10 /end AXIS_DESCR
/end CHARACTERISTIC
/begin CHARACTERISTIC SEZ06TMUB "podtverzhdena damos addr 0x181AE | Datapoint distribution of ignition timing efficiency" CURVE 0x181AE RL_GRID_UBYTE 0 CM_0p5_0 0 127.5
 /begin AXIS_DESCR FIX_AXIS NO_INPUT_QUANTITY CM_IDENTITY 6 0 5 FIX_AXIS_PAR_DIST 0 1 6 /end AXIS_DESCR
/end CHARACTERISTIC
/begin CHARACTERISTIC SFR05TEUB "podtverzhdena damos addr 0x181B5 | frmit dependet basic point (number 5)" CURVE 0x181B5 RL_GRID_UBYTE 0 CM_0p0078125_0 0 1.99219
 /begin AXIS_DESCR FIX_AXIS NO_INPUT_QUANTITY CM_IDENTITY 5 0 4 FIX_AXIS_PAR_DIST 0 1 5 /end AXIS_DESCR
/end CHARACTERISTIC
/begin CHARACTERISTIC SGA06MFUB "podtverzhdena damos addr 0x181BB" CURVE 0x181BB RL_GRID_UBYTE 0 CM_IDENTITY 0 255
 /begin AXIS_DESCR FIX_AXIS NO_INPUT_QUANTITY CM_IDENTITY 6 0 5 FIX_AXIS_PAR_DIST 0 1 6 /end AXIS_DESCR
/end CHARACTERISTIC
/begin CHARACTERISTIC SKS06ESUB "podtverzhdena damos addr 0x181C2 | Distribution for the start adaption factor kstaa" CURVE 0x181C2 RL_GRID_UBYTE 0 CM_0p0078125_0 0 1.99219
 /begin AXIS_DESCR FIX_AXIS NO_INPUT_QUANTITY CM_IDENTITY 6 0 5 FIX_AXIS_PAR_DIST 0 1 6 /end AXIS_DESCR
/end CHARACTERISTIC
/begin CHARACTERISTIC SML06TEUB "podtverzhdena damos addr 0x181C9 | ml dependet basic point (number 6)" CURVE 0x181C9 RL_GRID_UBYTE 0 CM_4_0_kgh 0 1020
 /begin AXIS_DESCR FIX_AXIS NO_INPUT_QUANTITY CM_IDENTITY 6 0 5 FIX_AXIS_PAR_DIST 0 1 6 /end AXIS_DESCR
/end CHARACTERISTIC
/begin CHARACTERISTIC SML06TMUB "podtverzhdena damos addr 0x181D0 | ml dependet basic point (number 6)" CURVE 0x181D0 RL_GRID_UBYTE 0 CM_4_0_kgh 0 1020
 /begin AXIS_DESCR FIX_AXIS NO_INPUT_QUANTITY CM_IDENTITY 6 0 5 FIX_AXIS_PAR_DIST 0 1 6 /end AXIS_DESCR
/end CHARACTERISTIC
/begin CHARACTERISTIC SNM06LHUB "podtverzhdena damos addr 0x181D7" CURVE 0x181D7 RL_GRID_UBYTE 0 CM_40_0_Upm 0 10200
 /begin AXIS_DESCR FIX_AXIS NO_INPUT_QUANTITY CM_IDENTITY 6 0 5 FIX_AXIS_PAR_DIST 0 1 6 /end AXIS_DESCR
/end CHARACTERISTIC
/begin CHARACTERISTIC SNM06MFUB "podtverzhdena damos addr 0x181DE" CURVE 0x181DE RL_GRID_UBYTE 0 CM_40_0_Upm 0 10200
 /begin AXIS_DESCR FIX_AXIS NO_INPUT_QUANTITY CM_IDENTITY 6 0 5 FIX_AXIS_PAR_DIST 0 1 6 /end AXIS_DESCR
/end CHARACTERISTIC
/begin CHARACTERISTIC SNM07ESUB "podtverzhdena damos addr 0x181E5 | Base point distribution of engine speed, 7 base pts." CURVE 0x181E5 RL_GRID_UBYTE 0 CM_40_0_Upm 0 10200
 /begin AXIS_DESCR FIX_AXIS NO_INPUT_QUANTITY CM_IDENTITY 7 0 6 FIX_AXIS_PAR_DIST 0 1 7 /end AXIS_DESCR
/end CHARACTERISTIC
/begin CHARACTERISTIC SNM10TEUB "podtverzhdena damos addr 0x181ED | nmot dependet basic point (number 10)" CURVE 0x181ED RL_GRID_UBYTE 0 CM_40_0_Upm 0 10200
 /begin AXIS_DESCR FIX_AXIS NO_INPUT_QUANTITY CM_IDENTITY 10 0 9 FIX_AXIS_PAR_DIST 0 1 10 /end AXIS_DESCR
/end CHARACTERISTIC
/begin CHARACTERISTIC SNM16GKUB "podtverzhdena damos addr 0x181F8 | Datapoint distribution mixture control 16 nmot datapoints" CURVE 0x181F8 RL_GRID_UBYTE 0 CM_40_0_Upm 0 10200
 /begin AXIS_DESCR FIX_AXIS NO_INPUT_QUANTITY CM_IDENTITY 16 0 15 FIX_AXIS_PAR_DIST 0 1 16 /end AXIS_DESCR
/end CHARACTERISTIC
/begin CHARACTERISTIC SNM16KRUB "podtverzhdena damos addr 0x18209 | datapoint distribution engine speed, 16 datapoints" CURVE 0x18209 RL_GRID_UBYTE 0 CM_40_0_Upm 0 10200
 /begin AXIS_DESCR FIX_AXIS NO_INPUT_QUANTITY CM_IDENTITY 16 0 15 FIX_AXIS_PAR_DIST 0 1 16 /end AXIS_DESCR
/end CHARACTERISTIC
/begin CHARACTERISTIC SRL04KRUB "podtverzhdena damos addr 0x1821A | datapoint distribution relative charge, 4 datapoints" CURVE 0x1821A RL_GRID_UBYTE 0 CM_0p75_0 0 191.25
 /begin AXIS_DESCR FIX_AXIS NO_INPUT_QUANTITY CM_IDENTITY 4 0 3 FIX_AXIS_PAR_DIST 0 1 4 /end AXIS_DESCR
/end CHARACTERISTIC
/begin CHARACTERISTIC SRL12GKUB "podtverzhdena damos addr 0x1821F" CURVE 0x1821F RL_GRID_UBYTE 0 CM_0p75_0 0 191.25
 /begin AXIS_DESCR FIX_AXIS NO_INPUT_QUANTITY CM_IDENTITY 12 0 11 FIX_AXIS_PAR_DIST 0 1 12 /end AXIS_DESCR
/end CHARACTERISTIC
/begin CHARACTERISTIC ST107TMUB "podtverzhdena damos addr 0x1822C | tabgmst dependet basic point (number 7)" CURVE 0x1822C RL_GRID_UBYTE 0 CM_5_50_GradC -50 1225
 /begin AXIS_DESCR FIX_AXIS NO_INPUT_QUANTITY CM_IDENTITY 7 0 6 FIX_AXIS_PAR_DIST 0 1 7 /end AXIS_DESCR
/end CHARACTERISTIC
/begin CHARACTERISTIC ST307TMUB "podtverzhdena damos addr 0x18234 | tkatmst dependet basic point (number 7)" CURVE 0x18234 RL_GRID_UBYTE 0 CM_5_50_GradC -50 1225
 /begin AXIS_DESCR FIX_AXIS NO_INPUT_QUANTITY CM_IDENTITY 7 0 6 FIX_AXIS_PAR_DIST 0 1 7 /end AXIS_DESCR
/end CHARACTERISTIC
/begin CHARACTERISTIC STA06ESUB "podtverzhdena damos addr 0x1823C | Distribution for the air temperature in the intake manifold" CURVE 0x1823C RL_GRID_UBYTE 0 CM_0p75_48_GradC -48 143.25
 /begin AXIS_DESCR FIX_AXIS NO_INPUT_QUANTITY CM_IDENTITY 6 0 5 FIX_AXIS_PAR_DIST 0 1 6 /end AXIS_DESCR
/end CHARACTERISTIC
/begin CHARACTERISTIC STM04__UB "podtverzhdena damos addr 0x18243" CURVE 0x18243 RL_GRID_UBYTE 0 CM_0p75_48_GradC -48 143.25
 /begin AXIS_DESCR FIX_AXIS NO_INPUT_QUANTITY CM_IDENTITY 4 0 3 FIX_AXIS_PAR_DIST 0 1 4 /end AXIS_DESCR
/end CHARACTERISTIC
/begin CHARACTERISTIC STM05SAUB "podtverzhdena damos addr 0x18248 | base point distribution" CURVE 0x18248 RL_GRID_UBYTE 0 CM_0p75_48_GradC -48 143.25
 /begin AXIS_DESCR FIX_AXIS NO_INPUT_QUANTITY CM_IDENTITY 5 0 4 FIX_AXIS_PAR_DIST 0 1 5 /end AXIS_DESCR
/end CHARACTERISTIC
/begin CHARACTERISTIC STM05TMUB "podtverzhdena damos addr 0x1824E | tmst dependet basic point (number 5)" CURVE 0x1824E RL_GRID_UBYTE 0 CM_0p75_48_GradC -48 143.25
 /begin AXIS_DESCR FIX_AXIS NO_INPUT_QUANTITY CM_IDENTITY 5 0 4 FIX_AXIS_PAR_DIST 0 1 5 /end AXIS_DESCR
/end CHARACTERISTIC
/begin CHARACTERISTIC STM06LLUB "podtverzhdena damos addr 0x18254 | Datapoint distribution, engine temperature, 6 datapoints" CURVE 0x18254 RL_GRID_UBYTE 0 CM_0p75_48_GradC -48 143.25
 /begin AXIS_DESCR FIX_AXIS NO_INPUT_QUANTITY CM_IDENTITY 6 0 5 FIX_AXIS_PAR_DIST 0 1 6 /end AXIS_DESCR
/end CHARACTERISTIC
/begin CHARACTERISTIC STM06__UB "podtverzhdena damos addr 0x1825B | Datapoint distribution, engine temperature, 6 datapoints" CURVE 0x1825B RL_GRID_UBYTE 0 CM_0p75_48_GradC -48 143.25
 /begin AXIS_DESCR FIX_AXIS NO_INPUT_QUANTITY CM_IDENTITY 6 0 5 FIX_AXIS_PAR_DIST 0 1 6 /end AXIS_DESCR
/end CHARACTERISTIC
/begin CHARACTERISTIC STM08DMUB "podtverzhdena damos addr 0x18262" CURVE 0x18262 RL_GRID_UBYTE 0 CM_0p75_48_GradC -48 143.25
 /begin AXIS_DESCR FIX_AXIS NO_INPUT_QUANTITY CM_IDENTITY 8 0 7 FIX_AXIS_PAR_DIST 0 1 8 /end AXIS_DESCR
/end CHARACTERISTIC
/begin CHARACTERISTIC STM08LEUB "podtverzhdena damos addr 0x1826B" CURVE 0x1826B RL_GRID_UBYTE 0 CM_0p75_48_GradC -48 143.25
 /begin AXIS_DESCR FIX_AXIS NO_INPUT_QUANTITY CM_IDENTITY 8 0 7 FIX_AXIS_PAR_DIST 0 1 8 /end AXIS_DESCR
/end CHARACTERISTIC
/begin CHARACTERISTIC STM09ESUB "podtverzhdena damos addr 0x18274 | Base point distribution of engine temperature, 9 base pts." CURVE 0x18274 RL_GRID_UBYTE 0 CM_0p75_48_GradC -48 143.25
 /begin AXIS_DESCR FIX_AXIS NO_INPUT_QUANTITY CM_IDENTITY 9 0 8 FIX_AXIS_PAR_DIST 0 1 9 /end AXIS_DESCR
/end CHARACTERISTIC
/begin CHARACTERISTIC STS12ESUB "podtverzhdena damos addr 0x1827E | Distribution for engine coolant temperature at start" CURVE 0x1827E RL_GRID_UBYTE 0 CM_0p75_48_GradC -48 143.25
 /begin AXIS_DESCR FIX_AXIS NO_INPUT_QUANTITY CM_IDENTITY 12 0 11 FIX_AXIS_PAR_DIST 0 1 12 /end AXIS_DESCR
/end CHARACTERISTIC
/begin CHARACTERISTIC STW06MDUB "podtverzhdena damos addr 0x1828B" CURVE 0x1828B RL_GRID_UBYTE 0 CM_0p75_48_GradC -48 143.25
 /begin AXIS_DESCR FIX_AXIS NO_INPUT_QUANTITY CM_IDENTITY 6 0 5 FIX_AXIS_PAR_DIST 0 1 6 /end AXIS_DESCR
/end CHARACTERISTIC
/begin CHARACTERISTIC MAP_394_1854A_5 "veroyatnaya mapscan addr 0x1854A" CURVE 0x1854A RL_2D_A8_UBYTE 0 CM_IDENTITY 0 255 /begin AXIS_DESCR STD_AXIS NO_INPUT_QUANTITY CM_IDENTITY 5 0 255 /end AXIS_DESCR /end CHARACTERISTIC
/begin CHARACTERISTIC MAP_395_1856E_8 "veroyatnaya mapscan addr 0x1856E" CURVE 0x1856E RL_2D_A8_UBYTE 0 CM_IDENTITY 0 255 /begin AXIS_DESCR STD_AXIS NO_INPUT_QUANTITY CM_IDENTITY 8 0 255 /end AXIS_DESCR /end CHARACTERISTIC
/begin CHARACTERISTIC MAP_399_18613_10x8 "adres podtverzhden mapscan addr 0x18613 | IMYA NE PODTVERZHDENO, adres: kod: mov r12, #0x613 @0x843E08" MAP 0x18613 RL_3D_A8_UBYTE 0 CM_IDENTITY 0 255 /begin AXIS_DESCR STD_AXIS NO_INPUT_QUANTITY CM_IDENTITY 8 0 255 /end AXIS_DESCR /begin AXIS_DESCR STD_AXIS NO_INPUT_QUANTITY CM_IDENTITY 10 0 255 /end AXIS_DESCR /end CHARACTERISTIC
/begin CHARACTERISTIC KFFTAGRV "podtverzhdena damos addr 0x186F6 | Factor for temperature decrease between EGR line and EGR valve" MAP 0x186F6 RL_GRID_UBYTE 0 CM_0p0078125_0 0 1.99219
 /begin AXIS_DESCR FIX_AXIS NO_INPUT_QUANTITY CM_IDENTITY 6 0 5 FIX_AXIS_PAR_DIST 0 1 6 /end AXIS_DESCR
 /begin AXIS_DESCR FIX_AXIS NO_INPUT_QUANTITY CM_IDENTITY 8 0 7 FIX_AXIS_PAR_DIST 0 1 8 /end AXIS_DESCR
/end CHARACTERISTIC
/begin CHARACTERISTIC KFFTDAG "podtverzhdena damos addr 0x18736 | Factor for temperatur decrease between EGR line and EGR induction" MAP 0x18736 RL_GRID_UBYTE 0 CM_0p0078125_0 0 1.99219
 /begin AXIS_DESCR FIX_AXIS NO_INPUT_QUANTITY CM_IDENTITY 6 0 5 FIX_AXIS_PAR_DIST 0 1 6 /end AXIS_DESCR
 /begin AXIS_DESCR FIX_AXIS NO_INPUT_QUANTITY CM_IDENTITY 8 0 7 FIX_AXIS_PAR_DIST 0 1 8 /end AXIS_DESCR
/end CHARACTERISTIC
/begin CHARACTERISTIC MAP_407_18768_6 "adres podtverzhden mapscan addr 0x18768 | IMYA NE PODTVERZHDENO, adres: kod: mov r12, #0x767 @0x8454B0" CURVE 0x18768 RL_2D_A8_UBYTE 0 CM_IDENTITY 0 255 /begin AXIS_DESCR STD_AXIS NO_INPUT_QUANTITY CM_IDENTITY 6 0 255 /end AXIS_DESCR /end CHARACTERISTIC
/begin CHARACTERISTIC MAP_409_1879A_6 "adres podtverzhden mapscan addr 0x1879A | IMYA NE PODTVERZHDENO, adres: kod: mov r12, #0x799 @0x8454C4" CURVE 0x1879A RL_2D_A8_UBYTE 0 CM_IDENTITY 0 255 /begin AXIS_DESCR STD_AXIS NO_INPUT_QUANTITY CM_IDENTITY 6 0 255 /end AXIS_DESCR /end CHARACTERISTIC
/begin CHARACTERISTIC ATMABKA "adres podtverzhden damos-veroyatno addr 0x187E2 | IMYA NE PODTVERZHDENO, adres: kod: mov r12, #0x7e2 @0x845E20 | factor reduction of exhaust gas temperature = f(soak time)" CURVE 0x187E2 RL_GRID_UBYTE 0 CM_0p00390625_0 0 0.996094
 /begin AXIS_DESCR FIX_AXIS NO_INPUT_QUANTITY CM_IDENTITY 6 0 5 FIX_AXIS_PAR_DIST 0 1 6 /end AXIS_DESCR
/end CHARACTERISTIC
/begin CHARACTERISTIC ATMABKK "adres podtverzhden damos-veroyatno addr 0x187E8 | IMYA NE PODTVERZHDENO, adres: kod: mov r12, #0x7e8 @0x845E8C | factor reduction for catalyst temperature = f(soak time)" CURVE 0x187E8 RL_GRID_UBYTE 0 CM_0p00390625_0 0 0.996094
 /begin AXIS_DESCR FIX_AXIS NO_INPUT_QUANTITY CM_IDENTITY 6 0 5 FIX_AXIS_PAR_DIST 0 1 6 /end AXIS_DESCR
/end CHARACTERISTIC
/begin CHARACTERISTIC FATMRML "adres podtverzhden damos-veroyatno addr 0x187EF | IMYA NE PODTVERZHDENO, adres: kod: mov r12, #0x7ef @0x845B92 | divide factor exhaust-/exhaust-pipe temperature" CURVE 0x187EF RL_GRID_UBYTE 0 CM_0p00390625_0 0 0.996094
 /begin AXIS_DESCR FIX_AXIS NO_INPUT_QUANTITY CM_IDENTITY 7 0 6 FIX_AXIS_PAR_DIST 0 1 7 /end AXIS_DESCR
/end CHARACTERISTIC
/begin CHARACTERISTIC KATMEXML "adres podtverzhden damos-veroyatno addr 0x187F9 | IMYA NE PODTVERZHDENO, adres: kod: mov r12, #0x7f9 @0x845CAA | Temperature of the exotherme in the catalyst tkatm" CURVE 0x187F9 RL_GRID_SBYTE 0 CM_5_0_GradC -640 635
 /begin AXIS_DESCR FIX_AXIS NO_INPUT_QUANTITY CM_IDENTITY 7 0 6 FIX_AXIS_PAR_DIST 0 1 7 /end AXIS_DESCR
/end CHARACTERISTIC
/begin CHARACTERISTIC KFATMLA "podtverzhdena damos-tochno addr 0x18800 | map exhaust gas temperature correction = f(lambda)" MAP 0x18800 RL_GRID_SBYTE 0 CM_5_0_GradC -640 635
 /begin AXIS_DESCR FIX_AXIS NO_INPUT_QUANTITY CM_IDENTITY 6 0 5 FIX_AXIS_PAR_DIST 0 1 6 /end AXIS_DESCR
 /begin AXIS_DESCR FIX_AXIS NO_INPUT_QUANTITY CM_IDENTITY 6 0 5 FIX_AXIS_PAR_DIST 0 1 6 /end AXIS_DESCR
/end CHARACTERISTIC
/begin CHARACTERISTIC KFATMZW "podtverzhdena damos-tochno addr 0x18824 | map exhaust gas temperature correktion = f(ignition-variation)" MAP 0x18824 RL_GRID_SBYTE 0 CM_5_0_GradC -640 635
 /begin AXIS_DESCR FIX_AXIS NO_INPUT_QUANTITY CM_IDENTITY 6 0 5 FIX_AXIS_PAR_DIST 0 1 6 /end AXIS_DESCR
 /begin AXIS_DESCR FIX_AXIS NO_INPUT_QUANTITY CM_IDENTITY 6 0 5 FIX_AXIS_PAR_DIST 0 1 6 /end AXIS_DESCR
/end CHARACTERISTIC
/begin CHARACTERISTIC KFTATM "podtverzhdena damos-tochno addr 0x1885A | map exhaust gas temperature f(nmot,rl)" MAP 0x1885A RL_GRID_SBYTE 0 CM_5_50_GradC -690 585
 /begin AXIS_DESCR FIX_AXIS NO_INPUT_QUANTITY CM_IDENTITY 8 0 7 FIX_AXIS_PAR_DIST 0 1 8 /end AXIS_DESCR
 /begin AXIS_DESCR FIX_AXIS NO_INPUT_QUANTITY CM_IDENTITY 8 0 7 FIX_AXIS_PAR_DIST 0 1 8 /end AXIS_DESCR
/end CHARACTERISTIC
/begin CHARACTERISTIC KLATMLAE "adres podtverzhden damos-veroyatno addr 0x1889A | IMYA NE PODTVERZHDENO, adres: kod: add DPP0, #0x89a @0x860AA6 | Temperature of the exotherme decrease during enrichment" CURVE 0x1889A RL_GRID_UBYTE 0 CM_0p00390625_0 0 0.996094
 /begin AXIS_DESCR FIX_AXIS NO_INPUT_QUANTITY CM_IDENTITY 6 0 5 FIX_AXIS_PAR_DIST 0 1 6 /end AXIS_DESCR
/end CHARACTERISTIC
/begin CHARACTERISTIC KLATMZWE "adres podtverzhden damos-veroyatno addr 0x188A0 | IMYA NE PODTVERZHDENO, adres: kod: mov r12, #0x8a0 @0x845C7A | Temperature of the exotherme decrease in cat during ignition retard tkatm" CURVE 0x188A0 RL_GRID_UBYTE 0 CM_0p00390625_0 0 0.996094
 /begin AXIS_DESCR FIX_AXIS NO_INPUT_QUANTITY CM_IDENTITY 6 0 5 FIX_AXIS_PAR_DIST 0 1 6 /end AXIS_DESCR
/end CHARACTERISTIC
/begin CHARACTERISTIC MAP_422_188CA_5 "adres podtverzhden mapscan addr 0x188CA | IMYA NE PODTVERZHDENO, adres: kod: mov r12, #0x8ca @0x847560" CURVE 0x188CA RL_2D_A8_UBYTE 0 CM_IDENTITY 0 255 /begin AXIS_DESCR STD_AXIS NO_INPUT_QUANTITY CM_IDENTITY 5 0 255 /end AXIS_DESCR /end CHARACTERISTIC
/begin CHARACTERISTIC KFFTV "podtverzhdena damos-tochno addr 0x18AEA | weighting map for TVLRH" MAP 0x18AEA RL_GRID_UBYTE 0 CM_0p0078125_0 0 1.99219
 /begin AXIS_DESCR FIX_AXIS NO_INPUT_QUANTITY CM_IDENTITY 6 0 5 FIX_AXIS_PAR_DIST 0 1 6 /end AXIS_DESCR
 /begin AXIS_DESCR FIX_AXIS NO_INPUT_QUANTITY CM_IDENTITY 6 0 5 FIX_AXIS_PAR_DIST 0 1 6 /end AXIS_DESCR
/end CHARACTERISTIC
/begin CHARACTERISTIC KFUSHK "veroyatnaya damos-veroyatno addr 0x18B0E | lambda sensor reference value for lambda control downstream of catalyst" MAP 0x18B0E RL_GRID_SBYTE 0 CM_0p005215686275_0p2_V -0.867608 0.462392
 /begin AXIS_DESCR FIX_AXIS NO_INPUT_QUANTITY CM_IDENTITY 6 0 5 FIX_AXIS_PAR_DIST 0 1 6 /end AXIS_DESCR
 /begin AXIS_DESCR FIX_AXIS NO_INPUT_QUANTITY CM_IDENTITY 6 0 5 FIX_AXIS_PAR_DIST 0 1 6 /end AXIS_DESCR
/end CHARACTERISTIC
/begin CHARACTERISTIC PLRHML "veroyatnaya damos-veroyatno addr 0x18B32 | p-part of LRHK, f(dushk)" CURVE 0x18B32 RL_GRID_SBYTE 0 CM_0p01_0_s -1.28 1.27
 /begin AXIS_DESCR FIX_AXIS NO_INPUT_QUANTITY CM_IDENTITY 8 0 7 FIX_AXIS_PAR_DIST 0 1 8 /end AXIS_DESCR
/end CHARACTERISTIC
/begin CHARACTERISTIC RLLRHON "veroyatnaya damos-veroyatno addr 0x18B3A | char. line on nmot, upper rl control threshold for downstream lambda control" CURVE 0x18B3A RL_GRID_UBYTE 0 CM_0p75_0 0 191.25
 /begin AXIS_DESCR FIX_AXIS NO_INPUT_QUANTITY CM_IDENTITY 8 0 7 FIX_AXIS_PAR_DIST 0 1 8 /end AXIS_DESCR
/end CHARACTERISTIC
/begin CHARACTERISTIC RLLRHUN "veroyatnaya damos-veroyatno addr 0x18B42 | char. line on nmot, lower control threshold rl for downstream lambda control" CURVE 0x18B42 RL_GRID_UBYTE 0 CM_0p75_0 0 191.25
 /begin AXIS_DESCR FIX_AXIS NO_INPUT_QUANTITY CM_IDENTITY 8 0 7 FIX_AXIS_PAR_DIST 0 1 8 /end AXIS_DESCR
/end CHARACTERISTIC
/begin CHARACTERISTIC ZLRHML "veroyatnaya damos-veroyatno addr 0x18B4A | time constant of lambda control integrator downstream catalyst" CURVE 0x18B4A RL_GRID_UBYTE 0 CM_0p0390625_0_mss 0 9.96094
 /begin AXIS_DESCR FIX_AXIS NO_INPUT_QUANTITY CM_IDENTITY 8 0 7 FIX_AXIS_PAR_DIST 0 1 8 /end AXIS_DESCR
/end CHARACTERISTIC
/begin CHARACTERISTIC BTRKHTMS "veroyatnaya damos-veroyatno addr 0x18B6B | Characteristic enabling flag B_trkh" CURVE 0x18B6B RL_GRID_UBYTE 0 CM_IDENTITY 0 255
 /begin AXIS_DESCR FIX_AXIS NO_INPUT_QUANTITY CM_IDENTITY 8 0 7 FIX_AXIS_PAR_DIST 0 1 8 /end AXIS_DESCR
/end CHARACTERISTIC
/begin CHARACTERISTIC FNSKHLL "podtverzhdena damos addr 0x18B81 | factor idle speed increase after start" CURVE 0x18B81 RL_GRID_UBYTE 0 CM_0p0078125_0 0 1.99219
 /begin AXIS_DESCR FIX_AXIS NO_INPUT_QUANTITY CM_IDENTITY 5 0 4 FIX_AXIS_PAR_DIST 0 1 5 /end AXIS_DESCR
/end CHARACTERISTIC
/begin CHARACTERISTIC FTMLAKH "adres podtverzhden damos-veroyatno addr 0x18BB0 | IMYA NE PODTVERZHDENO, adres: kod: mov r12, #0xbaf @0x84D4D8 | tmot-correction of lambda-weighting at catalyst heating" CURVE 0x18BB0 RL_GRID_UBYTE 0 CM_0p00390625_0 0 0.996094
 /begin AXIS_DESCR FIX_AXIS NO_INPUT_QUANTITY CM_IDENTITY 4 0 3 FIX_AXIS_PAR_DIST 0 1 4 /end AXIS_DESCR
/end CHARACTERISTIC
/begin CHARACTERISTIC MAP_446_18BBA_4 "adres podtverzhden mapscan addr 0x18BBA | IMYA NE PODTVERZHDENO, adres: kod: mov r12, #0xbb9 @0x84D3F8" CURVE 0x18BBA RL_2D_A16_UBYTE 0 CM_IDENTITY 0 255 /begin AXIS_DESCR STD_AXIS NO_INPUT_QUANTITY CM_IDENTITY 4 0 65535 /end AXIS_DESCR /end CHARACTERISTIC
/begin CHARACTERISTIC KFNLLKHM "podtverzhdena damos addr 0x18BC7 | Nominal idling speed during catalyzer heating" MAP 0x18BC7 RL_GRID_UBYTE 0 CM_10_0_Umin 0 2550
 /begin AXIS_DESCR FIX_AXIS NO_INPUT_QUANTITY CM_IDENTITY 4 0 3 FIX_AXIS_PAR_DIST 0 1 4 /end AXIS_DESCR
 /begin AXIS_DESCR FIX_AXIS NO_INPUT_QUANTITY CM_IDENTITY 8 0 7 FIX_AXIS_PAR_DIST 0 1 8 /end AXIS_DESCR
/end CHARACTERISTIC
/begin CHARACTERISTIC MLSUS "podtverzhdena damos addr 0x18BE9 | reference of air mass flow integral" CURVE 0x18BE9 RL_GRID_UBYTE 0 CM_0p02275555556_0_kg 0 5.80267
 /begin AXIS_DESCR FIX_AXIS NO_INPUT_QUANTITY CM_IDENTITY 12 0 11 FIX_AXIS_PAR_DIST 0 1 12 /end AXIS_DESCR
/end CHARACTERISTIC
/begin CHARACTERISTIC NFSKHM "adres podtverzhden damos-veroyatno addr 0x18C01 | IMYA NE PODTVERZHDENO, adres: kod: mov r12, #0xc01 @0x84D3B2 | LL nominal speed with driving graduations and catalyzer heating" CURVE 0x18C01 RL_GRID_UBYTE 0 CM_10_0_Umin 0 2550
 /begin AXIS_DESCR FIX_AXIS NO_INPUT_QUANTITY CM_IDENTITY 4 0 3 FIX_AXIS_PAR_DIST 0 1 4 /end AXIS_DESCR
/end CHARACTERISTIC
/begin CHARACTERISTIC MAP_452_18C2A_8 "veroyatnaya mapscan addr 0x18C2A" CURVE 0x18C2A RL_2D_A8_UBYTE 0 CM_IDENTITY 0 255 /begin AXIS_DESCR STD_AXIS NO_INPUT_QUANTITY CM_IDENTITY 8 0 255 /end AXIS_DESCR /end CHARACTERISTIC
/begin CHARACTERISTIC MAP_453_18C7C_8 "veroyatnaya mapscan addr 0x18C7C" CURVE 0x18C7C RL_2D_A8_UBYTE 0 CM_IDENTITY 0 255 /begin AXIS_DESCR STD_AXIS NO_INPUT_QUANTITY CM_IDENTITY 8 0 255 /end AXIS_DESCR /end CHARACTERISTIC
/begin CHARACTERISTIC MAP_454_18CCE_4 "adres podtverzhden mapscan addr 0x18CCE | IMYA NE PODTVERZHDENO, adres: kod: mov r12, #0xccd @0x84D6D4" CURVE 0x18CCE RL_2D_A8_UBYTE 0 CM_IDENTITY 0 255 /begin AXIS_DESCR STD_AXIS NO_INPUT_QUANTITY CM_IDENTITY 4 0 255 /end AXIS_DESCR /end CHARACTERISTIC
/begin CHARACTERISTIC MAP_456_18CE9_8 "adres podtverzhden mapscan addr 0x18CE9 | IMYA NE PODTVERZHDENO, adres: kod: mov r12, #0xce8 @0x84D972" CURVE 0x18CE9 RL_2D_A8_UBYTE 0 CM_IDENTITY 0 255 /begin AXIS_DESCR STD_AXIS NO_INPUT_QUANTITY CM_IDENTITY 8 0 255 /end AXIS_DESCR /end CHARACTERISTIC
/begin CHARACTERISTIC KFLMSKH "podtverzhdena damos-tochno addr 0x18CFA | Performance characteristics lambda engine nominal at catalyst heating" MAP 0x18CFA RL_GRID_UBYTE 0 CM_0p0078125_0 0 1.99219
 /begin AXIS_DESCR FIX_AXIS NO_INPUT_QUANTITY CM_IDENTITY 8 0 7 FIX_AXIS_PAR_DIST 0 1 8 /end AXIS_DESCR
 /begin AXIS_DESCR FIX_AXIS NO_INPUT_QUANTITY CM_IDENTITY 8 0 7 FIX_AXIS_PAR_DIST 0 1 8 /end AXIS_DESCR
/end CHARACTERISTIC
/begin CHARACTERISTIC MAP_458_18D3B_8 "adres podtverzhden mapscan addr 0x18D3B | IMYA NE PODTVERZHDENO, adres: kod: mov r12, #0xd3a @0x84D93C" CURVE 0x18D3B RL_2D_A8_UBYTE 0 CM_IDENTITY 0 255 /begin AXIS_DESCR STD_AXIS NO_INPUT_QUANTITY CM_IDENTITY 8 0 255 /end AXIS_DESCR /end CHARACTERISTIC
/begin CHARACTERISTIC LMSTMOT "veroyatnaya damos-veroyatno addr 0x18D4D | tmot-correction of lambda engine nominal" CURVE 0x18D4D RL_GRID_UBYTE 0 CM_0p0078125_0 0 1.99219
 /begin AXIS_DESCR FIX_AXIS NO_INPUT_QUANTITY CM_IDENTITY 4 0 3 FIX_AXIS_PAR_DIST 0 1 4 /end AXIS_DESCR
/end CHARACTERISTIC
/begin CHARACTERISTIC MAP_476_18E8E_4 "adres podtverzhden mapscan addr 0x18E8E | IMYA NE PODTVERZHDENO, adres: kod: mov r12, #0xe8d @0x84E3D8" CURVE 0x18E8E RL_2D_A16_UBYTE 0 CM_IDENTITY 0 255 /begin AXIS_DESCR STD_AXIS NO_INPUT_QUANTITY CM_IDENTITY 4 0 65535 /end AXIS_DESCR /end CHARACTERISTIC
/begin CHARACTERISTIC MAP_482_18F3D_4 "adres podtverzhden mapscan addr 0x18F3D | IMYA NE PODTVERZHDENO, adres: kod: mov r12, #0xf3d @0x84EE8A" CURVE 0x18F3D RL_2D_A8_UWORD 0 CM_IDENTITY 0 65535 /begin AXIS_DESCR STD_AXIS NO_INPUT_QUANTITY CM_IDENTITY 4 0 255 /end AXIS_DESCR /end CHARACTERISTIC
/begin CHARACTERISTIC MAP_484_18F61_4 "veroyatnaya mapscan addr 0x18F61" CURVE 0x18F61 RL_2D_A8_UBYTE 0 CM_IDENTITY 0 255 /begin AXIS_DESCR STD_AXIS NO_INPUT_QUANTITY CM_IDENTITY 4 0 255 /end AXIS_DESCR /end CHARACTERISTIC
/begin CHARACTERISTIC MAP_485_18F71_4 "adres podtverzhden mapscan addr 0x18F71 | IMYA NE PODTVERZHDENO, adres: kod: mov r12, #0xf71 @0x83F296" CURVE 0x18F71 RL_2D_A8_UBYTE 0 CM_IDENTITY 0 255 /begin AXIS_DESCR STD_AXIS NO_INPUT_QUANTITY CM_IDENTITY 4 0 255 /end AXIS_DESCR /end CHARACTERISTIC
/begin CHARACTERISTIC MAP_486_18FA2_4 "adres podtverzhden mapscan addr 0x18FA2 | IMYA NE PODTVERZHDENO, adres: kod: mov r12, #0xfa2 @0x8402EA" CURVE 0x18FA2 RL_2D_A8_UBYTE 0 CM_IDENTITY 0 255 /begin AXIS_DESCR STD_AXIS NO_INPUT_QUANTITY CM_IDENTITY 4 0 255 /end AXIS_DESCR /end CHARACTERISTIC
/begin CHARACTERISTIC MAP_487_18FB2_4 "veroyatnaya mapscan addr 0x18FB2" CURVE 0x18FB2 RL_2D_A8_UBYTE 0 CM_IDENTITY 0 255 /begin AXIS_DESCR STD_AXIS NO_INPUT_QUANTITY CM_IDENTITY 4 0 255 /end AXIS_DESCR /end CHARACTERISTIC
/begin CHARACTERISTIC SNM08GKUB "adres podtverzhden damos-veroyatno addr 0x19079 | IMYA NE PODTVERZHDENO, adres: kod: mov r12, #0x1078 @0x8429E8 | Datapoint distribution mixture control 8 nmot datapoints" CURVE 0x19079 RL_GRID_UBYTE 0 CM_40_0_Upm 0 10200
 /begin AXIS_DESCR FIX_AXIS NO_INPUT_QUANTITY CM_IDENTITY 8 0 7 FIX_AXIS_PAR_DIST 0 1 8 /end AXIS_DESCR
/end CHARACTERISTIC
/begin CHARACTERISTIC MAP_512_193E0_9 "adres podtverzhden mapscan addr 0x193E0 | IMYA NE PODTVERZHDENO, adres: kod: mov r12, #0x13e0 @0x85235C" CURVE 0x193E0 RL_2D_A8_UBYTE 0 CM_IDENTITY 0 255 /begin AXIS_DESCR STD_AXIS NO_INPUT_QUANTITY CM_IDENTITY 9 0 255 /end AXIS_DESCR /end CHARACTERISTIC
/begin CHARACTERISTIC MAP_521_196F8_5 "adres podtverzhden mapscan addr 0x196F8 | IMYA NE PODTVERZHDENO, adres: kod: mov r12, #0x16fe @0x851A0C" CURVE 0x196F8 RL_2D_A8_UBYTE 0 CM_IDENTITY 0 255 /begin AXIS_DESCR STD_AXIS NO_INPUT_QUANTITY CM_IDENTITY 5 0 255 /end AXIS_DESCR /end CHARACTERISTIC
/begin CHARACTERISTIC FQTEVA "neodnoznachnaya damos-somnitelno addr 0x19704 | progression of purge rate controller" CURVE 0x19704 RL_GRID_UBYTE 0 CM_0p0625_0 0 15.9375
 /begin AXIS_DESCR FIX_AXIS NO_INPUT_QUANTITY CM_IDENTITY 6 0 5 FIX_AXIS_PAR_DIST 0 1 6 /end AXIS_DESCR
/end CHARACTERISTIC
/begin CHARACTERISTIC MAP_523_19719_8 "adres podtverzhden mapscan addr 0x19719 | IMYA NE PODTVERZHDENO, adres: kod: mov r12, #0x1718 @0x8568A2" CURVE 0x19719 RL_2D_A8_UBYTE 0 CM_IDENTITY 0 255 /begin AXIS_DESCR STD_AXIS NO_INPUT_QUANTITY CM_IDENTITY 8 0 255 /end AXIS_DESCR /end CHARACTERISTIC
/begin CHARACTERISTIC KFTKONS "podtverzhdena damos-tochno addr 0x1972A | A/C switch-on delay time (morning brake sharpness)" MAP 0x1972A RL_GRID_UBYTE 0 CM_IDENTITY 0 255
 /begin AXIS_DESCR FIX_AXIS NO_INPUT_QUANTITY CM_IDENTITY 8 0 7 FIX_AXIS_PAR_DIST 0 1 8 /end AXIS_DESCR
 /begin AXIS_DESCR FIX_AXIS NO_INPUT_QUANTITY CM_IDENTITY 8 0 7 FIX_AXIS_PAR_DIST 0 1 8 /end AXIS_DESCR
/end CHARACTERISTIC
/begin CHARACTERISTIC MAP_525_1976E_6 "adres podtverzhden mapscan addr 0x1976E | IMYA NE PODTVERZHDENO, adres: kod: mov r12, #0x176e @0x857654" CURVE 0x1976E RL_2D_A8_UBYTE 0 CM_IDENTITY 0 255 /begin AXIS_DESCR STD_AXIS NO_INPUT_QUANTITY CM_IDENTITY 6 0 255 /end AXIS_DESCR /end CHARACTERISTIC
/begin CHARACTERISTIC MAP_526_1977E_5 "veroyatnaya mapscan addr 0x1977E" CURVE 0x1977E RL_2D_A8_UBYTE 0 CM_IDENTITY 0 255 /begin AXIS_DESCR STD_AXIS NO_INPUT_QUANTITY CM_IDENTITY 5 0 255 /end AXIS_DESCR /end CHARACTERISTIC
/begin CHARACTERISTIC MAP_527_1979E_6 "adres podtverzhden mapscan addr 0x1979E | IMYA NE PODTVERZHDENO, adres: kod: mov r12, #0x179e @0x85741E" CURVE 0x1979E RL_2D_A8_UBYTE 0 CM_IDENTITY 0 255 /begin AXIS_DESCR STD_AXIS NO_INPUT_QUANTITY CM_IDENTITY 6 0 255 /end AXIS_DESCR /end CHARACTERISTIC
/begin CHARACTERISTIC GRID_528_197BC_10x10 "adres podtverzhden gridscan addr 0x197BC | IMYA NE PODTVERZHDENO, adres: kod: mov r12, #0x17bc @0x8574EE" MAP 0x197BC RL_GRID_UBYTE 0 CM_IDENTITY 0 255
 /begin AXIS_DESCR FIX_AXIS NO_INPUT_QUANTITY CM_IDENTITY 10 0 9 FIX_AXIS_PAR_DIST 0 1 10 /end AXIS_DESCR
 /begin AXIS_DESCR FIX_AXIS NO_INPUT_QUANTITY CM_IDENTITY 10 0 9 FIX_AXIS_PAR_DIST 0 1 10 /end AXIS_DESCR
/end CHARACTERISTIC
/begin CHARACTERISTIC KFFTEAX "podtverzhdena damos addr 0x1982B | Characteristic map for limitation of the purge rate" MAP 0x1982B RL_GRID_UBYTE 0 CM_0p001953125_0 0 0.498047
 /begin AXIS_DESCR FIX_AXIS NO_INPUT_QUANTITY CM_IDENTITY 4 0 3 FIX_AXIS_PAR_DIST 0 1 4 /end AXIS_DESCR
 /begin AXIS_DESCR FIX_AXIS NO_INPUT_QUANTITY CM_IDENTITY 5 0 4 FIX_AXIS_PAR_DIST 0 1 5 /end AXIS_DESCR
/end CHARACTERISTIC
/begin CHARACTERISTIC KFQTE "podtverzhdena damos-tochno addr 0x1983F | Map for purge rate increase / decrease" MAP 0x1983F RL_GRID_UBYTE 0 CM_4p768359375En05_0_1s 0 0.0121593
 /begin AXIS_DESCR FIX_AXIS NO_INPUT_QUANTITY CM_IDENTITY 5 0 4 FIX_AXIS_PAR_DIST 0 1 5 /end AXIS_DESCR
 /begin AXIS_DESCR FIX_AXIS NO_INPUT_QUANTITY CM_IDENTITY 6 0 5 FIX_AXIS_PAR_DIST 0 1 6 /end AXIS_DESCR
/end CHARACTERISTIC
/begin CHARACTERISTIC KFTATX "podtverzhdena damos addr 0x1986F | map for max. duty cycle" MAP 0x1986F RL_GRID_UBYTE 0 CM_0p390625_0 0 99.6094
 /begin AXIS_DESCR FIX_AXIS NO_INPUT_QUANTITY CM_IDENTITY 6 0 5 FIX_AXIS_PAR_DIST 0 1 6 /end AXIS_DESCR
 /begin AXIS_DESCR FIX_AXIS NO_INPUT_QUANTITY CM_IDENTITY 10 0 9 FIX_AXIS_PAR_DIST 0 1 10 /end AXIS_DESCR
/end CHARACTERISTIC
/begin CHARACTERISTIC ZBTEML "veroyatnaya damos-veroyatno addr 0x198AD | integration speed for canister charge adaptation" CURVE 0x198AD RL_GRID_UBYTE 0 CM_0p02392578125_0_1s 0 6.10107
 /begin AXIS_DESCR FIX_AXIS NO_INPUT_QUANTITY CM_IDENTITY 6 0 5 FIX_AXIS_PAR_DIST 0 1 6 /end AXIS_DESCR
/end CHARACTERISTIC
/begin CHARACTERISTIC MAP_533_198B4_5 "adres podtverzhden mapscan addr 0x198B4 | IMYA NE PODTVERZHDENO, adres: kod: mov r12, #0x18b4 @0x857944" CURVE 0x198B4 RL_2D_A8_UWORD 0 CM_IDENTITY 0 65535 /begin AXIS_DESCR STD_AXIS NO_INPUT_QUANTITY CM_IDENTITY 5 0 255 /end AXIS_DESCR /end CHARACTERISTIC
/begin CHARACTERISTIC KFTEVP "podtverzhdena damos-tochno addr 0x198C4 | Characteristic map for period time of the PCV" MAP 0x198C4 RL_GRID_UBYTE 0 CM_0p5_0_ms 0 127.5
 /begin AXIS_DESCR FIX_AXIS NO_INPUT_QUANTITY CM_IDENTITY 9 0 8 FIX_AXIS_PAR_DIST 0 1 9 /end AXIS_DESCR
 /begin AXIS_DESCR FIX_AXIS NO_INPUT_QUANTITY CM_IDENTITY 5 0 4 FIX_AXIS_PAR_DIST 0 1 5 /end AXIS_DESCR
/end CHARACTERISTIC
/begin CHARACTERISTIC KFTVTEV "podtverzhdena damos addr 0x198FC | characteristic map for CVP delay time" MAP 0x198FC RL_GRID_UBYTE 0 CM_0p5_0_ms 0 127.5
 /begin AXIS_DESCR FIX_AXIS NO_INPUT_QUANTITY CM_IDENTITY 3 0 2 FIX_AXIS_PAR_DIST 0 1 3 /end AXIS_DESCR
 /begin AXIS_DESCR FIX_AXIS NO_INPUT_QUANTITY CM_IDENTITY 6 0 5 FIX_AXIS_PAR_DIST 0 1 6 /end AXIS_DESCR
/end CHARACTERISTIC
/begin CHARACTERISTIC KFDETATE "podtverzhdena damos-tochno addr 0x19923 | correction of ignition angle effectiveness for diagnosis of PCV" MAP 0x19923 RL_GRID_UBYTE 0 CM_0p5_0 0 127.5
 /begin AXIS_DESCR FIX_AXIS NO_INPUT_QUANTITY CM_IDENTITY 6 0 5 FIX_AXIS_PAR_DIST 0 1 6 /end AXIS_DESCR
 /begin AXIS_DESCR FIX_AXIS NO_INPUT_QUANTITY CM_IDENTITY 4 0 3 FIX_AXIS_PAR_DIST 0 1 4 /end AXIS_DESCR
/end CHARACTERISTIC
/begin CHARACTERISTIC MAP_537_19950_14 "adres podtverzhden mapscan addr 0x19950 | IMYA NE PODTVERZHDENO, adres: kod: mov r12, #0x1950 @0x858182" CURVE 0x19950 RL_2D_A8_UBYTE 0 CM_IDENTITY 0 255 /begin AXIS_DESCR STD_AXIS NO_INPUT_QUANTITY CM_IDENTITY 14 0 255 /end AXIS_DESCR /end CHARACTERISTIC
/begin CHARACTERISTIC KFMDDAGR "podtverzhdena damos-tochno addr 0x199A7 | Map torque reserve at tester demand of EGR-short test" MAP 0x199A7 RL_GRID_UBYTE 0 CM_0p390625_0 0 99.6094
 /begin AXIS_DESCR FIX_AXIS NO_INPUT_QUANTITY CM_IDENTITY 8 0 7 FIX_AXIS_PAR_DIST 0 1 8 /end AXIS_DESCR
 /begin AXIS_DESCR FIX_AXIS NO_INPUT_QUANTITY CM_IDENTITY 8 0 7 FIX_AXIS_PAR_DIST 0 1 8 /end AXIS_DESCR
/end CHARACTERISTIC
/begin CHARACTERISTIC DTLRTML "adres podtverzhden damos-veroyatno addr 0x19A1B | IMYA NE PODTVERZHDENO, adres: kod: mov r12, #0x1a1a @0x8572A2 | proportion factor to decrease waiting time up to tmot-threshold for closed loop" CURVE 0x19A1B RL_GRID_UBYTE 0 CM_0p390625_0 0 99.6094
 /begin AXIS_DESCR FIX_AXIS NO_INPUT_QUANTITY CM_IDENTITY 7 0 6 FIX_AXIS_PAR_DIST 0 1 7 /end AXIS_DESCR
/end CHARACTERISTIC
/begin CHARACTERISTIC TMLRTMS "adres podtverzhden damos-veroyatno addr 0x19A26 | IMYA NE PODTVERZHDENO, adres: kod: mov r12, #0x1a25 @0x8604D6 | engine temp. threshold for lambda control depending on cranking temp. tmst" CURVE 0x19A26 RL_GRID_SBYTE 0 CM_0p75_48_GradC -144 47.25
 /begin AXIS_DESCR FIX_AXIS NO_INPUT_QUANTITY CM_IDENTITY 4 0 3 FIX_AXIS_PAR_DIST 0 1 4 /end AXIS_DESCR
/end CHARACTERISTIC
/begin CHARACTERISTIC MAP_541_19A2F_20 "adres podtverzhden mapscan addr 0x19A2F | IMYA NE PODTVERZHDENO, adres: kod: mov r12, #0x1a2f @0x860424" CURVE 0x19A2F RL_2D_A8_UBYTE 0 CM_IDENTITY 0 255 /begin AXIS_DESCR STD_AXIS NO_INPUT_QUANTITY CM_IDENTITY 20 0 255 /end AXIS_DESCR /end CHARACTERISTIC
/begin CHARACTERISTIC TWLRTMS "adres podtverzhden damos-veroyatno addr 0x19A5A | IMYA NE PODTVERZHDENO, adres: kod: mov r12, #0x1a59 @0x860534 | waiting time up to check engine temp. signal exceeding threshold for closed loop" CURVE 0x19A5A RL_GRID_UBYTE 0 CM_20_0_s 0 5100
 /begin AXIS_DESCR FIX_AXIS NO_INPUT_QUANTITY CM_IDENTITY 4 0 3 FIX_AXIS_PAR_DIST 0 1 4 /end AXIS_DESCR
/end CHARACTERISTIC
/begin CHARACTERISTIC MAP_543_19A6B_20 "adres podtverzhden mapscan addr 0x19A6B | IMYA NE PODTVERZHDENO, adres: kod: mov r12, #0x1a6b @0x860EC2" CURVE 0x19A6B RL_2D_A8_UBYTE 0 CM_IDENTITY 0 255 /begin AXIS_DESCR STD_AXIS NO_INPUT_QUANTITY CM_IDENTITY 20 0 255 /end AXIS_DESCR /end CHARACTERISTIC
/begin CHARACTERISTIC MAP_544_19AAC_4 "adres podtverzhden mapscan addr 0x19AAC | IMYA NE PODTVERZHDENO, adres: kod: mov r12, #0x1aab @0x8616A0" CURVE 0x19AAC RL_2D_A8_UBYTE 0 CM_IDENTITY 0 255 /begin AXIS_DESCR STD_AXIS NO_INPUT_QUANTITY CM_IDENTITY 4 0 255 /end AXIS_DESCR /end CHARACTERISTIC
/begin CHARACTERISTIC KFIDTHM "podtverzhdena damos-tochno addr 0x19AB5 | Map value for threshold of integrated air mass for thermostat error detection" MAP 0x19AB5 RL_GRID_UBYTE 0 CM_0p09103840683_0_kg 0 23.2148
 /begin AXIS_DESCR FIX_AXIS NO_INPUT_QUANTITY CM_IDENTITY 4 0 3 FIX_AXIS_PAR_DIST 0 1 4 /end AXIS_DESCR
 /begin AXIS_DESCR FIX_AXIS NO_INPUT_QUANTITY CM_IDENTITY 4 0 3 FIX_AXIS_PAR_DIST 0 1 4 /end AXIS_DESCR
/end CHARACTERISTIC
/begin CHARACTERISTIC LURKH "adres podtverzhden damos-veroyatno addr 0x19AD3 | IMYA NE PODTVERZHDENO, adres: kod: mov r12, #0x1ad2 @0x8666FA | dmrkh-depen. engine roughness reference correction value, during cat heating" CURVE 0x19AD3 RL_GRID_UBYTE 0 CM_0p0078125_0 0 1.99219
 /begin AXIS_DESCR FIX_AXIS NO_INPUT_QUANTITY CM_IDENTITY 4 0 3 FIX_AXIS_PAR_DIST 0 1 4 /end AXIS_DESCR
/end CHARACTERISTIC
/begin CHARACTERISTIC AINTKAN "adres podtverzhden damos-veroyatno addr 0x19ADB | IMYA NE PODTVERZHDENO, adres: kod: mov r12, #0x1adb @0x868828 | number of interval misfire frequency at which ti- cutoff" CURVE 0x19ADB RL_GRID_UBYTE 0 CM_IDENTITY 0 255
 /begin AXIS_DESCR FIX_AXIS NO_INPUT_QUANTITY CM_IDENTITY 8 0 7 FIX_AXIS_PAR_DIST 0 1 8 /end AXIS_DESCR
/end CHARACTERISTIC
/begin CHARACTERISTIC SLX06TMUW "adres podtverzhden damos-veroyatno addr 0x19BE8 | IMYA NE PODTVERZHDENO, adres: kod: mov r12, #0x1be6 @0x834F66 | lamsbg dependet basic point (number 6)" CURVE 0x19BE8 RL_GRID_UBYTE 0 CM_0p000244140625_0 0 0.0622559
 /begin AXIS_DESCR FIX_AXIS NO_INPUT_QUANTITY CM_IDENTITY 6 0 5 FIX_AXIS_PAR_DIST 0 1 6 /end AXIS_DESCR
/end CHARACTERISTIC
/begin CHARACTERISTIC SML07TMUW "adres podtverzhden damos-veroyatno addr 0x19BF6 | IMYA NE PODTVERZHDENO, adres: kod: mov r12, #0x1bf4 @0x834F4E | ml dependet basic point (number 7)" CURVE 0x19BF6 RL_GRID_UBYTE 0 CM_0p1_0_kgh 0 25.5
 /begin AXIS_DESCR FIX_AXIS NO_INPUT_QUANTITY CM_IDENTITY 7 0 6 FIX_AXIS_PAR_DIST 0 1 7 /end AXIS_DESCR
/end CHARACTERISTIC
/begin CHARACTERISTIC SRL04DYUB "adres podtverzhden damos-veroyatno addr 0x19C04 | IMYA NE PODTVERZHDENO, adres: kod: mov r12, #0x1c04 @0x834B2C | basepoint distribution of rl, 4 basepoints" CURVE 0x19C04 RL_GRID_UBYTE 0 CM_IDENTITY 0 255
 /begin AXIS_DESCR FIX_AXIS NO_INPUT_QUANTITY CM_IDENTITY 4 0 3 FIX_AXIS_PAR_DIST 0 1 4 /end AXIS_DESCR
/end CHARACTERISTIC
/begin CHARACTERISTIC MAP_561_1A692_12 "adres podtverzhden mapscan addr 0x1A692 | IMYA NE PODTVERZHDENO, adres: kod: mov r4, #0x269f @0x83E348" CURVE 0x1A692 RL_2D_A8_UWORD 0 CM_IDENTITY 0 65535 /begin AXIS_DESCR STD_AXIS NO_INPUT_QUANTITY CM_IDENTITY 12 0 255 /end AXIS_DESCR /end CHARACTERISTIC
/begin CHARACTERISTIC MAP_565_1A84A_6 "adres podtverzhden mapscan addr 0x1A84A | IMYA NE PODTVERZHDENO, adres: kod: mov r4, #0x2851 @0x83E50E" CURVE 0x1A84A RL_2D_A8_UWORD 0 CM_IDENTITY 0 65535 /begin AXIS_DESCR STD_AXIS NO_INPUT_QUANTITY CM_IDENTITY 6 0 255 /end AXIS_DESCR /end CHARACTERISTIC
/begin CHARACTERISTIC MAP_566_1A88A_6 "adres podtverzhden mapscan addr 0x1A88A | IMYA NE PODTVERZHDENO, adres: kod: mov r4, #0x2891 @0x840358" CURVE 0x1A88A RL_2D_A8_UWORD 0 CM_IDENTITY 0 65535 /begin AXIS_DESCR STD_AXIS NO_INPUT_QUANTITY CM_IDENTITY 6 0 255 /end AXIS_DESCR /end CHARACTERISTIC
/begin CHARACTERISTIC MAP_568_1A945_4 "veroyatnaya mapscan addr 0x1A945" CURVE 0x1A945 RL_2D_A16_UWORD 0 CM_IDENTITY 0 65535 /begin AXIS_DESCR STD_AXIS NO_INPUT_QUANTITY CM_IDENTITY 4 0 65535 /end AXIS_DESCR /end CHARACTERISTIC
/begin CHARACTERISTIC MAP_569_1A965_4 "veroyatnaya mapscan addr 0x1A965" CURVE 0x1A965 RL_2D_A16_UWORD 0 CM_IDENTITY 0 65535 /begin AXIS_DESCR STD_AXIS NO_INPUT_QUANTITY CM_IDENTITY 4 0 65535 /end AXIS_DESCR /end CHARACTERISTIC
/begin CHARACTERISTIC MAP_572_1AA3A_4 "veroyatnaya mapscan addr 0x1AA3A" CURVE 0x1AA3A RL_2D_A8_UWORD 0 CM_IDENTITY 0 65535 /begin AXIS_DESCR STD_AXIS NO_INPUT_QUANTITY CM_IDENTITY 4 0 255 /end AXIS_DESCR /end CHARACTERISTIC
/begin CHARACTERISTIC MAP_573_1AB22_4 "veroyatnaya mapscan addr 0x1AB22" CURVE 0x1AB22 RL_2D_A8_UWORD 0 CM_IDENTITY 0 65535 /begin AXIS_DESCR STD_AXIS NO_INPUT_QUANTITY CM_IDENTITY 4 0 255 /end AXIS_DESCR /end CHARACTERISTIC
/begin CHARACTERISTIC MAP_574_1AC8F_6 "veroyatnaya mapscan addr 0x1AC8F" CURVE 0x1AC8F RL_2D_A16_UWORD 0 CM_IDENTITY 0 65535 /begin AXIS_DESCR STD_AXIS NO_INPUT_QUANTITY CM_IDENTITY 6 0 65535 /end AXIS_DESCR /end CHARACTERISTIC
/begin CHARACTERISTIC MAP_575_1ADDB_5 "adres podtverzhden mapscan addr 0x1ADDB | IMYA NE PODTVERZHDENO, adres: kod: mov r4, #0x2de6 @0x84428C" CURVE 0x1ADDB RL_2D_A16_UWORD 0 CM_IDENTITY 0 65535 /begin AXIS_DESCR STD_AXIS NO_INPUT_QUANTITY CM_IDENTITY 5 0 65535 /end AXIS_DESCR /end CHARACTERISTIC
/begin CHARACTERISTIC MAP_576_1AEC3_6 "adres podtverzhden mapscan addr 0x1AEC3 | IMYA NE PODTVERZHDENO, adres: kod: mov r12, #0x2ec2 @0x84519C" CURVE 0x1AEC3 RL_2D_A8_UBYTE 0 CM_IDENTITY 0 255 /begin AXIS_DESCR STD_AXIS NO_INPUT_QUANTITY CM_IDENTITY 6 0 255 /end AXIS_DESCR /end CHARACTERISTIC
/begin CHARACTERISTIC MAP_577_1AF14_6 "adres podtverzhden mapscan addr 0x1AF14 | IMYA NE PODTVERZHDENO, adres: kod: mov r12, #0x2f14 @0x845476" CURVE 0x1AF14 RL_2D_A16_UWORD 0 CM_IDENTITY 0 65535 /begin AXIS_DESCR STD_AXIS NO_INPUT_QUANTITY CM_IDENTITY 6 0 65535 /end AXIS_DESCR /end CHARACTERISTIC
/begin CHARACTERISTIC MAP_578_1B0C2_5 "veroyatnaya mapscan addr 0x1B0C2" CURVE 0x1B0C2 RL_2D_A8_UWORD 0 CM_IDENTITY 0 65535 /begin AXIS_DESCR STD_AXIS NO_INPUT_QUANTITY CM_IDENTITY 5 0 255 /end AXIS_DESCR /end CHARACTERISTIC
/begin CHARACTERISTIC MAP_585_1B497_8 "adres podtverzhden mapscan addr 0x1B497 | IMYA NE PODTVERZHDENO, adres: kod: mov r4, #0x34a8 @0x851CB2" CURVE 0x1B497 RL_2D_A16_UBYTE 0 CM_IDENTITY 0 255 /begin AXIS_DESCR STD_AXIS NO_INPUT_QUANTITY CM_IDENTITY 8 0 65535 /end AXIS_DESCR /end CHARACTERISTIC
/begin CHARACTERISTIC MAP_587_1B5E1_6 "adres podtverzhden mapscan addr 0x1B5E1 | IMYA NE PODTVERZHDENO, adres: kod: mov r4, #0x35e8 @0x8548B4" CURVE 0x1B5E1 RL_2D_A8_UWORD 0 CM_IDENTITY 0 65535 /begin AXIS_DESCR STD_AXIS NO_INPUT_QUANTITY CM_IDENTITY 6 0 255 /end AXIS_DESCR /end CHARACTERISTIC
/begin CHARACTERISTIC MAP_588_1B612_5 "adres podtverzhden mapscan addr 0x1B612 | IMYA NE PODTVERZHDENO, adres: kod: mov r4, #0x3618 @0x8548E8" CURVE 0x1B612 RL_2D_A8_UWORD 0 CM_IDENTITY 0 65535 /begin AXIS_DESCR STD_AXIS NO_INPUT_QUANTITY CM_IDENTITY 5 0 255 /end AXIS_DESCR /end CHARACTERISTIC
/begin CHARACTERISTIC PAGAVML "veroyatnaya damos-veroyatno addr 0x1B640 | exhaust gas pressure at outlet valve" CURVE 0x1B640 RL_GRID_UBYTE 0 CM_0p0390625_0_hPa 0 9.96094
 /begin AXIS_DESCR FIX_AXIS NO_INPUT_QUANTITY CM_IDENTITY 6 0 5 FIX_AXIS_PAR_DIST 0 1 6 /end AXIS_DESCR
/end CHARACTERISTIC
/begin CHARACTERISTIC ATMTANS "podtverzhdena damos addr 0x1B67A | temperature correction of the exhaust model temperature" CURVE 0x1B67A RL_GRID_SBYTE 0 CM_5_0_GradC -640 635
 /begin AXIS_DESCR FIX_AXIS NO_INPUT_QUANTITY CM_IDENTITY 3 0 2 FIX_AXIS_PAR_DIST 0 1 3 /end AXIS_DESCR
/end CHARACTERISTIC
/begin CHARACTERISTIC KDLASHKI "neodnoznachnaya damos-somnitelno addr 0x1B899 | evaluation factor of I-part of LRHK, f(dlashkm)" CURVE 0x1B899 RL_GRID_SWORD 0 CM_3p051757812En05_0 -1 0.999969
 /begin AXIS_DESCR FIX_AXIS NO_INPUT_QUANTITY CM_IDENTITY 10 0 9 FIX_AXIS_PAR_DIST 0 1 10 /end AXIS_DESCR
/end CHARACTERISTIC
/begin CHARACTERISTIC MAP_602_1B8C0_5 "adres podtverzhden mapscan addr 0x1B8C0 | IMYA NE PODTVERZHDENO, adres: kod: mov r12, #0x38c0 @0x8574BA" CURVE 0x1B8C0 RL_2D_A8_UBYTE 0 CM_IDENTITY 0 255 /begin AXIS_DESCR STD_AXIS NO_INPUT_QUANTITY CM_IDENTITY 5 0 255 /end AXIS_DESCR /end CHARACTERISTIC
/begin CHARACTERISTIC MAP_603_1B91F_5 "adres podtverzhden mapscan addr 0x1B91F | IMYA NE PODTVERZHDENO, adres: kod: mov r4, #0x3925 @0x85748A" CURVE 0x1B91F RL_2D_A8_UBYTE 0 CM_IDENTITY 0 255 /begin AXIS_DESCR STD_AXIS NO_INPUT_QUANTITY CM_IDENTITY 5 0 255 /end AXIS_DESCR /end CHARACTERISTIC
/begin CHARACTERISTIC FKHLA "podtverzhdena damos addr 0x1B950 | Weighting factor Lambda nominal for catalyzer heating" CURVE 0x1B950 RL_GRID_UWORD 0 CM_1p525878906En05_0 0 0.999985
 /begin AXIS_DESCR FIX_AXIS NO_INPUT_QUANTITY CM_IDENTITY 8 0 7 FIX_AXIS_PAR_DIST 0 1 8 /end AXIS_DESCR
/end CHARACTERISTIC
/begin CHARACTERISTIC FKHMD "podtverzhdena damos addr 0x1B96C | Weighting factor torque reserve for catalyzer heating" CURVE 0x1B96C RL_GRID_UWORD 0 CM_1p525878906En05_0 0 0.999985
 /begin AXIS_DESCR FIX_AXIS NO_INPUT_QUANTITY CM_IDENTITY 8 0 7 FIX_AXIS_PAR_DIST 0 1 8 /end AXIS_DESCR
/end CHARACTERISTIC
/begin CHARACTERISTIC MAP_608_1B9EC_4 "adres podtverzhden mapscan addr 0x1B9EC | IMYA NE PODTVERZHDENO, adres: kod: mov r13, #0x39ec @0x860A7C" CURVE 0x1B9EC RL_2D_A8_UBYTE 0 CM_IDENTITY 0 255 /begin AXIS_DESCR STD_AXIS NO_INPUT_QUANTITY CM_IDENTITY 4 0 255 /end AXIS_DESCR /end CHARACTERISTIC
/begin CHARACTERISTIC MAP_614_1BC7A_8 "veroyatnaya mapscan addr 0x1BC7A" CURVE 0x1BC7A RL_2D_A8_UBYTE 0 CM_IDENTITY 0 255 /begin AXIS_DESCR STD_AXIS NO_INPUT_QUANTITY CM_IDENTITY 8 0 255 /end AXIS_DESCR /end CHARACTERISTIC
/begin CHARACTERISTIC ZMRFABN "veroyatnaya damos-veroyatno addr 0x1BCDB | calculation of current time constant of low pass (permanent high load) mrfabnf_w" CURVE 0x1BCDB RL_GRID_UBYTE 0 CM_IDENTITY 0 255
 /begin AXIS_DESCR FIX_AXIS NO_INPUT_QUANTITY CM_IDENTITY 5 0 4 FIX_AXIS_PAR_DIST 0 1 5 /end AXIS_DESCR
/end CHARACTERISTIC
/begin CHARACTERISTIC MAP_623_1BD71_5 "veroyatnaya mapscan addr 0x1BD71" CURVE 0x1BD71 RL_2D_A16_UWORD 0 CM_IDENTITY 0 65535 /begin AXIS_DESCR STD_AXIS NO_INPUT_QUANTITY CM_IDENTITY 5 0 65535 /end AXIS_DESCR /end CHARACTERISTIC
/begin CHARACTERISTIC FQTEPT "podtverzhdena damos addr 0x1BE3F | characteristic line: for fuel-tank underpressure limitation" CURVE 0x1BE3F RL_GRID_SBYTE 0 CM_0p125_0 -16 15.875
 /begin AXIS_DESCR FIX_AXIS NO_INPUT_QUANTITY CM_IDENTITY 6 0 5 FIX_AXIS_PAR_DIST 0 1 6 /end AXIS_DESCR
/end CHARACTERISTIC
/begin CHARACTERISTIC KFETATE "veroyatnaya damos-veroyatno addr 0x1BE5E | characteristic map for efficency at active purging when te is near TEMIN" MAP 0x1BE5E RL_GRID_UWORD 0 CM_0p001953125_0 0 127.998
 /begin AXIS_DESCR FIX_AXIS NO_INPUT_QUANTITY CM_IDENTITY 5 0 4 FIX_AXIS_PAR_DIST 0 1 5 /end AXIS_DESCR
 /begin AXIS_DESCR FIX_AXIS NO_INPUT_QUANTITY CM_IDENTITY 3 0 2 FIX_AXIS_PAR_DIST 0 1 3 /end AXIS_DESCR
/end CHARACTERISTIC
/begin CHARACTERISTIC KFTEKA "somnitelnaya damos-somnitelno addr 0x1BE8A | characteristic map of desired fuel portion purge control" MAP 0x1BE8A RL_GRID_SBYTE 0 CM_0p0078125_0 -1 0.992188
 /begin AXIS_DESCR FIX_AXIS NO_INPUT_QUANTITY CM_IDENTITY 5 0 4 FIX_AXIS_PAR_DIST 0 1 5 /end AXIS_DESCR
 /begin AXIS_DESCR FIX_AXIS NO_INPUT_QUANTITY CM_IDENTITY 5 0 4 FIX_AXIS_PAR_DIST 0 1 5 /end AXIS_DESCR
/end CHARACTERISTIC
/begin CHARACTERISTIC KFDTMTE "veroyatnaya damos-veroyatno addr 0x1BF29 | char. map for gradient of engine coolant temperature in substitute temp. model" MAP 0x1BF29 RL_GRID_SBYTE 0 CM_0p000732421875_0_GradC -0.09375 0.0930176
 /begin AXIS_DESCR FIX_AXIS NO_INPUT_QUANTITY CM_IDENTITY 4 0 3 FIX_AXIS_PAR_DIST 0 1 4 /end AXIS_DESCR
 /begin AXIS_DESCR FIX_AXIS NO_INPUT_QUANTITY CM_IDENTITY 5 0 4 FIX_AXIS_PAR_DIST 0 1 5 /end AXIS_DESCR
/end CHARACTERISTIC
/begin CHARACTERISTIC KFDTMTR "veroyatnaya damos-veroyatno addr 0x1BF49 | char. map for gradient of engine coolant temperature in reference model" MAP 0x1BF49 RL_GRID_SBYTE 0 CM_0p000732421875_0_GradC -0.09375 0.0930176
 /begin AXIS_DESCR FIX_AXIS NO_INPUT_QUANTITY CM_IDENTITY 4 0 3 FIX_AXIS_PAR_DIST 0 1 4 /end AXIS_DESCR
 /begin AXIS_DESCR FIX_AXIS NO_INPUT_QUANTITY CM_IDENTITY 5 0 4 FIX_AXIS_PAR_DIST 0 1 5 /end AXIS_DESCR
/end CHARACTERISTIC
/begin CHARACTERISTIC KLDTMRS "veroyatnaya damos-veroyatno addr 0x1BF5F | char.line for gradient of engine coolant temp. during cutoff for reference model" CURVE 0x1BF5F RL_GRID_SBYTE 0 CM_0p000732421875_0_GradC -0.09375 0.0930176
 /begin AXIS_DESCR FIX_AXIS NO_INPUT_QUANTITY CM_IDENTITY 5 0 4 FIX_AXIS_PAR_DIST 0 1 5 /end AXIS_DESCR
/end CHARACTERISTIC
/begin CHARACTERISTIC DFPSLBIT "veroyatnaya damos-veroyatno addr 0x1BF7C | Section bits for indication of the activated error paths" CURVE 0x1BF7C RL_GRID_UBYTE 0 CM_IDENTITY 0 255
 /begin AXIS_DESCR FIX_AXIS NO_INPUT_QUANTITY CM_IDENTITY 16 0 15 FIX_AXIS_PAR_DIST 0 1 16 /end AXIS_DESCR
/end CHARACTERISTIC
/begin CHARACTERISTIC LURBRL8 "veroyatnaya damos-veroyatno addr 0x1BF9F | reference value for engine roughness, vehicle speed zero" CURVE 0x1BF9F RL_GRID_SBYTE 0 CM_IDENTITY -128 127
 /begin AXIS_DESCR FIX_AXIS NO_INPUT_QUANTITY CM_IDENTITY 8 0 7 FIX_AXIS_PAR_DIST 0 1 8 /end AXIS_DESCR
/end CHARACTERISTIC
/begin CHARACTERISTIC CL30LINE "veroyatnaya damos-veroyatno addr 0x1C3E2 | 30th line of classtable" CURVE 0x1C3E2 RL_GRID_UBYTE 0 CM_IDENTITY 0 255
 /begin AXIS_DESCR FIX_AXIS NO_INPUT_QUANTITY CM_IDENTITY 13 0 12 FIX_AXIS_PAR_DIST 0 1 13 /end AXIS_DESCR
/end CHARACTERISTIC
/begin CHARACTERISTIC CL31LINE "veroyatnaya damos-veroyatno addr 0x1C3F0 | 31th line of classtable" CURVE 0x1C3F0 RL_GRID_UBYTE 0 CM_IDENTITY 0 255
 /begin AXIS_DESCR FIX_AXIS NO_INPUT_QUANTITY CM_IDENTITY 13 0 12 FIX_AXIS_PAR_DIST 0 1 13 /end AXIS_DESCR
/end CHARACTERISTIC
/begin CHARACTERISTIC CL32LINE "veroyatnaya damos-veroyatno addr 0x1C3FE | 32th line of classtable" CURVE 0x1C3FE RL_GRID_UBYTE 0 CM_IDENTITY 0 255
 /begin AXIS_DESCR FIX_AXIS NO_INPUT_QUANTITY CM_IDENTITY 13 0 12 FIX_AXIS_PAR_DIST 0 1 13 /end AXIS_DESCR
/end CHARACTERISTIC
/begin CHARACTERISTIC CL33LINE "veroyatnaya damos-veroyatno addr 0x1C40C | 33th line of classtable" CURVE 0x1C40C RL_GRID_UBYTE 0 CM_IDENTITY 0 255
 /begin AXIS_DESCR FIX_AXIS NO_INPUT_QUANTITY CM_IDENTITY 13 0 12 FIX_AXIS_PAR_DIST 0 1 13 /end AXIS_DESCR
/end CHARACTERISTIC
/begin CHARACTERISTIC CL34LINE "veroyatnaya damos-veroyatno addr 0x1C41A | 34th line of classtable" CURVE 0x1C41A RL_GRID_UBYTE 0 CM_IDENTITY 0 255
 /begin AXIS_DESCR FIX_AXIS NO_INPUT_QUANTITY CM_IDENTITY 13 0 12 FIX_AXIS_PAR_DIST 0 1 13 /end AXIS_DESCR
/end CHARACTERISTIC
/begin CHARACTERISTIC CL35LINE "veroyatnaya damos-veroyatno addr 0x1C428 | 35th line of classtable" CURVE 0x1C428 RL_GRID_UBYTE 0 CM_IDENTITY 0 255
 /begin AXIS_DESCR FIX_AXIS NO_INPUT_QUANTITY CM_IDENTITY 13 0 12 FIX_AXIS_PAR_DIST 0 1 13 /end AXIS_DESCR
/end CHARACTERISTIC
/begin CHARACTERISTIC CL36LINE "veroyatnaya damos-veroyatno addr 0x1C436 | 36th line of classtable" CURVE 0x1C436 RL_GRID_UBYTE 0 CM_IDENTITY 0 255
 /begin AXIS_DESCR FIX_AXIS NO_INPUT_QUANTITY CM_IDENTITY 13 0 12 FIX_AXIS_PAR_DIST 0 1 13 /end AXIS_DESCR
/end CHARACTERISTIC
/begin CHARACTERISTIC CL37LINE "veroyatnaya damos-veroyatno addr 0x1C444 | 37th line of classtable" CURVE 0x1C444 RL_GRID_UBYTE 0 CM_IDENTITY 0 255
 /begin AXIS_DESCR FIX_AXIS NO_INPUT_QUANTITY CM_IDENTITY 13 0 12 FIX_AXIS_PAR_DIST 0 1 13 /end AXIS_DESCR
/end CHARACTERISTIC
/begin CHARACTERISTIC CL38LINE "veroyatnaya damos-veroyatno addr 0x1C452 | 38th line of classtable" CURVE 0x1C452 RL_GRID_UBYTE 0 CM_IDENTITY 0 255
 /begin AXIS_DESCR FIX_AXIS NO_INPUT_QUANTITY CM_IDENTITY 13 0 12 FIX_AXIS_PAR_DIST 0 1 13 /end AXIS_DESCR
/end CHARACTERISTIC
/begin CHARACTERISTIC CL39LINE "veroyatnaya damos-veroyatno addr 0x1C460 | 39th line of classtable" CURVE 0x1C460 RL_GRID_UBYTE 0 CM_IDENTITY 0 255
 /begin AXIS_DESCR FIX_AXIS NO_INPUT_QUANTITY CM_IDENTITY 13 0 12 FIX_AXIS_PAR_DIST 0 1 13 /end AXIS_DESCR
/end CHARACTERISTIC
/begin CHARACTERISTIC DIAG_FLAGS "podtverzhdena | Tablica flagov diagnostiki (znacheniya 0/1). V proshivke csok chast edinic zamenena nulyami otnositelno stoka -- otklyucheny proverki." VALUE 0x10009 RL_GRID_UBYTE 0 CM_IDENTITY -0 255 /end CHARACTERISTIC
/begin CHARACTERISTIC CLAHSH "podogrev datchika posle katalizatora" VALUE 0x11DA5 RL_GRID_UBYTE 0 CM_IDENTITY -0 255 /end CHARACTERISTIC
/begin CHARACTERISTIC CLAKAT "diagnostika katalizatora" VALUE 0x11DA9 RL_GRID_UBYTE 0 CM_IDENTITY -0 255 /end CHARACTERISTIC
/begin CHARACTERISTIC CLALASH "starenie datchika posle katalizatora" VALUE 0x11DB3 RL_GRID_UBYTE 0 CM_IDENTITY -0 255 /end CHARACTERISTIC
/begin CHARACTERISTIC CLALSH "sam datchik posle katalizatora" VALUE 0x11DB8 RL_GRID_UBYTE 0 CM_IDENTITY -0 255 /end CHARACTERISTIC
/begin CHARACTERISTIC CLAFRAO "" VALUE 0x11DA1 RL_GRID_UBYTE 0 CM_IDENTITY -0 255 /end CHARACTERISTIC
/begin CHARACTERISTIC CLAFRAU "" VALUE 0x11DA2 RL_GRID_UBYTE 0 CM_IDENTITY -0 255 /end CHARACTERISTIC
/begin CHARACTERISTIC CLAHSV "" VALUE 0x11DA7 RL_GRID_UBYTE 0 CM_IDENTITY -0 255 /end CHARACTERISTIC
/begin CHARACTERISTIC CLALATP "" VALUE 0x11DB4 RL_GRID_UBYTE 0 CM_IDENTITY -0 255 /end CHARACTERISTIC
/begin CHARACTERISTIC CLALATV "" VALUE 0x11DB5 RL_GRID_UBYTE 0 CM_IDENTITY -0 255 /end CHARACTERISTIC
/begin CHARACTERISTIC CLARKAT "" VALUE 0x11DC7 RL_GRID_UBYTE 0 CM_IDENTITY -0 255 /end CHARACTERISTIC
/begin CHARACTERISTIC DTC_CODES "adres podtverzhden | fault code table, 144 words, four entries per code" CURVE 0x1653A RL_GRID_UWORD 0 CM_IDENTITY -0 65535
 /begin AXIS_DESCR FIX_AXIS NO_INPUT_QUANTITY CM_IDENTITY 144 0 143 FIX_AXIS_PAR_DIST 0 1 144 /end AXIS_DESCR
/end CHARACTERISTIC
/begin CHARACTERISTIC TATELL "podtverzhdena | tans-threshold for canister purge control with B_ll = 1" VALUE 0x19535 RL_GRID_UBYTE 0 CM_0p75_48_GradC -48 143.25 /end CHARACTERISTIC
/begin CHARACTERISTIC TMSKLH "podtverzhdena | engine temperature threshold for short initial phase LRA when engin hot" VALUE 0x19536 RL_GRID_UBYTE 0 CM_0p75_48_GradC -48 143.25 /end CHARACTERISTIC
/begin CHARACTERISTIC TMSNOGA "podtverzhdena | threshold tms for endless purge control, if mixture adaptation without error" VALUE 0x19537 RL_GRID_UBYTE 0 CM_0p75_48_GradC -48 143.25 /end CHARACTERISTIC
/begin CHARACTERISTIC SRL11OPUW "podtverzhdena | ta zhe os, chto u KFZWOP" CURVE 0x14B70 RL_GRID_UWORD 0 CM_0p0234375_0 -0 1535.98
 /begin AXIS_DESCR FIX_AXIS NO_INPUT_QUANTITY CM_IDENTITY 11 0 10 FIX_AXIS_PAR_DIST 0 1 11 /end AXIS_DESCR
/end CHARACTERISTIC
/begin CHARACTERISTIC ANZDYNSH "podtverzhdena | Amount of dynamic measurement for swinging check of sensor post cat" VALUE 0x18942 RL_GRID_UBYTE 0 CM_IDENTITY -0 255 /end CHARACTERISTIC
/begin CHARACTERISTIC CWDLSAHK "podtverzhdena | code word for test aging of O2-sensor post cat" VALUE 0x18943 RL_GRID_UBYTE 0 CM_IDENTITY -0 255 /end CHARACTERISTIC
/begin CHARACTERISTIC TABGSTG "podtverzhdena | threshold for exhaust temperature dynamic-measuring" VALUE 0x18944 RL_GRID_UBYTE 0 CM_5_50_GradC -50 1225 /end CHARACTERISTIC
/begin CHARACTERISTIC TFRMB "podtverzhdena | time delay for detect. the mean value of lamda control factor within thresholds" VALUE 0x18945 RL_GRID_UBYTE 0 CM_0p1_0_s -0 25.5 /end CHARACTERISTIC
/begin CHARACTERISTIC TLLASH "podtverzhdena | time delay for reset lamlash_w if lamsons_w is not lamlash_w" VALUE 0x18946 RL_GRID_UBYTE 0 CM_0p1_0_s -0 25.5 /end CHARACTERISTIC
/begin CHARACTERISTIC TSALASH "podtverzhdena | Time after fuel cut-off for the checking of the sensor downstream catalyst" VALUE 0x18947 RL_GRID_UBYTE 0 CM_0p1_0_s -0 25.5 /end CHARACTERISTIC
/begin CHARACTERISTIC TUSCHUB "podtverzhdena | Delay time for interference peaks at thrust detection of the rear oxygen sensor" VALUE 0x18948 RL_GRID_UBYTE 0 CM_0p1_0_s -0 25.5 /end CHARACTERISTIC
/begin CHARACTERISTIC TUSHSMIN "podtverzhdena | Minimum time for measuring the gradient for enable filter" VALUE 0x18949 RL_GRID_UBYTE 0 CM_0p1_0_s -0 25.5 /end CHARACTERISTIC
/begin CHARACTERISTIC TUSSA "podtverzhdena | delay time after crossing the control threshold downstream cat" VALUE 0x1894A RL_GRID_UBYTE 0 CM_0p1_0_s -0 25.5 /end CHARACTERISTIC
/begin CHARACTERISTIC USHLEAN "podtverzhdena | Threshold for lean volt. for reset dynamic measurement of sensor downstream cat." VALUE 0x1894B RL_GRID_UBYTE 0 CM_0p005215686275_0p2_V -0.2 1.13 /end CHARACTERISTIC
/begin CHARACTERISTIC USHRICH "podtverzhdena | Threshold for rich volt. for valid dyn. measurement of sensor downstream cat." VALUE 0x1894C RL_GRID_UBYTE 0 CM_0p005215686275_0p2_V -0.2 1.13 /end CHARACTERISTIC
/begin CHARACTERISTIC USHSTGMX "podtverzhdena | Value for maximum gradient for initial value of filter" VALUE 0x1894D RL_GRID_UBYTE 0 CM_0p52_0_mVms -0 132.6 /end CHARACTERISTIC
/begin CHARACTERISTIC USHSTSOLL "podtverzhdena | Threshold for permitted gradient of the sensor voltage downstream catalyst" VALUE 0x1894E RL_GRID_UBYTE 0 CM_0p52_0_mVms -0 132.6 /end CHARACTERISTIC
/begin CHARACTERISTIC USSCHUB "podtverzhdena | Threshold for sensor voltage downstream catalyst after fuel cut-off" VALUE 0x1894F RL_GRID_UBYTE 0 CM_0p005215686275_0p2_V -0.2 1.13 /end CHARACTERISTIC
/begin CHARACTERISTIC ADKATNF "podtverzhdena | scaling factor for signal amplitude of the sensor resp. of the catalyst stress" VALUE 0x18951 RL_GRID_UBYTE 0 CM_0p09362_0_1V -0 23.8731 /end CHARACTERISTIC
/begin CHARACTERISTIC AHKATMN "podtverzhdena | threshold value catalyst good, AHKAT < AHKATMN" VALUE 0x18952 RL_GRID_UBYTE 0 CM_0p00390625_0 -0 0.996094 /end CHARACTERISTIC
/begin CHARACTERISTIC AHKATS "podtverzhdena | threshold value for sum AHKAT,AHKAT2 (stereo)" VALUE 0x18953 RL_GRID_UBYTE 0 CM_0p0078125_0 -0 1.99219 /end CHARACTERISTIC
/begin CHARACTERISTIC AHKATSB "podtverzhdena | threshold value for error of adding range (stereo)" VALUE 0x18954 RL_GRID_UBYTE 0 CM_0p00390625_0 -0 0.996094 /end CHARACTERISTIC
/begin CHARACTERISTIC AHKTMXT "podtverzhdena | threshold value catalyst defect at tester's request" VALUE 0x18955 RL_GRID_UBYTE 0 CM_0p00390625_0 -0 0.996094 /end CHARACTERISTIC
/begin CHARACTERISTIC APEKTDX "podtverzhdena | max. number of tests with error result" VALUE 0x18956 RL_GRID_UBYTE 0 CM_IDENTITY -0 255 /end CHARACTERISTIC
/begin CHARACTERISTIC AVKATFS "podtverzhdena | setting value for AVKATF in case of powerfail" VALUE 0x18957 RL_GRID_UBYTE 0 CM_0p00390625_0 -0 0.996094 /end CHARACTERISTIC
/begin CHARACTERISTIC CDKATLK "podtverzhdena | code word for B_lrka active" VALUE 0x18958 RL_GRID_UBYTE 0 CM_IDENTITY -0 255 /end CHARACTERISTIC
/begin CHARACTERISTIC DKATCW "podtverzhdena | single run resp. initialization of the DKAT function" VALUE 0x18959 RL_GRID_UBYTE 0 CM_IDENTITY -0 255 /end CHARACTERISTIC
/begin CHARACTERISTIC DRLKTDP "podtverzhdena | Threshold for engine load change" VALUE 0x1895A RL_GRID_UBYTE 0 CM_0p75_0 -0 191.25 /end CHARACTERISTIC
/begin CHARACTERISTIC DRLKTDPT "podtverzhdena | Threshold for engine load change at tester's request" VALUE 0x1895B RL_GRID_UBYTE 0 CM_0p75_0 -0 191.25 /end CHARACTERISTIC
/begin CHARACTERISTIC FALRKTD "podtverzhdena | amplification factor for amplitude of lambda controller" VALUE 0x1895C RL_GRID_UBYTE 0 CM_0p03125_0 -0 7.96875 /end CHARACTERISTIC
/begin CHARACTERISTIC FALRKTT "podtverzhdena | amplification factor for amplitude of lambda controller at tester mode" VALUE 0x1895D RL_GRID_UBYTE 0 CM_0p03125_0 -0 7.96875 /end CHARACTERISTIC
/begin CHARACTERISTIC KATBFMNT "podtverzhdena | threshold value for small catalyst stress at tester's request" VALUE 0x1895E RL_GRID_UBYTE 0 CM_0p00390625_0 -0 0.996094 /end CHARACTERISTIC
/begin CHARACTERISTIC KATBFN "podtverzhdena | standardized mean value of the sensor amplitude" VALUE 0x1895F RL_GRID_UBYTE 0 CM_0p00390625_0 -0 0.996094 /end CHARACTERISTIC
/begin CHARACTERISTIC KATBFNM "podtverzhdena | scaling factor multiplicative for catalyst stress" VALUE 0x18960 RL_GRID_UBYTE 0 CM_0p005215686275_0_V -0 1.33 /end CHARACTERISTIC
/begin CHARACTERISTIC KATBFNP "podtverzhdena | scaling factor additive for catalyst stress" VALUE 0x18961 RL_GRID_UBYTE 0 CM_0p005215686275_0_V -0 1.33 /end CHARACTERISTIC
/begin CHARACTERISTIC KATBFSX "podtverzhdena | maximum integrator value for stop condition" VALUE 0x18962 RL_GRID_UBYTE 0 CM_0p0078125_0 -0 1.99219 /end CHARACTERISTIC
/begin CHARACTERISTIC KATBSG "podtverzhdena | catalyst storage value for catalyst stress" VALUE 0x18963 RL_GRID_UBYTE 0 CM_0p8695652174_0_mg -0 221.739 /end CHARACTERISTIC
/begin CHARACTERISTIC KATBSH "podtverzhdena | offset for lambda control slightly in the rich area" VALUE 0x18964 RL_GRID_UBYTE 0 CM_0p8695652174_0_mgs -0 221.739 /end CHARACTERISTIC
/begin CHARACTERISTIC KATBSHG "podtverzhdena | limitation factor of model lambda-offset due to sensor mean values" VALUE 0x18965 RL_GRID_UBYTE 0 CM_0p00390625_0 -0 0.996094 /end CHARACTERISTIC
/begin CHARACTERISTIC NDKTSOT "podtverzhdena | upper engine speed limit for function request" VALUE 0x18966 RL_GRID_UBYTE 0 CM_40_0_Upm -0 10200 /end CHARACTERISTIC
/begin CHARACTERISTIC NDKTSUT "podtverzhdena | lower engine speed limit for function request" VALUE 0x18967 RL_GRID_UBYTE 0 CM_40_0_Upm -0 10200 /end CHARACTERISTIC
/begin CHARACTERISTIC NKTDX "podtverzhdena | Maximum speed for DKAT calculation" VALUE 0x18968 RL_GRID_UBYTE 0 CM_40_0_Upm -0 10200 /end CHARACTERISTIC
/begin CHARACTERISTIC RLDKTOT "podtverzhdena | upper load limit for function request" VALUE 0x18969 RL_GRID_UBYTE 0 CM_0p75_0 -0 191.25 /end CHARACTERISTIC
/begin CHARACTERISTIC RLDKTUT "podtverzhdena | lower load limit for function request" VALUE 0x1896A RL_GRID_UBYTE 0 CM_0p75_0 -0 191.25 /end CHARACTERISTIC
/begin CHARACTERISTIC TMAXKAT "podtverzhdena | maximum catalyst temp. for active diagnosis" VALUE 0x1896B RL_GRID_UBYTE 0 CM_5_50_GradC -50 1225 /end CHARACTERISTIC
/begin CHARACTERISTIC TMINKAT "podtverzhdena | minimum catalyst temperature for monitoring" VALUE 0x1896C RL_GRID_UBYTE 0 CM_5_50_GradC -50 1225 /end CHARACTERISTIC
/begin CHARACTERISTIC TMNKATT "podtverzhdena | minimum catalyst temperature for monitoring during tester mode" VALUE 0x1896D RL_GRID_UBYTE 0 CM_5_50_GradC -50 1225 /end CHARACTERISTIC
/begin CHARACTERISTIC TMSUKTD "podtverzhdena | minimum engine start temp. for monitoring" VALUE 0x1896E RL_GRID_UBYTE 0 CM_0p75_48_GradC -48 143.25 /end CHARACTERISTIC
/begin CHARACTERISTIC TWDKATST "podtverzhdena | waiting time after stop condition for filter and integrator" VALUE 0x1896F RL_GRID_UBYTE 0 CM_0p05_0_s -0 12.75 /end CHARACTERISTIC
/begin CHARACTERISTIC TWKTDLP "podtverzhdena | delay time after parameter switch over in lambda control" VALUE 0x18970 RL_GRID_UBYTE 0 CM_0p05_0_s -0 12.75 /end CHARACTERISTIC
/begin CHARACTERISTIC ZDKATAD "podtverzhdena | filter time constant of the differentiator for signal amplitude" VALUE 0x18971 RL_GRID_UBYTE 0 CM_IDENTITY -0 255 /end CHARACTERISTIC
/begin CHARACTERISTIC ZDKATAF "podtverzhdena | time constant 'absolute value filter' for signal amplitude" VALUE 0x18972 RL_GRID_UBYTE 0 CM_IDENTITY -0 255 /end CHARACTERISTIC
/begin CHARACTERISTIC ZDKATSH "podtverzhdena | time constant low pass filter, mean sensor values" VALUE 0x18973 RL_GRID_UBYTE 0 CM_IDENTITY -0 255 /end CHARACTERISTIC
/begin CHARACTERISTIC ZDKTBD "podtverzhdena | time constant of the differentiator for RF-alternating component" VALUE 0x18974 RL_GRID_UBYTE 0 CM_IDENTITY -0 255 /end CHARACTERISTIC
/begin CHARACTERISTIC ZDKTBF "podtverzhdena | time constant for gas mixing procedure in front of catalyst" VALUE 0x18975 RL_GRID_UBYTE 0 CM_IDENTITY -0 255 /end CHARACTERISTIC
/begin CHARACTERISTIC ZKTDRL "podtverzhdena | time constant low pass filter, engine load" VALUE 0x18976 RL_GRID_UBYTE 0 CM_IDENTITY -0 255 /end CHARACTERISTIC
/begin CHARACTERISTIC TMTE "podtverzhdena | engine-temperature threshold for canister purge" VALUE 0x1976C RL_GRID_UBYTE 0 CM_0p75_48_GradC -48 143.25 /end CHARACTERISTIC
/begin CHARACTERISTIC FRHB "podtverzhdena | limit for lambda controller to reset Bit 'High HC-canister charge'" VALUE 0x197AB RL_GRID_UBYTE 0 CM_0p0078125_0 -0 1.99219 /end CHARACTERISTIC
/begin CHARACTERISTIC FTEADAB "podtverzhdena | Canister charge threshold for interruption of the purge phase" VALUE 0x197AC RL_GRID_UBYTE 0 CM_0p5_0 -0 127.5 /end CHARACTERISTIC
/begin CHARACTERISTIC FTEADMX "podtverzhdena | Maximum value of the canister charge (ftead)" VALUE 0x197AD RL_GRID_UBYTE 0 CM_0p5_0 -0 127.5 /end CHARACTERISTIC
/begin CHARACTERISTIC FTEFHB "podtverzhdena | Limit for flow rate of purge system to detect high concentration" VALUE 0x197AE RL_GRID_UBYTE 0 CM_0p001953125_0 -0 0.498047 /end CHARACTERISTIC
/begin CHARACTERISTIC FTEHB "podtverzhdena | Limit for purge factor to detect high concentration" VALUE 0x197AF RL_GRID_UBYTE 0 CM_0p5_0 -0 127.5 /end CHARACTERISTIC
/begin CHARACTERISTIC FUMRBRK "podtverzhdena | factor calculation of canister charge (ftead) from HC-concentration" VALUE 0x197BB RL_GRID_UBYTE 0 CM_0p125_0 -0 31.875 /end CHARACTERISTIC
/begin CHARACTERISTIC KHCTEMN "podtverzhdena | minimum value of HC concentration in purge flow" VALUE 0x198AB RL_GRID_UBYTE 0 CM_0p015625_0 -0 3.98438 /end CHARACTERISTIC
/begin CHARACTERISTIC KHCTEMX "podtverzhdena | maximum value of HC concentration in purge flow" VALUE 0x198AC RL_GRID_UBYTE 0 CM_0p015625_0 -0 3.98438 /end CHARACTERISTIC
/begin CHARACTERISTIC DNDTEO "podtverzhdena | upper Nsoll-Nist threshold for abortion diagnosis CPV" VALUE 0x19912 RL_GRID_UBYTE 0 CM_10_0_Umin -0 2550 /end CHARACTERISTIC
/begin CHARACTERISTIC DNDTEU "podtverzhdena | lower Nsoll-Nist threshold for abortion diagnosis CPV" VALUE 0x19913 RL_GRID_UBYTE 0 CM_10_0_Umin -0 2550 /end CHARACTERISTIC
/begin CHARACTERISTIC ETAZWTEN "podtverzhdena | minimum threschold of ignition angle efficiency for diagnosis of PCV" VALUE 0x19914 RL_GRID_UBYTE 0 CM_0p5_0 -0 127.5 /end CHARACTERISTIC
/begin CHARACTERISTIC FKADPMN "podtverzhdena | minimum feul part via CPV for passive O.K. testing." VALUE 0x19915 RL_GRID_UBYTE 0 CM_0p0078125_0 -0 1.99219 /end CHARACTERISTIC
/begin CHARACTERISTIC IMSDTEVA "podtverzhdena | thershold for integral of purge mass flow after a long purge stop" VALUE 0x19916 RL_GRID_UBYTE 0 CM_0p0444_0_g -0 11.322 /end CHARACTERISTIC
/begin CHARACTERISTIC TC6TECI "podtverzhdena | mode 6 code word for O.K. check of CPV form DLDP" VALUE 0x1996E RL_GRID_UBYTE 0 CM_IDENTITY -0 255 /end CHARACTERISTIC
/begin CHARACTERISTIC TC6TECL "podtverzhdena | mode 6 code word for O.K. check of CPV from air-test" VALUE 0x1996F RL_GRID_UBYTE 0 CM_IDENTITY -0 255 /end CHARACTERISTIC
/begin CHARACTERISTIC TC6TECNL "podtverzhdena | mode 6 code word for NOT O.K. check of CPV from air-test" VALUE 0x19970 RL_GRID_UBYTE 0 CM_IDENTITY -0 255 /end CHARACTERISTIC
/begin CHARACTERISTIC TC6TECP "podtverzhdena | mode 6 code word for passive O.K. check of CPV" VALUE 0x19971 RL_GRID_UBYTE 0 CM_IDENTITY -0 255 /end CHARACTERISTIC
/begin CHARACTERISTIC TC6TECRF "podtverzhdena | mode 6 code word for O.K. check of CPV from FR-deviation dircetion rich" VALUE 0x19972 RL_GRID_UBYTE 0 CM_IDENTITY -0 255 /end CHARACTERISTIC
/begin CHARACTERISTIC TC6TECRM "podtverzhdena | mode 6 code word for O.K. check of CPV from FR-deviation dircetion lean" VALUE 0x19973 RL_GRID_UBYTE 0 CM_IDENTITY -0 255 /end CHARACTERISTIC
/begin CHARACTERISTIC TC6TECT "podtverzhdena | mode 6 code word for O.K. check of CPV form DLDP" VALUE 0x19974 RL_GRID_UBYTE 0 CM_IDENTITY -0 255 /end CHARACTERISTIC
/begin CHARACTERISTIC TTEVAZ "podtverzhdena | duration of stay for CPV opening with not successful frm" VALUE 0x19978 RL_GRID_UBYTE 0 CM_0p1_0_s -0 25.5 /end CHARACTERISTIC
/begin CHARACTERISTIC TVDTEB "podtverzhdena | delay time for statement TEV o.k./defect in diagnosis DTEV" VALUE 0x1997A RL_GRID_UBYTE 0 CM_0p1_0_s -0 25.5 /end CHARACTERISTIC
/begin CHARACTERISTIC TVDTEE "podtverzhdena | Duration as of PCV open for checking of DTEV" VALUE 0x1997B RL_GRID_UBYTE 0 CM_0p1_0_s -0 25.5 /end CHARACTERISTIC
/begin CHARACTERISTIC TVDTEVP "podtverzhdena | delay time for setting of the flip flop 'Passive Diagnosis CPV o.k.'" VALUE 0x1997D RL_GRID_UBYTE 0 CM_0p1_0_s -0 25.5 /end CHARACTERISTIC
/begin CHARACTERISTIC TVDTEVZ "podtverzhdena | delay time for closing CPV for active DTEV" VALUE 0x1997F RL_GRID_UBYTE 0 CM_0p1_0_s -0 25.5 /end CHARACTERISTIC
/begin CHARACTERISTIC LIMTKOA "podtverzhdena | Time threshold to switch off the AC-compressor indefinitly" VALUE 0x119D8 RL_GRID_UBYTE 0 CM_0p2_0_s -0 51 /end CHARACTERISTIC
/begin CHARACTERISTIC TKOAMNN "podtverzhdena | minimum shutdown time for air-conditioning compressor" CURVE 0x119E2 RL_GRID_UBYTE 0 CM_0p2_0_s -0 51
 /begin AXIS_DESCR COM_AXIS NO_INPUT_QUANTITY CM_40_0_rpm 8 0 10200 AXIS_PTS_REF SNM08_KO /end AXIS_DESCR
/end CHARACTERISTIC
/begin CHARACTERISTIC TKOAMXN "podtverzhdena | maximum shutdown time for air-conditioning compressor" CURVE 0x119EA RL_GRID_UBYTE 0 CM_0p2_0_s -0 51
 /begin AXIS_DESCR COM_AXIS NO_INPUT_QUANTITY CM_40_0_rpm 8 0 10200 AXIS_PTS_REF SNM08_KO /end AXIS_DESCR
/end CHARACTERISTIC
/begin CHARACTERISTIC TKOEMNN "podtverzhdena | minimal time of air-condition compressor beeing swiched on" CURVE 0x119F2 RL_GRID_UBYTE 0 CM_0p2_0_s -0 51
 /begin AXIS_DESCR COM_AXIS NO_INPUT_QUANTITY CM_40_0_rpm 8 0 10200 AXIS_PTS_REF SNM08_KO /end AXIS_DESCR
/end CHARACTERISTIC
/begin CHARACTERISTIC TMKOAO "podtverzhdena | Upper coolant temperature for swichting off the AC-compressor" VALUE 0x119FA RL_GRID_UBYTE 0 CM_0p75_48_GradC -48 143.25 /end CHARACTERISTIC
/begin CHARACTERISTIC TMKOAU "podtverzhdena | Lower coolant temperature for swichting off the AC-compressor" VALUE 0x119FB RL_GRID_UBYTE 0 CM_0p75_48_GradC -48 143.25 /end CHARACTERISTIC
/begin CHARACTERISTIC TNACMX "podtverzhdena | maximal time for engine speed nac after S_ko = 0" VALUE 0x119FC RL_GRID_UBYTE 0 CM_0p2_0_s -0 51 /end CHARACTERISTIC
/begin CHARACTERISTIC TVKOA "podtverzhdena | delay time for compressor OFF" VALUE 0x119FD RL_GRID_UBYTE 0 CM_0p02_0_s -0 5.1 /end CHARACTERISTIC
/begin CHARACTERISTIC TVKOE "podtverzhdena | delay time for compressor ON" VALUE 0x119FE RL_GRID_UBYTE 0 CM_0p02_0_s -0 5.1 /end CHARACTERISTIC
/begin CHARACTERISTIC VKOAO "podtverzhdena | Upper vehicle speed threshold to inhibit the AC-compressor" VALUE 0x119FF RL_GRID_UBYTE 0 CM_1p25_0_kmh -0 318.75 /end CHARACTERISTIC
/begin CHARACTERISTIC VKOAU "podtverzhdena | low vehicle speed threshold to inhibit the AC-compressor" VALUE 0x11A00 RL_GRID_UBYTE 0 CM_1p25_0_kmh -0 318.75 /end CHARACTERISTIC
/begin CHARACTERISTIC WDKKOAN_0 "podtverzhdena | wdk threshold for A/C compressor cut off, variant 0" CURVE 0x11A01 RL_GRID_UBYTE 0 CM_0p390625_0 -0 99.6094
 /begin AXIS_DESCR COM_AXIS NO_INPUT_QUANTITY CM_40_0_rpm 8 0 10200 AXIS_PTS_REF SNM08_KO /end AXIS_DESCR
/end CHARACTERISTIC
/begin CHARACTERISTIC WDKKOAN_1 "podtverzhdena | wdk threshold for A/C compressor cut off, variant 1" CURVE 0x11A09 RL_GRID_UBYTE 0 CM_0p390625_0 -0 99.6094
 /begin AXIS_DESCR COM_AXIS NO_INPUT_QUANTITY CM_40_0_rpm 8 0 10200 AXIS_PTS_REF SNM08_KO /end AXIS_DESCR
/end CHARACTERISTIC
/begin CHARACTERISTIC WDKKOEN "podtverzhdena | wdk threshold for air-condition compressor authorisation" CURVE 0x11A11 RL_GRID_UBYTE 0 CM_0p390625_0 -0 99.6094
 /begin AXIS_DESCR COM_AXIS NO_INPUT_QUANTITY CM_40_0_rpm 8 0 10200 AXIS_PTS_REF SNM08_KO /end AXIS_DESCR
/end CHARACTERISTIC
/begin CHARACTERISTIC CURVE_11A2E "adres podtverzhden | curve over coolant temperature, result to 0x9910" CURVE 0x11A35 RL_GRID_UBYTE 0 CM_IDENTITY -0 255
 /begin AXIS_DESCR COM_AXIS NO_INPUT_QUANTITY CM_0p75_48_GradC 6 0 143.25 AXIS_PTS_REF AX_11A2F_Y /end AXIS_DESCR
/end CHARACTERISTIC
/begin CHARACTERISTIC NMIN_MISF "podtverzhdena | nizhnyaya granica oborotov diagnostiki propuskov vosplameneniya" VALUE 0x121C9 RL_GRID_UBYTE 0 CM_40_0_rpm -0 10200 /end CHARACTERISTIC
/begin CHARACTERISTIC NMAX_MISF "podtverzhdena | verhnyaya granica oborotov diagnostiki propuskov vosplameneniya" VALUE 0x121CA RL_GRID_UBYTE 0 CM_40_0_rpm -0 10200 /end CHARACTERISTIC
/begin CHARACTERISTIC TMOT_FAN_HYS "podtverzhdena | gisterezis temperatury OZH dlya ventilyatora" VALUE 0x199FF RL_GRID_UBYTE 0 CM_0p75_0_K -0 191.25 /end CHARACTERISTIC
/begin CHARACTERISTIC TAN_FAN "podtverzhdena | porog temperatury vozduha na vpuske dlya vklyucheniya ventilyatora" VALUE 0x19A01 RL_GRID_UBYTE 0 CM_0p75_48_GradC -48 143.25 /end CHARACTERISTIC
/begin CHARACTERISTIC TMOT_FAN1 "podtverzhdena | porog temperatury OZH dlya vklyucheniya ventilyatora, rezhim 1" VALUE 0x19A02 RL_GRID_UBYTE 0 CM_0p75_48_GradC -48 143.25 /end CHARACTERISTIC
/begin CHARACTERISTIC TMOT_FAN2 "podtverzhdena | porog temperatury OZH dlya vklyucheniya ventilyatora, rezhim 2" VALUE 0x19A03 RL_GRID_UBYTE 0 CM_0p75_48_GradC -48 143.25 /end CHARACTERISTIC
/begin CHARACTERISTIC TMOT_FAN3 "podtverzhdena | porog temperatury OZH dlya vklyucheniya ventilyatora, rezhim 3" VALUE 0x19A04 RL_GRID_UBYTE 0 CM_0p75_48_GradC -48 143.25 /end CHARACTERISTIC
/begin CHARACTERISTIC TMOT_FAN4 "podtverzhdena | porog temperatury OZH dlya vklyucheniya ventilyatora, rezhim 4" VALUE 0x19A05 RL_GRID_UBYTE 0 CM_0p75_48_GradC -48 143.25 /end CHARACTERISTIC
/begin CHARACTERISTIC TMOT_FAN5 "podtverzhdena | porog temperatury OZH dlya vklyucheniya ventilyatora, rezhim 5" VALUE 0x19A06 RL_GRID_UBYTE 0 CM_0p75_48_GradC -48 143.25 /end CHARACTERISTIC
/begin CHARACTERISTIC LS_CONFIG "podtverzhdena | konfiguraciya lyambda-zondov, bitovoe pole: bit 1 -- zond posle neytralizatora, bank 1" VALUE 0x10022 RL_GRID_UBYTE 0 CM_IDENTITY -0 255 /end CHARACTERISTIC
/begin GROUP G_Katalizator_i_zadniy_zond "Katalizator i zadniy zond"
 /begin REF_CHARACTERISTIC ADKATNF AHKATMN AHKATS AHKATSB AHKTMXT ANZDYNSH APEKTDX ATMABKA ATMABKK ATMTANS AVKATFS BTRKHTMS CDKATLK CWDLSAHK DKATCW DRLKTDP DRLKTDPT FALRKTD FALRKTT FATMRML FKHLA FKHMD FNSKHLL FTMLAKH KATBFMNT KATBFN KATBFNM KATBFNP KATBFSX KATBSG KATBSH KATBSHG KATMEXML KDLASHKI KFATMLA KFATMZW KFFTV KFLMSKH KFNLLKHM KFTATM KFUSHK KLATMLAE KLATMZWE LMSTMOT MLSUS NDKTSOT NDKTSUT NFSKHM NKTDX PLRHAV PLRHML RLDKTOT RLDKTUT RLLRHON RLLRHUN TABGSTG TFRMB TLLASH TMAXKAT TMINKAT TMNKATT TMSUKTD TSALASH TUSCHUB TUSHSMIN TUSSA TWDKATST TWKTDLP USHLEAN USHRICH USHSTGMX USHSTSOLL USSCHUB ZDKATAD ZDKATAF ZDKATSH ZDKTBD ZDKTBF ZKTDRL ZLRHML /end REF_CHARACTERISTIC
/end GROUP
/begin GROUP G_Adsorber "Adsorber"
 /begin REF_CHARACTERISTIC DMSTES DNDTEO DNDTEU ETAZWTEN FKADPMN FQTEPT FQTEVA FRHB FTEADAB FTEADMX FTEFHB FTEHB FUMRBRK FVERZDYN GRID_528_197BC_10x10 IMSDTEVA KFDETATE KFETATE KFFTEAX KFQTE KFTADMS KFTATX KFTEKA KFTEVP KFTVTEV KHCTEMN KHCTEMX KLAFTE TATELL TATEMSN TC6TECI TC6TECL TC6TECNL TC6TECP TC6TECRF TC6TECRM TC6TECT TMSKLH TMSNOGA TMTE TTEVAZ TVDTEB TVDTEE TVDTEVP TVDTEVZ ZBTEML ZMRFABN /end REF_CHARACTERISTIC
/end GROUP
/begin GROUP G_Kondicioner "Kondicioner"
 /begin REF_CHARACTERISTIC KFTKONS LIMTKOA TKOAMNN TKOAMXN TKOEMNN TMKOAO TMKOAU TNACMX TVKOA TVKOE VKOAO VKOAU WDKKOAN_0 WDKKOAN_1 WDKKOEN /end REF_CHARACTERISTIC
/end GROUP
/begin GROUP G_Ohlazhdenie__ventilyator "Ohlazhdenie, ventilyator"
 /begin REF_CHARACTERISTIC DTLRTML KFDTMTE KFDTMTR KFIDTHM KLDTMRS TAN_FAN TMLRTMS TMOT_FAN1 TMOT_FAN2 TMOT_FAN3 TMOT_FAN4 TMOT_FAN5 TMOT_FAN_HYS TWLRTMS /end REF_CHARACTERISTIC
/end GROUP
/begin GROUP G_Propuski_vosplameneniya "Propuski vosplameneniya"
 /begin REF_CHARACTERISTIC AINTKAN ANALUN DLURMIN FSWALUV KFDLUR2 KFDLURZ KFKSWF KFLUAR2 KFLUARZ KFLURB1 KFLURB2 KFLURBZ KFLURM1 LURBRL8 LURKH LURKTM LURMIN1 LURMIN2 LURMIN3 NMAX_MISF NMIN_MISF /end REF_CHARACTERISTIC
/end GROUP
/begin GROUP G_Datchiki_i_prochie_vhody "Datchiki i prochie vhody" /begin REF_CHARACTERISTIC FUGKUE /end REF_CHARACTERISTIC /end GROUP
/begin GROUP G_Diagnostika_i_OBD "Diagnostika i OBD"
 /begin REF_CHARACTERISTIC CDCAAA CDCAGRF CDCAGRL CDCAGRV CDCAHC CDCBM CDCDK CDCDUMMY CDCEGFE CDCEV1 CDCEV2 CDCEV3 CDCEV4 CDCEV5 CDCEV6 CDCFRAO CDCFRAU CDCFRST CDCGE CDCHSH CDCHSHE CDCHSV CDCHSVE CDCKAT CDCKOSE CDCKPE CDCKRNT CDCKROF CDCKRTP CDCKS1 CDCKS2 CDCKS3 CDCKS4 CDCLASH CDCLATP CDCLATV CDCLLR CDCLM CDCLSH CDCLSV CDCLUEA CDCMD01 CDCMD02 CDCMD03 CDCMFA CDCMFB CDCPH CDCPUA CDCRKAT CDCRKAZ CDCSGROM CDCSWE CDCTA CDCTES CDCTEVE CDCTHM CDCTM CDCUB CDCVFZ CDCZOE CDCZSE CDCZZZ CL30LINE CL31LINE CL32LINE CL33LINE CL34LINE CL35LINE CL36LINE CL37LINE CL38LINE CL39LINE CLAFRAO CLAFRAU CLAHSH CLAHSV CLAKAT CLALASH CLALATP CLALATV CLALSH CLARKAT DFPSLBIT DIAG_FLAGS DTC_CODES FFTEV6 FFTFRAO FFTFRAU FFTFRST FFTGE FFTHSH FFTHSHE FFTHSV FFTHSVE FFTKAT FFTKOSE FFTKPE /end REF_CHARACTERISTIC
/end GROUP
/begin GROUP G_Konfiguraciya__kodovye_slova "Konfiguraciya, kodovye slova" /begin REF_CHARACTERISTIC LS_CONFIG /end REF_CHARACTERISTIC /end GROUP
/begin GROUP G_Recirkulyaciya_OG__na_motore_n "Recirkulyaciya OG (na motore net)" /begin REF_CHARACTERISTIC AGREDRLS FAGRH KFFTAGRV KFFTDAG KFMDDAGR PAGAVML /end REF_CHARACTERISTIC /end GROUP
/begin GROUP G_Osi "Osi"
 /begin REF_CHARACTERISTIC SAN12ESUW SBF02MFSB SDK10TEUB SDN06LLSB SEZ06TMUB SFR05TEUB SGA06MFUB SGA08MDUB SKS06ESUB SLX06TMUW SML05DKUB SML05LKUB SML06TEUB SML06TMUB SML07TMUW SML08LHUB SNG06LLSB SNM05DKUB SNM06LHUB SNM06LLUB SNM06MFUB SNM07ESUB SNM07LRUB SNM08DMUB SNM08GKUB SNM08LHUB SNM08__UB SNM10FEUB SNM10TEUB SNM12ESUB SNM12FEUB SNM16CIUB SNM16GKUB SNM16KRUB SNM16OPUB SNM16ZUUB SNM24ZUUB SNS06LLSB SQM05TEUB SRL03MFUW SRL04DYUB SRL04KRUB SRL06LHUB SRL06LRUB SRL08DMUB SRL11OPUW SRL12ESUB SRL12GKUB SRL12ZUUB SRL16ZUUB ST107TMUB ST307TMUB STA06ESUB STM04__UB STM05SAUB STM05TMUB STM06LLUB STM06__UB STM08DMUB STM08LEUB STM09ESUB STM12ESUB STS12ESUB STW06MDUB /end REF_CHARACTERISTIC
/end GROUP
/begin GROUP G_Naydeno_skanerom "Naydeno skanerom"
 /begin REF_CHARACTERISTIC GRID_326_1637C_16x7 MAP_056_10D9A_6 MAP_115_112C2_14 MAP_120_11567_8 MAP_123_11595_8 MAP_124_115EC_7 MAP_125_115FB_7 MAP_127_11616_8 MAP_128_11673_6 MAP_132_116E5_4 MAP_134_11986_5x6 MAP_137_11A1A_6 MAP_139_11A40_10x10 MAP_152_11AD4_16x12 MAP_171_124D4_6 MAP_172_128BD_21 MAP_175_14915_6 MAP_181_14998_10 MAP_182_149B8_10 MAP_183_149D8_10 MAP_189_14BC5_12 MAP_208_14F60_8 MAP_209_14F7F_6 MAP_211_14FF7_5 MAP_212_15005_6 MAP_247_15BCB_7 MAP_248_15C2D_7 MAP_261_15F88_12 MAP_303_1611B_4 MAP_309_16156_5 MAP_394_1854A_5 MAP_395_1856E_8 MAP_399_18613_10x8 MAP_407_18768_6 MAP_409_1879A_6 MAP_422_188CA_5 MAP_446_18BBA_4 MAP_452_18C2A_8 MAP_453_18C7C_8 MAP_454_18CCE_4 MAP_456_18CE9_8 MAP_458_18D3B_8 MAP_476_18E8E_4 MAP_482_18F3D_4 MAP_484_18F61_4 MAP_485_18F71_4 MAP_486_18FA2_4 MAP_487_18FB2_4 MAP_512_193E0_9 MAP_521_196F8_5 MAP_523_19719_8 MAP_525_1976E_6 MAP_526_1977E_5 MAP_527_1979E_6 MAP_533_198B4_5 MAP_537_19950_14 MAP_541_19A2F_20 MAP_543_19A6B_20 MAP_544_19AAC_4 MAP_561_1A692_12 MAP_565_1A84A_6 MAP_566_1A88A_6 MAP_568_1A945_4 MAP_569_1A965_4 MAP_572_1AA3A_4 MAP_573_1AB22_4 MAP_574_1AC8F_6 MAP_575_1ADDB_5 MAP_576_1AEC3_6 MAP_577_1AF14_6 MAP_578_1B0C2_5 MAP_585_1B497_8 MAP_587_1B5E1_6 MAP_588_1B612_5 MAP_602_1B8C0_5 MAP_603_1B91F_5 MAP_608_1B9EC_4 MAP_614_1BC7A_8 MAP_623_1BD71_5 /end REF_CHARACTERISTIC
/end GROUP
/begin GROUP G_Prochee "Prochee" /begin REF_CHARACTERISTIC CURVE_11A2E /end REF_CHARACTERISTIC /end GROUP
/end MODULE
/end PROJECT
