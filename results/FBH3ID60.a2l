ASAP2_VERSION 1 61
/begin PROJECT FBH3ID60 "Kia Spectra 1.6 Bosch M7.9.7 FBH3ID60"
/begin HEADER "Kia Spectra 1.6 Bosch M7.9.7 FBH3ID60" VERSION "1.0" /end HEADER
/begin MODULE FBH3ID60_MOD "Bosch M7.9.7 / Infineon C167"
/begin MOD_COMMON "little-endian, выравнивание 1" BYTE_ORDER MSB_LAST ALIGNMENT_BYTE 1 ALIGNMENT_WORD 1 ALIGNMENT_LONG 1 /end MOD_COMMON
/begin COMPU_METHOD CM_IDENTITY "без пересчёта (сырые значения)" RAT_FUNC "%.3f" "" COEFFS 0 1 0 0 0 1 /end COMPU_METHOD
/begin COMPU_METHOD CM_40_0_Upm "nmot_ub_q40" RAT_FUNC "%.1f" "Upm" COEFFS 0 1 0 0 0 40 /end COMPU_METHOD
/begin COMPU_METHOD CM_0p5_0 "масштаб 0.5" RAT_FUNC "%.3f" "%" COEFFS 0 1 0 0 0 0.5 /end COMPU_METHOD
/begin COMPU_METHOD CM_0p390625_0 "rel_ub_b99p6" RAT_FUNC "%.3f" "%" COEFFS 0 1 0 0 0 0.390625 /end COMPU_METHOD
/begin COMPU_METHOD CM_0p75_0_gradKW "масштаб 0.75" RAT_FUNC "%.3f" "grad KW" COEFFS 0 1 0 0 0 0.75 /end COMPU_METHOD
/begin COMPU_METHOD CM_0p75_0 "rel_ub_q0p75" RAT_FUNC "%.3f" "%" COEFFS 0 1 0 0 0 0.75 /end COMPU_METHOD
/begin COMPU_METHOD CM_0p0078125_0 "fak_ub_b2" RAT_FUNC "%.3f" "-" COEFFS 0 1 0 0 0 0.0078125 /end COMPU_METHOD
/begin COMPU_METHOD CM_0p00390625_0 "fak_ub_b1" RAT_FUNC "%.3f" "-" COEFFS 0 1 0 0 0 0.00390625 /end COMPU_METHOD
/begin COMPU_METHOD CM_0p0625_0 "fak_ub_b16" RAT_FUNC "%.3f" "-" COEFFS 0 1 0 0 0 0.0625 /end COMPU_METHOD
/begin COMPU_METHOD CM_n0p75_0_gradKW "zw_ub_qn0p75" RAT_FUNC "%.3f" "grad KW" COEFFS 0 1 0 0 0 -0.75 /end COMPU_METHOD
/begin COMPU_METHOD CM_0p3921568627_0_DK "relDK_ub_b100" RAT_FUNC "%.3f" "% DK" COEFFS 0 1 0 0 0 0.3921568627 /end COMPU_METHOD
/begin COMPU_METHOD CM_0p25_0 "fak_ub_b64" RAT_FUNC "%.3f" "-" COEFFS 0 1 0 0 0 0.25 /end COMPU_METHOD
/begin COMPU_METHOD CM_0p01_0_s "t10msxs_ub_b2p55_@_UW" RAT_FUNC "%.3f" "s" COEFFS 0 1 0 0 0 0.01 /end COMPU_METHOD
/begin COMPU_METHOD CM_0p001953125_0 "rel_uw_b127p5" RAT_FUNC "%.3f" "%" COEFFS 0 1 0 0 0 0.001953125 /end COMPU_METHOD
/begin COMPU_METHOD CM_0p1960784314_0 "rel_ub_b50" RAT_FUNC "%.3f" "%" COEFFS 0 1 0 0 0 0.1960784314 /end COMPU_METHOD
/begin COMPU_METHOD CM_0p003051757812_0 "rel_sw_b100" RAT_FUNC "%.3f" "%" COEFFS 0 1 0 0 0 0.003051757812 /end COMPU_METHOD
/begin COMPU_METHOD CM_0p000244140625_0 "fak_uw_b16" RAT_FUNC "%.3f" "-" COEFFS 0 1 0 0 0 0.000244140625 /end COMPU_METHOD
/begin COMPU_METHOD CM_0p1_0_s "t100msxs_uw_b6553p5" RAT_FUNC "%.3f" "s" COEFFS 0 1 0 0 0 0.1 /end COMPU_METHOD
/begin COMPU_METHOD CM_0p0234375_0 "rel_uw_q0p0234" RAT_FUNC "%.3f" "%" COEFFS 0 1 0 0 0 0.0234375 /end COMPU_METHOD
/begin COMPU_METHOD CM_0p015625_0 "fak_ub_b4" RAT_FUNC "%.3f" "-" COEFFS 0 1 0 0 0 0.015625 /end COMPU_METHOD
/begin COMPU_METHOD CM_1p525878906En05_0 "fak_uw_b1" RAT_FUNC "%.3f" "-" COEFFS 0 1 0 0 0 1.525878906e-05 /end COMPU_METHOD
/begin COMPU_METHOD CM_3p051757812En05_0 "fak_uw_b2" RAT_FUNC "%.3f" "-" COEFFS 0 1 0 0 0 3.051757812e-05 /end COMPU_METHOD
/begin COMPU_METHOD CM_0p01220703125_0_Upm "fak_ub_b3p125" RAT_FUNC "%.3f" "%/Upm" COEFFS 0 1 0 0 0 0.01220703125 /end COMPU_METHOD
/begin COMPU_METHOD CM_10_0_Umin "nmot_ub_q10" RAT_FUNC "%.1f" "U/min" COEFFS 0 1 0 0 0 10 /end COMPU_METHOD
/begin COMPU_METHOD CM_0p09764705882_0 "rel_ub_b24p9" RAT_FUNC "%.3f" "%" COEFFS 0 1 0 0 0 0.09764705882 /end COMPU_METHOD
/begin COMPU_METHOD CM_0p75_48_GradC "temp_ub_q0p75_o48" RAT_FUNC "%.3f" "Grad C" COEFFS 0 1 48 0 0 0.75 /end COMPU_METHOD
/begin COMPU_METHOD CM_5_0_GradC "temp_q5" RAT_FUNC "%.1f" "Grad C" COEFFS 0 1 0 0 0 5 /end COMPU_METHOD
/begin COMPU_METHOD CM_5_50_GradC "temp_ub_q5_o50" RAT_FUNC "%.1f" "Grad C" COEFFS 0 1 50 0 0 5 /end COMPU_METHOD
/begin COMPU_METHOD CM_8_0_Ohm "r_q8" RAT_FUNC "%.1f" "Ohm" COEFFS 0 1 0 0 0 8 /end COMPU_METHOD
/begin COMPU_METHOD CM_0p3058103976_0_s "fak_ub_b77p81" RAT_FUNC "%.3f" "%/s" COEFFS 0 1 0 0 0 0.3058103976 /end COMPU_METHOD
/begin COMPU_METHOD CM_0p048828125_0 "fak_ub_b12p45" RAT_FUNC "%.3f" "%" COEFFS 0 1 0 0 0 0.048828125 /end COMPU_METHOD
/begin COMPU_METHOD CM_0p005215686275_0p2_V "spg_ub_q0p0052_o0p2" RAT_FUNC "%.3f" "V" COEFFS 0 1 0.2 0 0 0.005215686275 /end COMPU_METHOD
/begin COMPU_METHOD CM_0p0390625_0_mss "tgrad_ub_q0p039" RAT_FUNC "%.3f" "ms/s" COEFFS 0 1 0 0 0 0.0390625 /end COMPU_METHOD
/begin COMPU_METHOD CM_0p02275555556_0_kg "m_ub_b5p8" RAT_FUNC "%.3f" "kg" COEFFS 0 1 0 0 0 0.02275555556 /end COMPU_METHOD
/begin COMPU_METHOD CM_0p75_0_GradKW "zw_ub_q0p75" RAT_FUNC "%.3f" "Grad KW" COEFFS 0 1 0 0 0 0.75 /end COMPU_METHOD
/begin COMPU_METHOD CM_1_n1 "dezsub1" RAT_FUNC "%.1f" "-" COEFFS 0 1 -1 0 0 1 /end COMPU_METHOD
/begin COMPU_METHOD CM_1p25_0_V "spg_ub_b320" RAT_FUNC "%.1f" "V" COEFFS 0 1 0 0 0 1.25 /end COMPU_METHOD
/begin COMPU_METHOD CM_6_0_GradKW "zw_ub_q6" RAT_FUNC "%.1f" "Grad KW" COEFFS 0 1 0 0 0 6 /end COMPU_METHOD
/begin COMPU_METHOD CM_0p00048828125_0 "fak_ub_b0p125" RAT_FUNC "%.3f" "-" COEFFS 0 1 0 0 0 0.00048828125 /end COMPU_METHOD
/begin COMPU_METHOD CM_4p768359375En05_0_1s "perio_ub_b0p012207" RAT_FUNC "%.3f" "1/s" COEFFS 0 1 0 0 0 4.768359375e-05 /end COMPU_METHOD
/begin COMPU_METHOD CM_0p02392578125_0_1s "perio_ub_b6p125" RAT_FUNC "%.3f" "1/s" COEFFS 0 1 0 0 0 0.02392578125 /end COMPU_METHOD
/begin COMPU_METHOD CM_0p5_0_ms "t500usxms_ub_q0p5" RAT_FUNC "%.3f" "ms" COEFFS 0 1 0 0 0 0.5 /end COMPU_METHOD
/begin COMPU_METHOD CM_20_0_s "t100msxs_ub_q20" RAT_FUNC "%.1f" "s" COEFFS 0 1 0 0 0 20 /end COMPU_METHOD
/begin COMPU_METHOD CM_0p09103840683_0_kg "m_ub_b23p3" RAT_FUNC "%.3f" "kg" COEFFS 0 1 0 0 0 0.09103840683 /end COMPU_METHOD
/begin COMPU_METHOD CM_0p07421875_0 "fak_uw_b4864" RAT_FUNC "%.3f" "-" COEFFS 0 1 0 0 0 0.07421875 /end COMPU_METHOD
/begin COMPU_METHOD CM_0p0390625_0_hPa "p_uw_q0p039" RAT_FUNC "%.3f" "hPa" COEFFS 0 1 0 0 0 0.0390625 /end COMPU_METHOD
/begin COMPU_METHOD CM_4p577636719En06_0_hPa "rel_uw_b0p3" RAT_FUNC "%.3f" "%/hPa" COEFFS 0 1 0 0 0 4.577636719e-06 /end COMPU_METHOD
/begin COMPU_METHOD CM_0p75_0_GradC "temp_sw_q0p75" RAT_FUNC "%.3f" "Grad C" COEFFS 0 1 0 0 0 0.75 /end COMPU_METHOD
/begin COMPU_METHOD CM_6p103515625En05_0 "fak_uw_b4" RAT_FUNC "%.3f" "-" COEFFS 0 1 0 0 0 6.103515625e-05 /end COMPU_METHOD
/begin COMPU_METHOD CM_0p05664148928_0_kJ "q_uw_q0p0566" RAT_FUNC "%.3f" "kJ" COEFFS 0 1 0 0 0 0.05664148928 /end COMPU_METHOD
/begin COMPU_METHOD CM_3p9062En05_0p05_s "t10msxs_q0p000039_o0p05" RAT_FUNC "%.3f" "s" COEFFS 0 1 0.05 0 0 3.9062e-05 /end COMPU_METHOD
/begin COMPU_METHOD CM_0p0195313_0_V "spg_uw_b1280" RAT_FUNC "%.3f" "V" COEFFS 0 1 0 0 0 0.0195313 /end COMPU_METHOD
/begin COMPU_METHOD CM_0p1875_0 "rel_sw_q0p1875" RAT_FUNC "%.3f" "%" COEFFS 0 1 0 0 0 0.1875 /end COMPU_METHOD
/begin COMPU_METHOD CM_7p629394531En05_0_1s "zk200msxs_uw_b5" RAT_FUNC "%.3f" "1/s" COEFFS 0 1 0 0 0 7.629394531e-05 /end COMPU_METHOD
/begin COMPU_METHOD CM_0p0146484375_0_s "zk200msxs_uw_b960" RAT_FUNC "%.3f" "%/s" COEFFS 0 1 0 0 0 0.0146484375 /end COMPU_METHOD
/begin COMPU_METHOD CM_0p125_0 "fak_sb_b16" RAT_FUNC "%.3f" "-" COEFFS 0 1 0 0 0 0.125 /end COMPU_METHOD
/begin COMPU_METHOD CM_0p000732421875_0_GradC "temp_sb_b0p093" RAT_FUNC "%.3f" "Grad C" COEFFS 0 1 0 0 0 0.000732421875 /end COMPU_METHOD
/begin RECORD_LAYOUT RL_GRID_DU8 FNC_VALUES 1 UBYTE ROW_DIR DIRECT /end RECORD_LAYOUT
/begin RECORD_LAYOUT RL_3D_A8_DU8 NO_AXIS_PTS_X 1 UBYTE NO_AXIS_PTS_Y 2 UBYTE AXIS_PTS_X 3 UBYTE INDEX_INCR DIRECT AXIS_PTS_Y 4 UBYTE INDEX_INCR DIRECT FNC_VALUES 5 UBYTE ROW_DIR DIRECT /end RECORD_LAYOUT
/begin RECORD_LAYOUT RL_GRID_DS8 FNC_VALUES 1 SBYTE ROW_DIR DIRECT /end RECORD_LAYOUT
/begin RECORD_LAYOUT RL_2D_A16_DU16 NO_AXIS_PTS_X 1 UBYTE AXIS_PTS_X 2 UWORD INDEX_INCR DIRECT FNC_VALUES 3 UWORD ROW_DIR DIRECT /end RECORD_LAYOUT
/begin RECORD_LAYOUT RL_2D_A8_DU8 NO_AXIS_PTS_X 1 UBYTE AXIS_PTS_X 2 UBYTE INDEX_INCR DIRECT FNC_VALUES 3 UBYTE ROW_DIR DIRECT /end RECORD_LAYOUT
/begin RECORD_LAYOUT RL_2D_A8_DU16 NO_AXIS_PTS_X 1 UBYTE AXIS_PTS_X 2 UBYTE INDEX_INCR DIRECT FNC_VALUES 3 UWORD ROW_DIR DIRECT /end RECORD_LAYOUT
/begin RECORD_LAYOUT RL_GRID_DU16 FNC_VALUES 1 UWORD ROW_DIR DIRECT /end RECORD_LAYOUT
/begin RECORD_LAYOUT RL_GRID_DS16 FNC_VALUES 1 SWORD ROW_DIR DIRECT /end RECORD_LAYOUT
/begin RECORD_LAYOUT RL_2D_A16_DU8 NO_AXIS_PTS_X 1 UBYTE AXIS_PTS_X 2 UWORD INDEX_INCR DIRECT FNC_VALUES 3 UBYTE ROW_DIR DIRECT /end RECORD_LAYOUT
/begin CHARACTERISTIC SNM16GKUB "подтверждена | damos | адрес 0x181F7, данные 0x181F7 | Datapoint distribution mixture control 16 nmot datapoints" CURVE 0x181F7 RL_GRID_DU8 0 CM_IDENTITY 0 255
 /begin AXIS_DESCR FIX_AXIS NO_INPUT_QUANTITY CM_IDENTITY 16 0 15 FIX_AXIS_PAR_DIST 0 1 16 /end AXIS_DESCR
/end CHARACTERISTIC
/begin CHARACTERISTIC SNM16KRUB "подтверждена | damos | адрес 0x18208, данные 0x18208 | datapoint distribution engine speed, 16 datapoints" CURVE 0x18208 RL_GRID_DU8 0 CM_IDENTITY 0 255
 /begin AXIS_DESCR FIX_AXIS NO_INPUT_QUANTITY CM_IDENTITY 16 0 15 FIX_AXIS_PAR_DIST 0 1 16 /end AXIS_DESCR
/end CHARACTERISTIC
/begin CHARACTERISTIC SRL04KRUB "подтверждена | damos | адрес 0x18219, данные 0x18219 | datapoint distribution relative charge, 4 datapoints" CURVE 0x18219 RL_GRID_DU8 0 CM_IDENTITY 0 255
 /begin AXIS_DESCR FIX_AXIS NO_INPUT_QUANTITY CM_IDENTITY 4 0 3 FIX_AXIS_PAR_DIST 0 1 4 /end AXIS_DESCR
/end CHARACTERISTIC
/begin CHARACTERISTIC SRL12GKUB "подтверждена | damos | адрес 0x1821E, данные 0x1821E" CURVE 0x1821E RL_GRID_DU8 0 CM_IDENTITY 0 255
 /begin AXIS_DESCR FIX_AXIS NO_INPUT_QUANTITY CM_IDENTITY 12 0 11 FIX_AXIS_PAR_DIST 0 1 12 /end AXIS_DESCR
/end CHARACTERISTIC
/begin CHARACTERISTIC ST107TMUB "подтверждена | damos | адрес 0x1822B, данные 0x1822B | tabgmst dependet basic point (number 7)" CURVE 0x1822B RL_GRID_DU8 0 CM_IDENTITY 0 255
 /begin AXIS_DESCR FIX_AXIS NO_INPUT_QUANTITY CM_IDENTITY 7 0 6 FIX_AXIS_PAR_DIST 0 1 7 /end AXIS_DESCR
/end CHARACTERISTIC
/begin CHARACTERISTIC ST307TMUB "подтверждена | damos | адрес 0x18233, данные 0x18233 | tkatmst dependet basic point (number 7)" CURVE 0x18233 RL_GRID_DU8 0 CM_IDENTITY 0 255
 /begin AXIS_DESCR FIX_AXIS NO_INPUT_QUANTITY CM_IDENTITY 7 0 6 FIX_AXIS_PAR_DIST 0 1 7 /end AXIS_DESCR
/end CHARACTERISTIC
/begin CHARACTERISTIC STA06ESUB "подтверждена | damos | адрес 0x1823B, данные 0x1823B | Distribution for the air temperature in the intake manifold" CURVE 0x1823B RL_GRID_DU8 0 CM_IDENTITY 0 255
 /begin AXIS_DESCR FIX_AXIS NO_INPUT_QUANTITY CM_IDENTITY 6 0 5 FIX_AXIS_PAR_DIST 0 1 6 /end AXIS_DESCR
/end CHARACTERISTIC
/begin CHARACTERISTIC STM04__UB "подтверждена | damos | адрес 0x18242, данные 0x18242" CURVE 0x18242 RL_GRID_DU8 0 CM_IDENTITY 0 255
 /begin AXIS_DESCR FIX_AXIS NO_INPUT_QUANTITY CM_IDENTITY 4 0 3 FIX_AXIS_PAR_DIST 0 1 4 /end AXIS_DESCR
/end CHARACTERISTIC
/begin CHARACTERISTIC STM05SAUB "подтверждена | damos | адрес 0x18247, данные 0x18247 | base point distribution" CURVE 0x18247 RL_GRID_DU8 0 CM_IDENTITY 0 255
 /begin AXIS_DESCR FIX_AXIS NO_INPUT_QUANTITY CM_IDENTITY 5 0 4 FIX_AXIS_PAR_DIST 0 1 5 /end AXIS_DESCR
/end CHARACTERISTIC
/begin CHARACTERISTIC STM05TMUB "подтверждена | damos | адрес 0x1824D, данные 0x1824D | tmst dependet basic point (number 5)" CURVE 0x1824D RL_GRID_DU8 0 CM_IDENTITY 0 255
 /begin AXIS_DESCR FIX_AXIS NO_INPUT_QUANTITY CM_IDENTITY 5 0 4 FIX_AXIS_PAR_DIST 0 1 5 /end AXIS_DESCR
/end CHARACTERISTIC
/begin CHARACTERISTIC STM06LLUB "подтверждена | damos | адрес 0x18253, данные 0x18253 | Datapoint distribution, engine temperature, 6 datapoints" CURVE 0x18253 RL_GRID_DU8 0 CM_IDENTITY 0 255
 /begin AXIS_DESCR FIX_AXIS NO_INPUT_QUANTITY CM_IDENTITY 6 0 5 FIX_AXIS_PAR_DIST 0 1 6 /end AXIS_DESCR
/end CHARACTERISTIC
/begin CHARACTERISTIC STM06__UB "подтверждена | damos | адрес 0x1825A, данные 0x1825A | Datapoint distribution, engine temperature, 6 datapoints" CURVE 0x1825A RL_GRID_DU8 0 CM_IDENTITY 0 255
 /begin AXIS_DESCR FIX_AXIS NO_INPUT_QUANTITY CM_IDENTITY 6 0 5 FIX_AXIS_PAR_DIST 0 1 6 /end AXIS_DESCR
/end CHARACTERISTIC
/begin CHARACTERISTIC STM08DMUB "подтверждена | damos | адрес 0x18261, данные 0x18261" CURVE 0x18261 RL_GRID_DU8 0 CM_IDENTITY 0 255
 /begin AXIS_DESCR FIX_AXIS NO_INPUT_QUANTITY CM_IDENTITY 8 0 7 FIX_AXIS_PAR_DIST 0 1 8 /end AXIS_DESCR
/end CHARACTERISTIC
/begin CHARACTERISTIC STM08LEUB "подтверждена | damos | адрес 0x1826A, данные 0x1826A" CURVE 0x1826A RL_GRID_DU8 0 CM_IDENTITY 0 255
 /begin AXIS_DESCR FIX_AXIS NO_INPUT_QUANTITY CM_IDENTITY 8 0 7 FIX_AXIS_PAR_DIST 0 1 8 /end AXIS_DESCR
/end CHARACTERISTIC
/begin CHARACTERISTIC STM09ESUB "подтверждена | damos | адрес 0x18273, данные 0x18273 | Base point distribution of engine temperature, 9 base pts." CURVE 0x18273 RL_GRID_DU8 0 CM_IDENTITY 0 255
 /begin AXIS_DESCR FIX_AXIS NO_INPUT_QUANTITY CM_IDENTITY 9 0 8 FIX_AXIS_PAR_DIST 0 1 9 /end AXIS_DESCR
/end CHARACTERISTIC
/begin CHARACTERISTIC STS12ESUB "подтверждена | damos | адрес 0x1827D, данные 0x1827D | Distribution for engine coolant temperature at start" CURVE 0x1827D RL_GRID_DU8 0 CM_IDENTITY 0 255
 /begin AXIS_DESCR FIX_AXIS NO_INPUT_QUANTITY CM_IDENTITY 12 0 11 FIX_AXIS_PAR_DIST 0 1 12 /end AXIS_DESCR
/end CHARACTERISTIC
/begin CHARACTERISTIC STW06MDUB "подтверждена | damos | адрес 0x1828A, данные 0x1828A" CURVE 0x1828A RL_GRID_DU8 0 CM_IDENTITY 0 255
 /begin AXIS_DESCR FIX_AXIS NO_INPUT_QUANTITY CM_IDENTITY 6 0 5 FIX_AXIS_PAR_DIST 0 1 6 /end AXIS_DESCR
/end CHARACTERISTIC
/begin CHARACTERISTIC FLRAG "вероятная | damos-вероятно | адрес 0x18291, данные 0x18291 | масштаб x0.0625 - | amplification of load controller at AT" CURVE 0x18291 RL_GRID_DU8 0 CM_0p0625_0 0 255
 /begin AXIS_DESCR FIX_AXIS NO_INPUT_QUANTITY CM_IDENTITY 6 0 5 FIX_AXIS_PAR_DIST 0 1 6 /end AXIS_DESCR
/end CHARACTERISTIC
/begin CHARACTERISTIC FLRAWG "вероятная | damos-вероятно | адрес 0x18297, данные 0x18297 | масштаб x0.0625 - | amplification of load controller" CURVE 0x18297 RL_GRID_DU8 0 CM_0p0625_0 0 255
 /begin AXIS_DESCR FIX_AXIS NO_INPUT_QUANTITY CM_IDENTITY 6 0 5 FIX_AXIS_PAR_DIST 0 1 6 /end AXIS_DESCR
/end CHARACTERISTIC
/begin CHARACTERISTIC FLRHG "вероятная | damos-вероятно | адрес 0x1829D, данные 0x1829D | масштаб x0.0625 - | amplification of load controller" CURVE 0x1829D RL_GRID_DU8 0 CM_0p0625_0 0 255
 /begin AXIS_DESCR FIX_AXIS NO_INPUT_QUANTITY CM_IDENTITY 6 0 5 FIX_AXIS_PAR_DIST 0 1 6 /end AXIS_DESCR
/end CHARACTERISTIC
/begin CHARACTERISTIC FRARAG "вероятная | damos-вероятно | адрес 0x182A3, данные 0x182A3 | масштаб x0.012207 %/Upm | amplification factor at AT" CURVE 0x182A3 RL_GRID_DU8 0 CM_0p01220703125_0_Upm 0 255
 /begin AXIS_DESCR FIX_AXIS NO_INPUT_QUANTITY CM_IDENTITY 6 0 5 FIX_AXIS_PAR_DIST 0 1 6 /end AXIS_DESCR
/end CHARACTERISTIC
/begin CHARACTERISTIC FRARAWG "вероятная | damos-вероятно | адрес 0x182A9, данные 0x182A9 | масштаб x0.012207 %/Upm | amplification factor" CURVE 0x182A9 RL_GRID_DU8 0 CM_0p01220703125_0_Upm 0 255
 /begin AXIS_DESCR FIX_AXIS NO_INPUT_QUANTITY CM_IDENTITY 6 0 5 FIX_AXIS_PAR_DIST 0 1 6 /end AXIS_DESCR
/end CHARACTERISTIC
/begin CHARACTERISTIC FRARHG "вероятная | damos-вероятно | адрес 0x182AF, данные 0x182AF | масштаб x0.012207 %/Upm | amplification factor" CURVE 0x182AF RL_GRID_DU8 0 CM_0p01220703125_0_Upm 0 255
 /begin AXIS_DESCR FIX_AXIS NO_INPUT_QUANTITY CM_IDENTITY 6 0 5 FIX_AXIS_PAR_DIST 0 1 6 /end AXIS_DESCR
/end CHARACTERISTIC
/begin CHARACTERISTIC RLVMXN "подтверждена | damos | адрес 0x182B7, данные 0x182B7 | масштаб x0.75 % | maximum volumetric flow with open throttle valve" CURVE 0x182B7 RL_GRID_DU8 0 CM_0p75_0 0 255
 /begin AXIS_DESCR FIX_AXIS NO_INPUT_QUANTITY CM_IDENTITY 11 0 10 FIX_AXIS_PAR_DIST 0 1 11 /end AXIS_DESCR
/end CHARACTERISTIC
/begin CHARACTERISTIC RLVSMXN "подтверждена | damos | адрес 0x182CE, данные 0x182CE | масштаб x0.75 % | maximum volumetric flow with open throttle valve and SU" CURVE 0x182CE RL_GRID_DU8 0 CM_0p75_0 0 255
 /begin AXIS_DESCR FIX_AXIS NO_INPUT_QUANTITY CM_IDENTITY 11 0 10 FIX_AXIS_PAR_DIST 0 1 11 /end AXIS_DESCR
/end CHARACTERISTIC
/begin CHARACTERISTIC DFAUWKN "вероятная | damos-вероятно | адрес 0x182E6, данные 0x182E6 | масштаб x0.00390625 - | Damping ratio for filtering torque on a low clutch torque and op. lockup clutch" CURVE 0x182E6 RL_GRID_DU8 0 CM_0p00390625_0 0 255
 /begin AXIS_DESCR FIX_AXIS NO_INPUT_QUANTITY CM_IDENTITY 6 0 5 FIX_AXIS_PAR_DIST 0 1 6 /end AXIS_DESCR
/end CHARACTERISTIC
/begin CHARACTERISTIC DFAWKN "вероятная | damos-вероятно | адрес 0x182EC, данные 0x182EC | масштаб x0.00390625 - | Damping ratio for filtering torque on an openned lockup clutch" CURVE 0x182EC RL_GRID_DU8 0 CM_0p00390625_0 0 255
 /begin AXIS_DESCR FIX_AXIS NO_INPUT_QUANTITY CM_IDENTITY 6 0 5 FIX_AXIS_PAR_DIST 0 1 6 /end AXIS_DESCR
/end CHARACTERISTIC
/begin CHARACTERISTIC KFDMDFA "подтверждена | damos-точно | адрес 0x182F5, данные 0x182F5 | масштаб x0.00390625 - | Map Damping ratio for filtering motors torque" MAP 0x182F5 RL_GRID_DU8 0 CM_0p00390625_0 0 255
 /begin AXIS_DESCR FIX_AXIS NO_INPUT_QUANTITY CM_IDENTITY 6 0 5 FIX_AXIS_PAR_DIST 0 1 6 /end AXIS_DESCR
 /begin AXIS_DESCR FIX_AXIS NO_INPUT_QUANTITY CM_IDENTITY 6 0 5 FIX_AXIS_PAR_DIST 0 1 6 /end AXIS_DESCR
/end CHARACTERISTIC
/begin CHARACTERISTIC KFDMDFAS "подтверждена | damos-точно | адрес 0x18319, данные 0x18319 | масштаб x0.00390625 - | Map Damping ratio for filtering motor torque on fuel feed restart" MAP 0x18319 RL_GRID_DU8 0 CM_0p00390625_0 0 255
 /begin AXIS_DESCR FIX_AXIS NO_INPUT_QUANTITY CM_IDENTITY 6 0 5 FIX_AXIS_PAR_DIST 0 1 6 /end AXIS_DESCR
 /begin AXIS_DESCR FIX_AXIS NO_INPUT_QUANTITY CM_IDENTITY 6 0 5 FIX_AXIS_PAR_DIST 0 1 6 /end AXIS_DESCR
/end CHARACTERISTIC
/begin CHARACTERISTIC KFDMDFAU "подтверждена | damos-точно | адрес 0x1833D, данные 0x1833D | масштаб x0.00390625 - | Map damping ratio for filtering motor torque on low clutch torque" MAP 0x1833D RL_GRID_DU8 0 CM_0p00390625_0 0 255
 /begin AXIS_DESCR FIX_AXIS NO_INPUT_QUANTITY CM_IDENTITY 6 0 5 FIX_AXIS_PAR_DIST 0 1 6 /end AXIS_DESCR
 /begin AXIS_DESCR FIX_AXIS NO_INPUT_QUANTITY CM_IDENTITY 6 0 5 FIX_AXIS_PAR_DIST 0 1 6 /end AXIS_DESCR
/end CHARACTERISTIC
/begin CHARACTERISTIC KFZMDFA "подтверждена | damos-точно | адрес 0x18361, данные 0x18361 | Map time constant values for filtering motor torque" MAP 0x18361 RL_GRID_DU8 0 CM_IDENTITY 0 255
 /begin AXIS_DESCR FIX_AXIS NO_INPUT_QUANTITY CM_IDENTITY 6 0 5 FIX_AXIS_PAR_DIST 0 1 6 /end AXIS_DESCR
 /begin AXIS_DESCR FIX_AXIS NO_INPUT_QUANTITY CM_IDENTITY 6 0 5 FIX_AXIS_PAR_DIST 0 1 6 /end AXIS_DESCR
/end CHARACTERISTIC
/begin CHARACTERISTIC KFZMDFAS "подтверждена | damos-точно | адрес 0x18385, данные 0x18385 | Map time constant values for filtering motor torque on fuel feed restart" MAP 0x18385 RL_GRID_DU8 0 CM_IDENTITY 0 255
 /begin AXIS_DESCR FIX_AXIS NO_INPUT_QUANTITY CM_IDENTITY 6 0 5 FIX_AXIS_PAR_DIST 0 1 6 /end AXIS_DESCR
 /begin AXIS_DESCR FIX_AXIS NO_INPUT_QUANTITY CM_IDENTITY 6 0 5 FIX_AXIS_PAR_DIST 0 1 6 /end AXIS_DESCR
/end CHARACTERISTIC
/begin CHARACTERISTIC KFZMDFAU "подтверждена | damos-точно | адрес 0x183A9, данные 0x183A9 | Map time constant values for filtering motor torque on low clutch torque" MAP 0x183A9 RL_GRID_DU8 0 CM_IDENTITY 0 255
 /begin AXIS_DESCR FIX_AXIS NO_INPUT_QUANTITY CM_IDENTITY 6 0 5 FIX_AXIS_PAR_DIST 0 1 6 /end AXIS_DESCR
 /begin AXIS_DESCR FIX_AXIS NO_INPUT_QUANTITY CM_IDENTITY 6 0 5 FIX_AXIS_PAR_DIST 0 1 6 /end AXIS_DESCR
/end CHARACTERISTIC
/begin CHARACTERISTIC ZFAUWKN "вероятная | damos-вероятно | адрес 0x183D0, данные 0x183D0 | lower time constant value for filt. torque on openned lockup clutch" CURVE 0x183D0 RL_GRID_DU8 0 CM_IDENTITY 0 255
 /begin AXIS_DESCR FIX_AXIS NO_INPUT_QUANTITY CM_IDENTITY 6 0 5 FIX_AXIS_PAR_DIST 0 1 6 /end AXIS_DESCR
/end CHARACTERISTIC
/begin CHARACTERISTIC ZFAWKN "вероятная | damos-вероятно | адрес 0x183D6, данные 0x183D6 | time constant for filtering motor torque on openned lockup clutch" CURVE 0x183D6 RL_GRID_DU8 0 CM_IDENTITY 0 255
 /begin AXIS_DESCR FIX_AXIS NO_INPUT_QUANTITY CM_IDENTITY 6 0 5 FIX_AXIS_PAR_DIST 0 1 6 /end AXIS_DESCR
/end CHARACTERISTIC
/begin CHARACTERISTIC REDZEM "подтверждена | damos | адрес 0x183DF, данные 0x183DF | threshold between ignition intervention and injector disabling" CURVE 0x183DF RL_GRID_DU8 0 CM_IDENTITY 0 255
 /begin AXIS_DESCR FIX_AXIS NO_INPUT_QUANTITY CM_IDENTITY 5 0 4 FIX_AXIS_PAR_DIST 0 1 5 /end AXIS_DESCR
/end CHARACTERISTIC
/begin CHARACTERISTIC WPHN "вероятная | damos-вероятно | адрес 0x183EB, данные 0x183EB | масштаб x0.75 grad KW | phase correction" CURVE 0x183EB RL_GRID_DS8 0 CM_0p75_0_gradKW 0 127
 /begin AXIS_DESCR FIX_AXIS NO_INPUT_QUANTITY CM_IDENTITY 8 0 7 FIX_AXIS_PAR_DIST 0 1 8 /end AXIS_DESCR
/end CHARACTERISTIC
/begin CHARACTERISTIC DZWSPM "вероятная | damos-вероятно | адрес 0x183F3, данные 0x183F3 | масштаб x0.75 grad KW | delta latest ignition angle relative to engine temperature" CURVE 0x183F3 RL_GRID_DS8 0 CM_0p75_0_gradKW 0 127
 /begin AXIS_DESCR FIX_AXIS NO_INPUT_QUANTITY CM_IDENTITY 6 0 5 FIX_AXIS_PAR_DIST 0 1 6 /end AXIS_DESCR
/end CHARACTERISTIC
/begin CHARACTERISTIC KFTVSA "сомнительная | damos-сомнительно | адрес 0x18449, данные 0x18449 | масштаб x0.01 s | Retard time for overrun fuel cut-off" MAP 0x18449 RL_GRID_DU8 0 CM_0p01_0_s 0 255
 /begin AXIS_DESCR FIX_AXIS NO_INPUT_QUANTITY CM_IDENTITY 8 0 7 FIX_AXIS_PAR_DIST 0 1 8 /end AXIS_DESCR
 /begin AXIS_DESCR FIX_AXIS NO_INPUT_QUANTITY CM_IDENTITY 5 0 4 FIX_AXIS_PAR_DIST 0 1 5 /end AXIS_DESCR
/end CHARACTERISTIC
/begin CHARACTERISTIC NWECVTM "вероятная | damos-вероятно | адрес 0x18471, данные 0x18471 | масштаб x40 Upm | Fuel restart-speed at CVT" CURVE 0x18471 RL_GRID_DU8 0 CM_40_0_Upm 0 255
 /begin AXIS_DESCR FIX_AXIS NO_INPUT_QUANTITY CM_IDENTITY 5 0 4 FIX_AXIS_PAR_DIST 0 1 5 /end AXIS_DESCR
/end CHARACTERISTIC
/begin CHARACTERISTIC TVSATM "вероятная | damos-вероятно | адрес 0x18476, данные 0x18476 | delay time after cranking for fuel cut off" CURVE 0x18476 RL_GRID_DU8 0 CM_IDENTITY 0 255
 /begin AXIS_DESCR FIX_AXIS NO_INPUT_QUANTITY CM_IDENTITY 5 0 4 FIX_AXIS_PAR_DIST 0 1 5 /end AXIS_DESCR
/end CHARACTERISTIC
/begin CHARACTERISTIC DNEVTMOD "подтверждена | damos | адрес 0x1847D, данные 0x1847D | масштаб x10 U/min | char.line delta desired engine speed dependent on evtmod" CURVE 0x1847D RL_GRID_DU8 0 CM_10_0_Umin 0 255
 /begin AXIS_DESCR FIX_AXIS NO_INPUT_QUANTITY CM_IDENTITY 8 0 7 FIX_AXIS_PAR_DIST 0 1 8 /end AXIS_DESCR
/end CHARACTERISTIC
/begin CHARACTERISTIC DNLBZ "подтверждена | damos | адрес 0x1848E, данные 0x1848E | масштаб x10 U/min | Idle speed increase for battery charging balance" CURVE 0x1848E RL_GRID_DU8 0 CM_10_0_Umin 0 255
 /begin AXIS_DESCR FIX_AXIS NO_INPUT_QUANTITY CM_IDENTITY 6 0 5 FIX_AXIS_PAR_DIST 0 1 6 /end AXIS_DESCR
/end CHARACTERISTIC
/begin CHARACTERISTIC FNSSTM "подтверждена | damos | адрес 0x1849B, данные 0x1849B | масштаб x0.0078125 - | Faktor for taget engine speed during start" CURVE 0x1849B RL_GRID_DU8 0 CM_0p0078125_0 0 255
 /begin AXIS_DESCR FIX_AXIS NO_INPUT_QUANTITY CM_IDENTITY 6 0 5 FIX_AXIS_PAR_DIST 0 1 6 /end AXIS_DESCR
/end CHARACTERISTIC
/begin CHARACTERISTIC NFSM "вероятная | damos-вероятно | адрес 0x184AA, данные 0x184AA | масштаб x10 U/min | desired engine speed DRIVE-position switch on" CURVE 0x184AA RL_GRID_DU8 0 CM_10_0_Umin 0 255
 /begin AXIS_DESCR FIX_AXIS NO_INPUT_QUANTITY CM_IDENTITY 6 0 5 FIX_AXIS_PAR_DIST 0 1 6 /end AXIS_DESCR
/end CHARACTERISTIC
/begin CHARACTERISTIC NLLM "вероятная | damos-вероятно | адрес 0x184B0, данные 0x184B0 | масштаб x10 U/min | desired engine speed" CURVE 0x184B0 RL_GRID_DU8 0 CM_10_0_Umin 0 255
 /begin AXIS_DESCR FIX_AXIS NO_INPUT_QUANTITY CM_IDENTITY 6 0 5 FIX_AXIS_PAR_DIST 0 1 6 /end AXIS_DESCR
/end CHARACTERISTIC
/begin CHARACTERISTIC NSLPP "подтверждена | damos | адрес 0x184B7, данные 0x184B7 | масштаб x10 U/min | Target speed depending on the pump pressure of power steerung" CURVE 0x184B7 RL_GRID_DU8 0 CM_10_0_Umin 0 255
 /begin AXIS_DESCR FIX_AXIS NO_INPUT_QUANTITY CM_IDENTITY 4 0 3 FIX_AXIS_PAR_DIST 0 1 4 /end AXIS_DESCR
/end CHARACTERISTIC
/begin CHARACTERISTIC NSLPPFS "подтверждена | damos | адрес 0x184C0, данные 0x184C0 | масштаб x10 U/min | Target speed depending on the pump pressure of power steering with B_fs=1" CURVE 0x184C0 RL_GRID_DU8 0 CM_10_0_Umin 0 255
 /begin AXIS_DESCR FIX_AXIS NO_INPUT_QUANTITY CM_IDENTITY 4 0 3 FIX_AXIS_PAR_DIST 0 1 4 /end AXIS_DESCR
/end CHARACTERISTIC
/begin CHARACTERISTIC NTANS "подтверждена | damos | адрес 0x184C9, данные 0x184C9 | масштаб x10 U/min | idle speed rpm tans-dependent" CURVE 0x184C9 RL_GRID_DU8 0 CM_10_0_Umin 0 255
 /begin AXIS_DESCR FIX_AXIS NO_INPUT_QUANTITY CM_IDENTITY 8 0 7 FIX_AXIS_PAR_DIST 0 1 8 /end AXIS_DESCR
/end CHARACTERISTIC
/begin CHARACTERISTIC LIMXDNS "вероятная | damos-вероятно | адрес 0x184D9, данные 0x184D9 | масштаб x0.0976471 % | upper integrator limit for standing car" CURVE 0x184D9 RL_GRID_DU8 0 CM_0p09764705882_0 0 255
 /begin AXIS_DESCR FIX_AXIS NO_INPUT_QUANTITY CM_IDENTITY 6 0 5 FIX_AXIS_PAR_DIST 0 1 6 /end AXIS_DESCR
/end CHARACTERISTIC
/begin CHARACTERISTIC LIMXVDNS "вероятная | damos-вероятно | адрес 0x184DF, данные 0x184DF | масштаб x0.0976471 % | upper integrator limit for rolling car" CURVE 0x184DF RL_GRID_DU8 0 CM_0p09764705882_0 0 255
 /begin AXIS_DESCR FIX_AXIS NO_INPUT_QUANTITY CM_IDENTITY 6 0 5 FIX_AXIS_PAR_DIST 0 1 6 /end AXIS_DESCR
/end CHARACTERISTIC
/begin CHARACTERISTIC LISTM "вероятная | damos-вероятно | адрес 0x184E5, данные 0x184E5 | масштаб x0.0976471 % | value of idle speed control integrator during start" CURVE 0x184E5 RL_GRID_DU8 0 CM_0p09764705882_0 0 255
 /begin AXIS_DESCR FIX_AXIS NO_INPUT_QUANTITY CM_IDENTITY 6 0 5 FIX_AXIS_PAR_DIST 0 1 6 /end AXIS_DESCR
/end CHARACTERISTIC
/begin CHARACTERISTIC DMDKOE "подтверждена | damos | адрес 0x184FC, данные 0x184FC | масштаб x0.196078 % | Start value of torque filter when AC is swiched on" CURVE 0x184FC RL_GRID_DU8 0 CM_0p1960784314_0 0 255
 /begin AXIS_DESCR FIX_AXIS NO_INPUT_QUANTITY CM_IDENTITY 6 0 5 FIX_AXIS_PAR_DIST 0 1 6 /end AXIS_DESCR
/end CHARACTERISTIC
/begin CHARACTERISTIC KFMDKO "подтверждена | damos-точно | адрес 0x18516, данные 0x18516 | масштаб x0.196078 % | map for torque needed for air condition" MAP 0x18516 RL_GRID_DU8 0 CM_0p1960784314_0 0 255
 /begin AXIS_DESCR FIX_AXIS NO_INPUT_QUANTITY CM_IDENTITY 6 0 5 FIX_AXIS_PAR_DIST 0 1 6 /end AXIS_DESCR
 /begin AXIS_DESCR FIX_AXIS NO_INPUT_QUANTITY CM_IDENTITY 6 0 5 FIX_AXIS_PAR_DIST 0 1 6 /end AXIS_DESCR
/end CHARACTERISTIC
/begin CHARACTERISTIC MAP_394_1854A_5 "вероятная | mapscan | адрес 0x1854A, данные 0x18550" CURVE 0x1854A RL_2D_A8_DU8 0 CM_IDENTITY 0 255 /begin AXIS_DESCR STD_AXIS NO_INPUT_QUANTITY CM_IDENTITY 5 0 255 /end AXIS_DESCR /end CHARACTERISTIC
/begin CHARACTERISTIC MAP_395_1856E_8 "вероятная | mapscan | адрес 0x1856E, данные 0x18577" CURVE 0x1856E RL_2D_A8_DU8 0 CM_IDENTITY 0 255 /begin AXIS_DESCR STD_AXIS NO_INPUT_QUANTITY CM_IDENTITY 8 0 255 /end AXIS_DESCR /end CHARACTERISTIC
/begin CHARACTERISTIC EVTMODO "подтверждена | damos | адрес 0x185CD, данные 0x185CD | масштаб x0.75 Grad C | offset for evtmod depending on filtered engine temperature" CURVE 0x185CD RL_GRID_DS8 0 CM_0p75_48_GradC 0 127
 /begin AXIS_DESCR FIX_AXIS NO_INPUT_QUANTITY CM_IDENTITY 12 0 11 FIX_AXIS_PAR_DIST 0 1 12 /end AXIS_DESCR
/end CHARACTERISTIC
/begin CHARACTERISTIC FDVANS "подтверждена | damos | адрес 0x185E6, данные 0x185E6 | масштаб x0.0078125 - | Temperature factor for air at throttle valve" CURVE 0x185E6 RL_GRID_DU8 0 CM_0p0078125_0 0 255
 /begin AXIS_DESCR FIX_AXIS NO_INPUT_QUANTITY CM_IDENTITY 8 0 7 FIX_AXIS_PAR_DIST 0 1 8 /end AXIS_DESCR
/end CHARACTERISTIC
/begin CHARACTERISTIC FWFTBRTA "подтверждена | damos | адрес 0x185F7, данные 0x185F7 | масштаб x0.0078125 - | Weighting for ftbr as a function of tans" CURVE 0x185F7 RL_GRID_DU8 0 CM_0p0078125_0 0 255
 /begin AXIS_DESCR FIX_AXIS NO_INPUT_QUANTITY CM_IDENTITY 14 0 13 FIX_AXIS_PAR_DIST 0 1 14 /end AXIS_DESCR
/end CHARACTERISTIC
/begin CHARACTERISTIC MAP_399_18613_10x8 "вероятная | mapscan | адрес 0x18613, данные 0x18627" MAP 0x18613 RL_3D_A8_DU8 0 CM_IDENTITY 0 255 /begin AXIS_DESCR STD_AXIS NO_INPUT_QUANTITY CM_IDENTITY 10 0 255 /end AXIS_DESCR /begin AXIS_DESCR STD_AXIS NO_INPUT_QUANTITY CM_IDENTITY 8 0 255 /end AXIS_DESCR /end CHARACTERISTIC
/begin CHARACTERISTIC FZPUSA "подтверждена | damos | адрес 0x1867D, данные 0x1867D | масштаб x0.0078125 - | correction faktor time constant ambient pressure adaptation during fuel cut-off" CURVE 0x1867D RL_GRID_DU8 0 CM_0p0078125_0 0 255
 /begin AXIS_DESCR FIX_AXIS NO_INPUT_QUANTITY CM_IDENTITY 8 0 7 FIX_AXIS_PAR_DIST 0 1 8 /end AXIS_DESCR
/end CHARACTERISTIC
/begin CHARACTERISTIC WDKHKDN "подтверждена | damos | адрес 0x18695, данные 0x18695 | масштаб x0.390625 % | High threshold throttle plate for altitude adaptation" CURVE 0x18695 RL_GRID_DU8 0 CM_0p390625_0 0 255
 /begin AXIS_DESCR FIX_AXIS NO_INPUT_QUANTITY CM_IDENTITY 6 0 5 FIX_AXIS_PAR_DIST 0 1 6 /end AXIS_DESCR
/end CHARACTERISTIC
/begin CHARACTERISTIC WDKHKN "вероятная | damos-вероятно | адрес 0x186A2, данные 0x186A2 | масштаб x0.390625 % | Low threshold throttle plate for altitude adaptation" CURVE 0x186A2 RL_GRID_DU8 0 CM_0p390625_0 0 255
 /begin AXIS_DESCR FIX_AXIS NO_INPUT_QUANTITY CM_IDENTITY 6 0 5 FIX_AXIS_PAR_DIST 0 1 6 /end AXIS_DESCR
/end CHARACTERISTIC
/begin CHARACTERISTIC WPUAVLN "подтверждена | damos | адрес 0x186AF, данные 0x186AF | масштаб x0.392157 % DK | Throttle valve angle as of which VL ambient pressure adaptation is active" CURVE 0x186AF RL_GRID_DU8 0 CM_0p3921568627_0_DK 0 255
 /begin AXIS_DESCR FIX_AXIS NO_INPUT_QUANTITY CM_IDENTITY 12 0 11 FIX_AXIS_PAR_DIST 0 1 12 /end AXIS_DESCR
/end CHARACTERISTIC
/begin CHARACTERISTIC WPUAVLSN "подтверждена | damos | адрес 0x186C8, данные 0x186C8 | масштаб x0.392157 % DK | Throttle valve angle as of which VL ambient pressure adaptation is blocked" CURVE 0x186C8 RL_GRID_DU8 0 CM_0p3921568627_0_DK 0 255
 /begin AXIS_DESCR FIX_AXIS NO_INPUT_QUANTITY CM_IDENTITY 12 0 11 FIX_AXIS_PAR_DIST 0 1 12 /end AXIS_DESCR
/end CHARACTERISTIC
/begin CHARACTERISTIC KFFTAGRV "подтверждена | damos | адрес 0x186F6, данные 0x186F6 | масштаб x0.0078125 - | Factor for temperature decrease between EGR line and EGR valve" MAP 0x186F6 RL_GRID_DU8 0 CM_0p0078125_0 0 255
 /begin AXIS_DESCR FIX_AXIS NO_INPUT_QUANTITY CM_IDENTITY 6 0 5 FIX_AXIS_PAR_DIST 0 1 6 /end AXIS_DESCR
 /begin AXIS_DESCR FIX_AXIS NO_INPUT_QUANTITY CM_IDENTITY 8 0 7 FIX_AXIS_PAR_DIST 0 1 8 /end AXIS_DESCR
/end CHARACTERISTIC
/begin CHARACTERISTIC KFFTDAG "подтверждена | damos | адрес 0x18736, данные 0x18736 | масштаб x0.0078125 - | Factor for temperatur decrease between EGR line and EGR induction" MAP 0x18736 RL_GRID_DU8 0 CM_0p0078125_0 0 255
 /begin AXIS_DESCR FIX_AXIS NO_INPUT_QUANTITY CM_IDENTITY 6 0 5 FIX_AXIS_PAR_DIST 0 1 6 /end AXIS_DESCR
 /begin AXIS_DESCR FIX_AXIS NO_INPUT_QUANTITY CM_IDENTITY 8 0 7 FIX_AXIS_PAR_DIST 0 1 8 /end AXIS_DESCR
/end CHARACTERISTIC
/begin CHARACTERISTIC MAP_407_18768_6 "вероятная | mapscan | адрес 0x18768, данные 0x1876F" CURVE 0x18768 RL_2D_A8_DU8 0 CM_IDENTITY 0 255 /begin AXIS_DESCR STD_AXIS NO_INPUT_QUANTITY CM_IDENTITY 6 0 255 /end AXIS_DESCR /end CHARACTERISTIC
/begin CHARACTERISTIC KFSU "подтверждена | damos | адрес 0x18775, данные 0x18775 | Load/speed performance characteristics for suction tube switchover" MAP 0x18775 RL_GRID_DU8 0 CM_IDENTITY 0 255
 /begin AXIS_DESCR FIX_AXIS NO_INPUT_QUANTITY CM_IDENTITY 6 0 5 FIX_AXIS_PAR_DIST 0 1 6 /end AXIS_DESCR
 /begin AXIS_DESCR FIX_AXIS NO_INPUT_QUANTITY CM_IDENTITY 6 0 5 FIX_AXIS_PAR_DIST 0 1 6 /end AXIS_DESCR
/end CHARACTERISTIC
/begin CHARACTERISTIC MAP_409_1879A_6 "вероятная | mapscan | адрес 0x1879A, данные 0x187A1" CURVE 0x1879A RL_2D_A8_DU8 0 CM_IDENTITY 0 255 /begin AXIS_DESCR STD_AXIS NO_INPUT_QUANTITY CM_IDENTITY 6 0 255 /end AXIS_DESCR /end CHARACTERISTIC
/begin CHARACTERISTIC KFSU2 "подтверждена | damos | адрес 0x187A7, данные 0x187A7 | map for intake manifold switch over, flap 2" MAP 0x187A7 RL_GRID_DU8 0 CM_IDENTITY 0 255
 /begin AXIS_DESCR FIX_AXIS NO_INPUT_QUANTITY CM_IDENTITY 6 0 5 FIX_AXIS_PAR_DIST 0 1 6 /end AXIS_DESCR
 /begin AXIS_DESCR FIX_AXIS NO_INPUT_QUANTITY CM_IDENTITY 6 0 5 FIX_AXIS_PAR_DIST 0 1 6 /end AXIS_DESCR
/end CHARACTERISTIC
/begin CHARACTERISTIC TVSUM "подтверждена | damos | адрес 0x187D5, данные 0x187D5 | масштаб x0.1 s | delay time for intake manifold switch over in dependence of engine temperatur" CURVE 0x187D5 RL_GRID_DU8 0 CM_0p1_0_s 0 255
 /begin AXIS_DESCR FIX_AXIS NO_INPUT_QUANTITY CM_IDENTITY 6 0 5 FIX_AXIS_PAR_DIST 0 1 6 /end AXIS_DESCR
/end CHARACTERISTIC
/begin CHARACTERISTIC ATMABKA "вероятная | damos-вероятно | адрес 0x187E2, данные 0x187E2 | масштаб x0.00390625 - | factor reduction of exhaust gas temperature = f(soak time)" CURVE 0x187E2 RL_GRID_DU8 0 CM_0p00390625_0 0 255
 /begin AXIS_DESCR FIX_AXIS NO_INPUT_QUANTITY CM_IDENTITY 6 0 5 FIX_AXIS_PAR_DIST 0 1 6 /end AXIS_DESCR
/end CHARACTERISTIC
/begin CHARACTERISTIC ATMABKK "вероятная | damos-вероятно | адрес 0x187E8, данные 0x187E8 | масштаб x0.00390625 - | factor reduction for catalyst temperature = f(soak time)" CURVE 0x187E8 RL_GRID_DU8 0 CM_0p00390625_0 0 255
 /begin AXIS_DESCR FIX_AXIS NO_INPUT_QUANTITY CM_IDENTITY 6 0 5 FIX_AXIS_PAR_DIST 0 1 6 /end AXIS_DESCR
/end CHARACTERISTIC
/begin CHARACTERISTIC FATMRML "вероятная | damos-вероятно | адрес 0x187EF, данные 0x187EF | масштаб x0.00390625 - | divide factor exhaust-/exhaust-pipe temperature" CURVE 0x187EF RL_GRID_DU8 0 CM_0p00390625_0 0 255
 /begin AXIS_DESCR FIX_AXIS NO_INPUT_QUANTITY CM_IDENTITY 7 0 6 FIX_AXIS_PAR_DIST 0 1 7 /end AXIS_DESCR
/end CHARACTERISTIC
/begin CHARACTERISTIC KATMEXML "вероятная | damos-вероятно | адрес 0x187F9, данные 0x187F9 | масштаб x5 Grad C | Temperature of the exotherme in the catalyst tkatm" CURVE 0x187F9 RL_GRID_DS8 0 CM_5_0_GradC 0 127
 /begin AXIS_DESCR FIX_AXIS NO_INPUT_QUANTITY CM_IDENTITY 7 0 6 FIX_AXIS_PAR_DIST 0 1 7 /end AXIS_DESCR
/end CHARACTERISTIC
/begin CHARACTERISTIC KFATMLA "подтверждена | damos-точно | адрес 0x18800, данные 0x18800 | масштаб x5 Grad C | map exhaust gas temperature correction = f(lambda)" MAP 0x18800 RL_GRID_DS8 0 CM_5_0_GradC 0 127
 /begin AXIS_DESCR FIX_AXIS NO_INPUT_QUANTITY CM_IDENTITY 6 0 5 FIX_AXIS_PAR_DIST 0 1 6 /end AXIS_DESCR
 /begin AXIS_DESCR FIX_AXIS NO_INPUT_QUANTITY CM_IDENTITY 6 0 5 FIX_AXIS_PAR_DIST 0 1 6 /end AXIS_DESCR
/end CHARACTERISTIC
/begin CHARACTERISTIC KFATMZW "подтверждена | damos-точно | адрес 0x18824, данные 0x18824 | масштаб x5 Grad C | map exhaust gas temperature correktion = f(ignition-variation)" MAP 0x18824 RL_GRID_DS8 0 CM_5_0_GradC 0 127
 /begin AXIS_DESCR FIX_AXIS NO_INPUT_QUANTITY CM_IDENTITY 6 0 5 FIX_AXIS_PAR_DIST 0 1 6 /end AXIS_DESCR
 /begin AXIS_DESCR FIX_AXIS NO_INPUT_QUANTITY CM_IDENTITY 6 0 5 FIX_AXIS_PAR_DIST 0 1 6 /end AXIS_DESCR
/end CHARACTERISTIC
/begin CHARACTERISTIC KFTATM "подтверждена | damos-точно | адрес 0x1885A, данные 0x1885A | масштаб x5 Grad C | map exhaust gas temperature  f(nmot,rl)" MAP 0x1885A RL_GRID_DS8 0 CM_5_50_GradC 0 127
 /begin AXIS_DESCR FIX_AXIS NO_INPUT_QUANTITY CM_IDENTITY 8 0 7 FIX_AXIS_PAR_DIST 0 1 8 /end AXIS_DESCR
 /begin AXIS_DESCR FIX_AXIS NO_INPUT_QUANTITY CM_IDENTITY 8 0 7 FIX_AXIS_PAR_DIST 0 1 8 /end AXIS_DESCR
/end CHARACTERISTIC
/begin CHARACTERISTIC KLATMLAE "вероятная | damos-вероятно | адрес 0x1889A, данные 0x1889A | масштаб x0.00390625 - | Temperature of the exotherme decrease during enrichment" CURVE 0x1889A RL_GRID_DU8 0 CM_0p00390625_0 0 255
 /begin AXIS_DESCR FIX_AXIS NO_INPUT_QUANTITY CM_IDENTITY 6 0 5 FIX_AXIS_PAR_DIST 0 1 6 /end AXIS_DESCR
/end CHARACTERISTIC
/begin CHARACTERISTIC KLATMZWE "вероятная | damos-вероятно | адрес 0x188A0, данные 0x188A0 | масштаб x0.00390625 - | Temperature of the exotherme decrease in cat during ignition retard tkatm" CURVE 0x188A0 RL_GRID_DU8 0 CM_0p00390625_0 0 255
 /begin AXIS_DESCR FIX_AXIS NO_INPUT_QUANTITY CM_IDENTITY 6 0 5 FIX_AXIS_PAR_DIST 0 1 6 /end AXIS_DESCR
/end CHARACTERISTIC
/begin CHARACTERISTIC FRINH1 "подтверждена | damos | адрес 0x188C0, данные 0x188C0 | масштаб x0.25 - | Multiplication factor for RIN nominal value downstream of the catalyzer" CURVE 0x188C0 RL_GRID_DU8 0 CM_0p25_0 0 255
 /begin AXIS_DESCR FIX_AXIS NO_INPUT_QUANTITY CM_IDENTITY 5 0 4 FIX_AXIS_PAR_DIST 0 1 5 /end AXIS_DESCR
/end CHARACTERISTIC
/begin CHARACTERISTIC MAP_422_188CA_5 "вероятная | mapscan | адрес 0x188CA, данные 0x188D0" CURVE 0x188CA RL_2D_A8_DU8 0 CM_IDENTITY 0 255 /begin AXIS_DESCR STD_AXIS NO_INPUT_QUANTITY CM_IDENTITY 5 0 255 /end AXIS_DESCR /end CHARACTERISTIC
/begin CHARACTERISTIC KFRINH "неоднозначная | damos-сомнительно | адрес 0x188DF, данные 0x188DF | масштаб x8 Ohm | MAP for Nernst resistor post cat" MAP 0x188DF RL_GRID_DU8 0 CM_8_0_Ohm 0 255
 /begin AXIS_DESCR FIX_AXIS NO_INPUT_QUANTITY CM_IDENTITY 3 0 2 FIX_AXIS_PAR_DIST 0 1 3 /end AXIS_DESCR
 /begin AXIS_DESCR FIX_AXIS NO_INPUT_QUANTITY CM_IDENTITY 5 0 4 FIX_AXIS_PAR_DIST 0 1 5 /end AXIS_DESCR
/end CHARACTERISTIC
/begin CHARACTERISTIC KFTPKOR "подтверждена | damos-точно | адрес 0x18907, данные 0x18907 | масштаб x0.0078125 - | correction map for the measured cycle duration TP (tpsvkof)" MAP 0x18907 RL_GRID_DU8 0 CM_0p0078125_0 0 255
 /begin AXIS_DESCR FIX_AXIS NO_INPUT_QUANTITY CM_IDENTITY 7 0 6 FIX_AXIS_PAR_DIST 0 1 7 /end AXIS_DESCR
 /begin AXIS_DESCR FIX_AXIS NO_INPUT_QUANTITY CM_IDENTITY 8 0 7 FIX_AXIS_PAR_DIST 0 1 8 /end AXIS_DESCR
/end CHARACTERISTIC
/begin CHARACTERISTIC FFRITMS "подтверждена | damos | адрес 0x1898F, данные 0x1898F | масштаб x0.00390625 - | tmst dependent factor to modify I-dynamic of lambda control" CURVE 0x1898F RL_GRID_DU8 0 CM_0p00390625_0 0 255
 /begin AXIS_DESCR FIX_AXIS NO_INPUT_QUANTITY CM_IDENTITY 4 0 3 FIX_AXIS_PAR_DIST 0 1 4 /end AXIS_DESCR
/end CHARACTERISTIC
/begin CHARACTERISTIC KFRI "подтверждена | damos-точно | адрес 0x18997, данные 0x18997 | масштаб x0.30581 %/s | I characteristic map" MAP 0x18997 RL_GRID_DU8 0 CM_0p3058103976_0_s 0 255
 /begin AXIS_DESCR FIX_AXIS NO_INPUT_QUANTITY CM_IDENTITY 6 0 5 FIX_AXIS_PAR_DIST 0 1 6 /end AXIS_DESCR
 /begin AXIS_DESCR FIX_AXIS NO_INPUT_QUANTITY CM_IDENTITY 7 0 6 FIX_AXIS_PAR_DIST 0 1 7 /end AXIS_DESCR
/end CHARACTERISTIC
/begin CHARACTERISTIC KFRI2 "вероятная | damos-вероятно | адрес 0x189C1, данные 0x189C1 | масштаб x0.30581 %/s | LR-I-Map for bank 2" MAP 0x189C1 RL_GRID_DU8 0 CM_0p3058103976_0_s 0 255
 /begin AXIS_DESCR FIX_AXIS NO_INPUT_QUANTITY CM_IDENTITY 6 0 5 FIX_AXIS_PAR_DIST 0 1 6 /end AXIS_DESCR
 /begin AXIS_DESCR FIX_AXIS NO_INPUT_QUANTITY CM_IDENTITY 7 0 6 FIX_AXIS_PAR_DIST 0 1 7 /end AXIS_DESCR
/end CHARACTERISTIC
/begin CHARACTERISTIC KFRP "подтверждена | damos-точно | адрес 0x189EB, данные 0x189EB | масштаб x0.0488281 % | P characteristic map" MAP 0x189EB RL_GRID_DU8 0 CM_0p048828125_0 0 255
 /begin AXIS_DESCR FIX_AXIS NO_INPUT_QUANTITY CM_IDENTITY 6 0 5 FIX_AXIS_PAR_DIST 0 1 6 /end AXIS_DESCR
 /begin AXIS_DESCR FIX_AXIS NO_INPUT_QUANTITY CM_IDENTITY 7 0 6 FIX_AXIS_PAR_DIST 0 1 7 /end AXIS_DESCR
/end CHARACTERISTIC
/begin CHARACTERISTIC KFRP2 "сомнительная | damos-сомнительно | адрес 0x18A15, данные 0x18A15 | масштаб x0.0488281 % | LR-P MAP for bank 2" MAP 0x18A15 RL_GRID_DU8 0 CM_0p048828125_0 0 255
 /begin AXIS_DESCR FIX_AXIS NO_INPUT_QUANTITY CM_IDENTITY 6 0 5 FIX_AXIS_PAR_DIST 0 1 6 /end AXIS_DESCR
 /begin AXIS_DESCR FIX_AXIS NO_INPUT_QUANTITY CM_IDENTITY 7 0 6 FIX_AXIS_PAR_DIST 0 1 7 /end AXIS_DESCR
/end CHARACTERISTIC
/begin CHARACTERISTIC KFRTV "сомнительная | damos-сомнительно | адрес 0x18A3F, данные 0x18A3F | масштаб x0.01 s | delay time characteristic map" MAP 0x18A3F RL_GRID_DS8 0 CM_0p01_0_s 0 127
 /begin AXIS_DESCR FIX_AXIS NO_INPUT_QUANTITY CM_IDENTITY 6 0 5 FIX_AXIS_PAR_DIST 0 1 6 /end AXIS_DESCR
 /begin AXIS_DESCR FIX_AXIS NO_INPUT_QUANTITY CM_IDENTITY 7 0 6 FIX_AXIS_PAR_DIST 0 1 7 /end AXIS_DESCR
/end CHARACTERISTIC
/begin CHARACTERISTIC KFRTV2 "сомнительная | damos-сомнительно | адрес 0x18A69, данные 0x18A69 | масштаб x0.01 s | delay time characteristic map" MAP 0x18A69 RL_GRID_DS8 0 CM_0p01_0_s 0 127
 /begin AXIS_DESCR FIX_AXIS NO_INPUT_QUANTITY CM_IDENTITY 6 0 5 FIX_AXIS_PAR_DIST 0 1 6 /end AXIS_DESCR
 /begin AXIS_DESCR FIX_AXIS NO_INPUT_QUANTITY CM_IDENTITY 7 0 6 FIX_AXIS_PAR_DIST 0 1 7 /end AXIS_DESCR
/end CHARACTERISTIC
/begin CHARACTERISTIC MAP_432_18ABF_8 "вероятная | mapscan | адрес 0x18ABF, данные 0x18AC8" CURVE 0x18ABF RL_2D_A8_DU8 0 CM_IDENTITY 0 255 /begin AXIS_DESCR STD_AXIS NO_INPUT_QUANTITY CM_IDENTITY 8 0 255 /end AXIS_DESCR /end CHARACTERISTIC
/begin CHARACTERISTIC RLLRUN "вероятная | damos-вероятно | адрес 0x18AD2, данные 0x18AD2 | масштаб x0.75 % | char.line above nmot,lower rL control limit for controller in front of catalyst" CURVE 0x18AD2 RL_GRID_DU8 0 CM_0p75_0 0 255
 /begin AXIS_DESCR FIX_AXIS NO_INPUT_QUANTITY CM_IDENTITY 8 0 7 FIX_AXIS_PAR_DIST 0 1 8 /end AXIS_DESCR
/end CHARACTERISTIC
/begin CHARACTERISTIC KFFTV "подтверждена | damos-точно | адрес 0x18AEA, данные 0x18AEA | масштаб x0.0078125 - | weighting map for TVLRH" MAP 0x18AEA RL_GRID_DU8 0 CM_0p0078125_0 0 255
 /begin AXIS_DESCR FIX_AXIS NO_INPUT_QUANTITY CM_IDENTITY 6 0 5 FIX_AXIS_PAR_DIST 0 1 6 /end AXIS_DESCR
 /begin AXIS_DESCR FIX_AXIS NO_INPUT_QUANTITY CM_IDENTITY 6 0 5 FIX_AXIS_PAR_DIST 0 1 6 /end AXIS_DESCR
/end CHARACTERISTIC
/begin CHARACTERISTIC KFUSHK "вероятная | damos-вероятно | адрес 0x18B0E, данные 0x18B0E | масштаб x0.00521569 V | lambda sensor reference value for lambda control downstream of catalyst" MAP 0x18B0E RL_GRID_DS8 0 CM_0p005215686275_0p2_V 0 127
 /begin AXIS_DESCR FIX_AXIS NO_INPUT_QUANTITY CM_IDENTITY 6 0 5 FIX_AXIS_PAR_DIST 0 1 6 /end AXIS_DESCR
 /begin AXIS_DESCR FIX_AXIS NO_INPUT_QUANTITY CM_IDENTITY 6 0 5 FIX_AXIS_PAR_DIST 0 1 6 /end AXIS_DESCR
/end CHARACTERISTIC
/begin CHARACTERISTIC PLRHML "вероятная | damos-вероятно | адрес 0x18B32, данные 0x18B32 | масштаб x0.01 s | p-part of LRHK, f(dushk)" CURVE 0x18B32 RL_GRID_DS8 0 CM_0p01_0_s 0 127
 /begin AXIS_DESCR FIX_AXIS NO_INPUT_QUANTITY CM_IDENTITY 8 0 7 FIX_AXIS_PAR_DIST 0 1 8 /end AXIS_DESCR
/end CHARACTERISTIC
/begin CHARACTERISTIC RLLRHON "вероятная | damos-вероятно | адрес 0x18B3A, данные 0x18B3A | масштаб x0.75 % | char. line on nmot, upper rl control threshold for downstream lambda control" CURVE 0x18B3A RL_GRID_DU8 0 CM_0p75_0 0 255
 /begin AXIS_DESCR FIX_AXIS NO_INPUT_QUANTITY CM_IDENTITY 8 0 7 FIX_AXIS_PAR_DIST 0 1 8 /end AXIS_DESCR
/end CHARACTERISTIC
/begin CHARACTERISTIC RLLRHUN "вероятная | damos-вероятно | адрес 0x18B42, данные 0x18B42 | масштаб x0.75 % | char. line on nmot, lower control threshold rl for downstream lambda control" CURVE 0x18B42 RL_GRID_DU8 0 CM_0p75_0 0 255
 /begin AXIS_DESCR FIX_AXIS NO_INPUT_QUANTITY CM_IDENTITY 8 0 7 FIX_AXIS_PAR_DIST 0 1 8 /end AXIS_DESCR
/end CHARACTERISTIC
/begin CHARACTERISTIC ZLRHML "вероятная | damos-вероятно | адрес 0x18B4A, данные 0x18B4A | масштаб x0.0390625 ms/s | time constant of lambda control integrator downstream catalyst" CURVE 0x18B4A RL_GRID_DU8 0 CM_0p0390625_0_mss 0 255
 /begin AXIS_DESCR FIX_AXIS NO_INPUT_QUANTITY CM_IDENTITY 8 0 7 FIX_AXIS_PAR_DIST 0 1 8 /end AXIS_DESCR
/end CHARACTERISTIC
/begin CHARACTERISTIC DTVKAML "вероятная | damos-вероятно | адрес 0x18B52, данные 0x18B52 | масштаб x0.01 s | delta-tv for cat oxygen neutralization (air mass dependent)" CURVE 0x18B52 RL_GRID_DS8 0 CM_0p01_0_s 0 127
 /begin AXIS_DESCR FIX_AXIS NO_INPUT_QUANTITY CM_IDENTITY 5 0 4 FIX_AXIS_PAR_DIST 0 1 5 /end AXIS_DESCR
/end CHARACTERISTIC
/begin CHARACTERISTIC DTVKAML2 "вероятная | damos-вероятно | адрес 0x18B57, данные 0x18B57 | масштаб x0.01 s | delta-tv for cat oxygen neutralization (air mass dependent) bank2" CURVE 0x18B57 RL_GRID_DS8 0 CM_0p01_0_s 0 127
 /begin AXIS_DESCR FIX_AXIS NO_INPUT_QUANTITY CM_IDENTITY 5 0 4 FIX_AXIS_PAR_DIST 0 1 5 /end AXIS_DESCR
/end CHARACTERISTIC
/begin CHARACTERISTIC FKAXAVKAT "вероятная | damos-вероятно | адрес 0x18B5D, данные 0x18B5D | масштаб x0.00390625 - | weighting factor for oxygen capacity depending on avkatf" CURVE 0x18B5D RL_GRID_DU8 0 CM_0p00390625_0 0 255
 /begin AXIS_DESCR FIX_AXIS NO_INPUT_QUANTITY CM_IDENTITY 5 0 4 FIX_AXIS_PAR_DIST 0 1 5 /end AXIS_DESCR
/end CHARACTERISTIC
/begin CHARACTERISTIC BTRKHTMS "вероятная | damos-вероятно | адрес 0x18B6B, данные 0x18B6B | Characteristic enabling flag B_trkh" CURVE 0x18B6B RL_GRID_DU8 0 CM_IDENTITY 0 255
 /begin AXIS_DESCR FIX_AXIS NO_INPUT_QUANTITY CM_IDENTITY 8 0 7 FIX_AXIS_PAR_DIST 0 1 8 /end AXIS_DESCR
/end CHARACTERISTIC
/begin CHARACTERISTIC FNSKHLL "подтверждена | damos | адрес 0x18B81, данные 0x18B81 | масштаб x0.0078125 - | factor idle speed increase after start" CURVE 0x18B81 RL_GRID_DU8 0 CM_0p0078125_0 0 255
 /begin AXIS_DESCR FIX_AXIS NO_INPUT_QUANTITY CM_IDENTITY 5 0 4 FIX_AXIS_PAR_DIST 0 1 5 /end AXIS_DESCR
/end CHARACTERISTIC
/begin CHARACTERISTIC FTMLAKH "вероятная | damos-вероятно | адрес 0x18BB0, данные 0x18BB0 | масштаб x0.00390625 - | tmot-correction of lambda-weighting at catalyst heating" CURVE 0x18BB0 RL_GRID_DU8 0 CM_0p00390625_0 0 255
 /begin AXIS_DESCR FIX_AXIS NO_INPUT_QUANTITY CM_IDENTITY 4 0 3 FIX_AXIS_PAR_DIST 0 1 4 /end AXIS_DESCR
/end CHARACTERISTIC
/begin CHARACTERISTIC MAP_446_18BBA_4 "вероятная | mapscan | адрес 0x18BBA, данные 0x18BC3" CURVE 0x18BBA RL_2D_A16_DU8 0 CM_IDENTITY 0 255 /begin AXIS_DESCR STD_AXIS NO_INPUT_QUANTITY CM_IDENTITY 4 0 65535 /end AXIS_DESCR /end CHARACTERISTIC
/begin CHARACTERISTIC KFNLLKHM "подтверждена | damos | адрес 0x18BC7, данные 0x18BC7 | масштаб x10 U/min | Nominal idling speed during catalyzer heating" MAP 0x18BC7 RL_GRID_DU8 0 CM_10_0_Umin 0 255
 /begin AXIS_DESCR FIX_AXIS NO_INPUT_QUANTITY CM_IDENTITY 4 0 3 FIX_AXIS_PAR_DIST 0 1 4 /end AXIS_DESCR
 /begin AXIS_DESCR FIX_AXIS NO_INPUT_QUANTITY CM_IDENTITY 8 0 7 FIX_AXIS_PAR_DIST 0 1 8 /end AXIS_DESCR
/end CHARACTERISTIC
/begin CHARACTERISTIC MLSUS "подтверждена | damos | адрес 0x18BE9, данные 0x18BE9 | масштаб x0.0227556 kg | reference of air mass flow integral" CURVE 0x18BE9 RL_GRID_DU8 0 CM_0p02275555556_0_kg 0 255
 /begin AXIS_DESCR FIX_AXIS NO_INPUT_QUANTITY CM_IDENTITY 12 0 11 FIX_AXIS_PAR_DIST 0 1 12 /end AXIS_DESCR
/end CHARACTERISTIC
/begin CHARACTERISTIC NFSKHM "вероятная | damos-вероятно | адрес 0x18C01, данные 0x18C01 | масштаб x10 U/min | LL nominal speed with driving graduations and catalyzer heating" CURVE 0x18C01 RL_GRID_DU8 0 CM_10_0_Umin 0 255
 /begin AXIS_DESCR FIX_AXIS NO_INPUT_QUANTITY CM_IDENTITY 4 0 3 FIX_AXIS_PAR_DIST 0 1 4 /end AXIS_DESCR
/end CHARACTERISTIC
/begin CHARACTERISTIC FMDKHFH "вероятная | damos-вероятно | адрес 0x18C10, данные 0x18C10 | масштаб x0.0078125 - | altitude correction of torque reserve for catalyst heating" CURVE 0x18C10 RL_GRID_DU8 0 CM_0p0078125_0 0 255
 /begin AXIS_DESCR FIX_AXIS NO_INPUT_QUANTITY CM_IDENTITY 4 0 3 FIX_AXIS_PAR_DIST 0 1 4 /end AXIS_DESCR
/end CHARACTERISTIC
/begin CHARACTERISTIC FMDKHTM "вероятная | damos-вероятно | адрес 0x18C19, данные 0x18C19 | масштаб x0.0078125 - | tmot-correction of torque reserve for catalyst heating" CURVE 0x18C19 RL_GRID_DU8 0 CM_0p0078125_0 0 255
 /begin AXIS_DESCR FIX_AXIS NO_INPUT_QUANTITY CM_IDENTITY 8 0 7 FIX_AXIS_PAR_DIST 0 1 8 /end AXIS_DESCR
/end CHARACTERISTIC
/begin CHARACTERISTIC MAP_452_18C2A_8 "вероятная | mapscan | адрес 0x18C2A, данные 0x18C33" CURVE 0x18C2A RL_2D_A8_DU8 0 CM_IDENTITY 0 255 /begin AXIS_DESCR STD_AXIS NO_INPUT_QUANTITY CM_IDENTITY 8 0 255 /end AXIS_DESCR /end CHARACTERISTIC
/begin CHARACTERISTIC MAP_453_18C7C_8 "вероятная | mapscan | адрес 0x18C7C, данные 0x18C85" CURVE 0x18C7C RL_2D_A8_DU8 0 CM_IDENTITY 0 255 /begin AXIS_DESCR STD_AXIS NO_INPUT_QUANTITY CM_IDENTITY 8 0 255 /end AXIS_DESCR /end CHARACTERISTIC
/begin CHARACTERISTIC MAP_454_18CCE_4 "вероятная | mapscan | адрес 0x18CCE, данные 0x18CD3" CURVE 0x18CCE RL_2D_A8_DU8 0 CM_IDENTITY 0 255 /begin AXIS_DESCR STD_AXIS NO_INPUT_QUANTITY CM_IDENTITY 4 0 255 /end AXIS_DESCR /end CHARACTERISTIC
/begin CHARACTERISTIC KFEKWTMP "подтверждена | damos-точно | адрес 0x18CD7, данные 0x18CD7 | масштаб x0.5 % | characteristic diagram efficiency while keeping catalyst warm" MAP 0x18CD7 RL_GRID_DU8 0 CM_0p5_0 0 255
 /begin AXIS_DESCR FIX_AXIS NO_INPUT_QUANTITY CM_IDENTITY 4 0 3 FIX_AXIS_PAR_DIST 0 1 4 /end AXIS_DESCR
 /begin AXIS_DESCR FIX_AXIS NO_INPUT_QUANTITY CM_IDENTITY 4 0 3 FIX_AXIS_PAR_DIST 0 1 4 /end AXIS_DESCR
/end CHARACTERISTIC
/begin CHARACTERISTIC MAP_456_18CE9_8 "вероятная | mapscan | адрес 0x18CE9, данные 0x18CF2" CURVE 0x18CE9 RL_2D_A8_DU8 0 CM_IDENTITY 0 255 /begin AXIS_DESCR STD_AXIS NO_INPUT_QUANTITY CM_IDENTITY 8 0 255 /end AXIS_DESCR /end CHARACTERISTIC
/begin CHARACTERISTIC KFLMSKH "подтверждена | damos-точно | адрес 0x18CFA, данные 0x18CFA | масштаб x0.0078125 - | Performance characteristics lambda engine nominal at catalyst heating" MAP 0x18CFA RL_GRID_DU8 0 CM_0p0078125_0 0 255
 /begin AXIS_DESCR FIX_AXIS NO_INPUT_QUANTITY CM_IDENTITY 8 0 7 FIX_AXIS_PAR_DIST 0 1 8 /end AXIS_DESCR
 /begin AXIS_DESCR FIX_AXIS NO_INPUT_QUANTITY CM_IDENTITY 8 0 7 FIX_AXIS_PAR_DIST 0 1 8 /end AXIS_DESCR
/end CHARACTERISTIC
/begin CHARACTERISTIC MAP_458_18D3B_8 "вероятная | mapscan | адрес 0x18D3B, данные 0x18D44" CURVE 0x18D3B RL_2D_A8_DU8 0 CM_IDENTITY 0 255 /begin AXIS_DESCR STD_AXIS NO_INPUT_QUANTITY CM_IDENTITY 8 0 255 /end AXIS_DESCR /end CHARACTERISTIC
/begin CHARACTERISTIC LMSTMOT "вероятная | damos-вероятно | адрес 0x18D4D, данные 0x18D4D | масштаб x0.0078125 - | tmot-correction of lambda engine nominal" CURVE 0x18D4D RL_GRID_DU8 0 CM_0p0078125_0 0 255
 /begin AXIS_DESCR FIX_AXIS NO_INPUT_QUANTITY CM_IDENTITY 4 0 3 FIX_AXIS_PAR_DIST 0 1 4 /end AXIS_DESCR
/end CHARACTERISTIC
/begin CHARACTERISTIC KEMLN "вероятная | damos-вероятно | адрес 0x18D5D, данные 0x18D5D | масштаб x0.75 Grad KW | length of the sampling window for knock control" CURVE 0x18D5D RL_GRID_DU8 0 CM_0p75_0_GradKW 0 255
 /begin AXIS_DESCR FIX_AXIS NO_INPUT_QUANTITY CM_IDENTITY 16 0 15 FIX_AXIS_PAR_DIST 0 1 16 /end AXIS_DESCR
/end CHARACTERISTIC
/begin CHARACTERISTIC KFMAKR "сомнительная | damos-сомнительно | адрес 0x18D6D, данные 0x18D6D | масштаб x0.75 Grad KW | map for starting measuring window knock control" MAP 0x18D6D RL_GRID_DU8 0 CM_0p75_0_GradKW 0 255
 /begin AXIS_DESCR FIX_AXIS NO_INPUT_QUANTITY CM_IDENTITY 4 0 3 FIX_AXIS_PAR_DIST 0 1 4 /end AXIS_DESCR
 /begin AXIS_DESCR FIX_AXIS NO_INPUT_QUANTITY CM_IDENTITY 16 0 15 FIX_AXIS_PAR_DIST 0 1 16 /end AXIS_DESCR
/end CHARACTERISTIC
/begin CHARACTERISTIC SENZZYL "вероятная | damos-вероятно | адрес 0x18DB0, данные 0x18DB0 | knock sensor for sw-cylinder counter 0-7" CURVE 0x18DB0 RL_GRID_DU8 0 CM_1_n1 0 255
 /begin AXIS_DESCR FIX_AXIS NO_INPUT_QUANTITY CM_IDENTITY 8 0 7 FIX_AXIS_PAR_DIST 0 1 8 /end AXIS_DESCR
/end CHARACTERISTIC
/begin CHARACTERISTIC KE1N "вероятная | damos-вероятно | адрес 0x18DBB, данные 0x18DBB | масштаб x0.0625 - | knock detection threshold at cylindertimer 1" CURVE 0x18DBB RL_GRID_DU8 0 CM_0p0625_0 0 255
 /begin AXIS_DESCR FIX_AXIS NO_INPUT_QUANTITY CM_IDENTITY 16 0 15 FIX_AXIS_PAR_DIST 0 1 16 /end AXIS_DESCR
/end CHARACTERISTIC
/begin CHARACTERISTIC KE2N "вероятная | damos-вероятно | адрес 0x18DCB, данные 0x18DCB | масштаб x0.0625 - | knock detection threshold at cylindertimer 2" CURVE 0x18DCB RL_GRID_DU8 0 CM_0p0625_0 0 255
 /begin AXIS_DESCR FIX_AXIS NO_INPUT_QUANTITY CM_IDENTITY 16 0 15 FIX_AXIS_PAR_DIST 0 1 16 /end AXIS_DESCR
/end CHARACTERISTIC
/begin CHARACTERISTIC KE3N "вероятная | damos-вероятно | адрес 0x18DDB, данные 0x18DDB | масштаб x0.0625 - | knock detection threshold at cylindertimer 3" CURVE 0x18DDB RL_GRID_DU8 0 CM_0p0625_0 0 255
 /begin AXIS_DESCR FIX_AXIS NO_INPUT_QUANTITY CM_IDENTITY 16 0 15 FIX_AXIS_PAR_DIST 0 1 16 /end AXIS_DESCR
/end CHARACTERISTIC
/begin CHARACTERISTIC KE4N "вероятная | damos-вероятно | адрес 0x18DEB, данные 0x18DEB | масштаб x0.0625 - | knock detection threshold at cylindertimer 4" CURVE 0x18DEB RL_GRID_DU8 0 CM_0p0625_0 0 255
 /begin AXIS_DESCR FIX_AXIS NO_INPUT_QUANTITY CM_IDENTITY 16 0 15 FIX_AXIS_PAR_DIST 0 1 16 /end AXIS_DESCR
/end CHARACTERISTIC
/begin CHARACTERISTIC KE5N "вероятная | damos-вероятно | адрес 0x18DFB, данные 0x18DFB | масштаб x0.0625 - | knock detection threshold at cylindertimer 5" CURVE 0x18DFB RL_GRID_DU8 0 CM_0p0625_0 0 255
 /begin AXIS_DESCR FIX_AXIS NO_INPUT_QUANTITY CM_IDENTITY 16 0 15 FIX_AXIS_PAR_DIST 0 1 16 /end AXIS_DESCR
/end CHARACTERISTIC
/begin CHARACTERISTIC KE6N "вероятная | damos-вероятно | адрес 0x18E0B, данные 0x18E0B | масштаб x0.0625 - | knock detection threshold at cylindertimer 6" CURVE 0x18E0B RL_GRID_DU8 0 CM_0p0625_0 0 255
 /begin AXIS_DESCR FIX_AXIS NO_INPUT_QUANTITY CM_IDENTITY 16 0 15 FIX_AXIS_PAR_DIST 0 1 16 /end AXIS_DESCR
/end CHARACTERISTIC
/begin CHARACTERISTIC KE7N "вероятная | damos-вероятно | адрес 0x18E1B, данные 0x18E1B | масштаб x0.0625 - | knock detection threshold at cylindertimer 7" CURVE 0x18E1B RL_GRID_DU8 0 CM_0p0625_0 0 255
 /begin AXIS_DESCR FIX_AXIS NO_INPUT_QUANTITY CM_IDENTITY 16 0 15 FIX_AXIS_PAR_DIST 0 1 16 /end AXIS_DESCR
/end CHARACTERISTIC
/begin CHARACTERISTIC KE8N "вероятная | damos-вероятно | адрес 0x18E2B, данные 0x18E2B | масштаб x0.0625 - | knock detection threshold at cylindertimer 8" CURVE 0x18E2B RL_GRID_DU8 0 CM_0p0625_0 0 255
 /begin AXIS_DESCR FIX_AXIS NO_INPUT_QUANTITY CM_IDENTITY 16 0 15 FIX_AXIS_PAR_DIST 0 1 16 /end AXIS_DESCR
/end CHARACTERISTIC
/begin CHARACTERISTIC RKRMX1N "вероятная | damos-вероятно | адрес 0x18E3B, данные 0x18E3B | масштаб x1.25 V | Maximum of reference level for knock detection threshold cylinder group 1" CURVE 0x18E3B RL_GRID_DU8 0 CM_1p25_0_V 0 255
 /begin AXIS_DESCR FIX_AXIS NO_INPUT_QUANTITY CM_IDENTITY 16 0 15 FIX_AXIS_PAR_DIST 0 1 16 /end AXIS_DESCR
/end CHARACTERISTIC
/begin CHARACTERISTIC RKRMX2N "вероятная | damos-вероятно | адрес 0x18E4B, данные 0x18E4B | масштаб x1.25 V | maximum of reference level for knock detection threshold cylinder group 2" CURVE 0x18E4B RL_GRID_DU8 0 CM_1p25_0_V 0 255
 /begin AXIS_DESCR FIX_AXIS NO_INPUT_QUANTITY CM_IDENTITY 16 0 15 FIX_AXIS_PAR_DIST 0 1 16 /end AXIS_DESCR
/end CHARACTERISTIC
/begin CHARACTERISTIC DWKRMSN "вероятная | damos-вероятно | адрес 0x18E5D, данные 0x18E5D | масштаб x-0.75 grad KW | delta ignition angle knock control distance from mean retarding" CURVE 0x18E5D RL_GRID_DS8 0 CM_n0p75_0_gradKW 0 127
 /begin AXIS_DESCR FIX_AXIS NO_INPUT_QUANTITY CM_IDENTITY 16 0 15 FIX_AXIS_PAR_DIST 0 1 16 /end AXIS_DESCR
/end CHARACTERISTIC
/begin CHARACTERISTIC KRAL1N "вероятная | damos-вероятно | адрес 0x18E6D, данные 0x18E6D | масштаб x0.75 % | load range for adaption maps 1" CURVE 0x18E6D RL_GRID_DU8 0 CM_0p75_0 0 255
 /begin AXIS_DESCR FIX_AXIS NO_INPUT_QUANTITY CM_IDENTITY 16 0 15 FIX_AXIS_PAR_DIST 0 1 16 /end AXIS_DESCR
/end CHARACTERISTIC
/begin CHARACTERISTIC KRAL2N "вероятная | damos-вероятно | адрес 0x18E7D, данные 0x18E7D | масштаб x0.75 % | load range dor adaption maps 2" CURVE 0x18E7D RL_GRID_DU8 0 CM_0p75_0 0 255
 /begin AXIS_DESCR FIX_AXIS NO_INPUT_QUANTITY CM_IDENTITY 16 0 15 FIX_AXIS_PAR_DIST 0 1 16 /end AXIS_DESCR
/end CHARACTERISTIC
/begin CHARACTERISTIC MAP_476_18E8E_4 "вероятная | mapscan | адрес 0x18E8E, данные 0x18E97" CURVE 0x18E8E RL_2D_A16_DU8 0 CM_IDENTITY 0 255 /begin AXIS_DESCR STD_AXIS NO_INPUT_QUANTITY CM_IDENTITY 4 0 65535 /end AXIS_DESCR /end CHARACTERISTIC
/begin CHARACTERISTIC KRDWSN "вероятная | damos-вероятно | адрес 0x18EA3, данные 0x18EA3 | масштаб x-0.75 grad KW | knock control delta angle safety" CURVE 0x18EA3 RL_GRID_DS8 0 CM_n0p75_0_gradKW 0 127
 /begin AXIS_DESCR FIX_AXIS NO_INPUT_QUANTITY CM_IDENTITY 16 0 15 FIX_AXIS_PAR_DIST 0 1 16 /end AXIS_DESCR
/end CHARACTERISTIC
/begin CHARACTERISTIC KRFKN "вероятная | damos-вероятно | адрес 0x18F05, данные 0x18F05 | масштаб x-0.75 grad KW | retard step knock occurrence" CURVE 0x18F05 RL_GRID_DS8 0 CM_n0p75_0_gradKW 0 127
 /begin AXIS_DESCR FIX_AXIS NO_INPUT_QUANTITY CM_IDENTITY 16 0 15 FIX_AXIS_PAR_DIST 0 1 16 /end AXIS_DESCR
/end CHARACTERISTIC
/begin CHARACTERISTIC KRMXN "вероятная | damos-вероятно | адрес 0x18F15, данные 0x18F15 | масштаб x-0.75 grad KW | maximum retard adjustment" CURVE 0x18F15 RL_GRID_DS8 0 CM_n0p75_0_gradKW 0 127
 /begin AXIS_DESCR FIX_AXIS NO_INPUT_QUANTITY CM_IDENTITY 16 0 15 FIX_AXIS_PAR_DIST 0 1 16 /end AXIS_DESCR
/end CHARACTERISTIC
/begin CHARACTERISTIC KRNLZAR "вероятная | damos-вероятно | адрес 0x18F25, данные 0x18F25 | масштаб x40 Upm | cylinder individual rpm limit for lead by leading cylinder" CURVE 0x18F25 RL_GRID_DU8 0 CM_40_0_Upm 0 255
 /begin AXIS_DESCR FIX_AXIS NO_INPUT_QUANTITY CM_IDENTITY 8 0 7 FIX_AXIS_PAR_DIST 0 1 8 /end AXIS_DESCR
/end CHARACTERISTIC
/begin CHARACTERISTIC KRVFN "вероятная | damos-вероятно | адрес 0x18F2D, данные 0x18F2D | number of firings/cyl. or time for ignition advancing" CURVE 0x18F2D RL_GRID_DU8 0 CM_IDENTITY 0 255
 /begin AXIS_DESCR FIX_AXIS NO_INPUT_QUANTITY CM_IDENTITY 16 0 15 FIX_AXIS_PAR_DIST 0 1 16 /end AXIS_DESCR
/end CHARACTERISTIC
/begin CHARACTERISTIC MAP_482_18F3D_4 "вероятная | mapscan | адрес 0x18F3D, данные 0x18F42" CURVE 0x18F3D RL_2D_A8_DU16 0 CM_IDENTITY 0 65535 /begin AXIS_DESCR STD_AXIS NO_INPUT_QUANTITY CM_IDENTITY 4 0 255 /end AXIS_DESCR /end CHARACTERISTIC
/begin CHARACTERISTIC LKRN "вероятная | damos-вероятно | адрес 0x18F4D, данные 0x18F4D | масштаб x0.75 % | load-signal threshold knock control" CURVE 0x18F4D RL_GRID_DU8 0 CM_0p75_0 0 255
 /begin AXIS_DESCR FIX_AXIS NO_INPUT_QUANTITY CM_IDENTITY 16 0 15 FIX_AXIS_PAR_DIST 0 1 16 /end AXIS_DESCR
/end CHARACTERISTIC
/begin CHARACTERISTIC MAP_484_18F61_4 "вероятная | mapscan | адрес 0x18F61, данные 0x18F66" CURVE 0x18F61 RL_2D_A8_DU8 0 CM_IDENTITY 0 255 /begin AXIS_DESCR STD_AXIS NO_INPUT_QUANTITY CM_IDENTITY 4 0 255 /end AXIS_DESCR /end CHARACTERISTIC
/begin CHARACTERISTIC MAP_485_18F71_4 "вероятная | mapscan | адрес 0x18F71, данные 0x18F76" CURVE 0x18F71 RL_2D_A8_DU8 0 CM_IDENTITY 0 255 /begin AXIS_DESCR STD_AXIS NO_INPUT_QUANTITY CM_IDENTITY 4 0 255 /end AXIS_DESCR /end CHARACTERISTIC
/begin CHARACTERISTIC MAP_486_18FA2_4 "вероятная | mapscan | адрес 0x18FA2, данные 0x18FA7" CURVE 0x18FA2 RL_2D_A8_DU8 0 CM_IDENTITY 0 255 /begin AXIS_DESCR STD_AXIS NO_INPUT_QUANTITY CM_IDENTITY 4 0 255 /end AXIS_DESCR /end CHARACTERISTIC
/begin CHARACTERISTIC MAP_487_18FB2_4 "вероятная | mapscan | адрес 0x18FB2, данные 0x18FB7" CURVE 0x18FB2 RL_2D_A8_DU8 0 CM_IDENTITY 0 255 /begin AXIS_DESCR STD_AXIS NO_INPUT_QUANTITY CM_IDENTITY 4 0 255 /end AXIS_DESCR /end CHARACTERISTIC
/begin CHARACTERISTIC WDKSLN "вероятная | damos-вероятно | адрес 0x18FCB, данные 0x18FCB | масштаб x0.392157 % DK | Throttle valve angle threshold for idle detection" CURVE 0x18FCB RL_GRID_DU8 0 CM_0p3921568627_0_DK 0 255
 /begin AXIS_DESCR FIX_AXIS NO_INPUT_QUANTITY CM_IDENTITY 6 0 5 FIX_AXIS_PAR_DIST 0 1 6 /end AXIS_DESCR
/end CHARACTERISTIC
/begin CHARACTERISTIC MAP_489_18FD6_4 "вероятная | mapscan | адрес 0x18FD6, данные 0x18FDB" CURVE 0x18FD6 RL_2D_A8_DU8 0 CM_IDENTITY 0 255 /begin AXIS_DESCR STD_AXIS NO_INPUT_QUANTITY CM_IDENTITY 4 0 255 /end AXIS_DESCR /end CHARACTERISTIC
/begin CHARACTERISTIC KFWEE "подтверждена | damos-точно | адрес 0x18FF8, данные 0x18FF8 | масштаб x6 Grad KW | characteristic map angle end of injection" MAP 0x18FF8 RL_GRID_DU8 0 CM_6_0_GradKW 0 255
 /begin AXIS_DESCR FIX_AXIS NO_INPUT_QUANTITY CM_IDENTITY 8 0 7 FIX_AXIS_PAR_DIST 0 1 8 /end AXIS_DESCR
 /begin AXIS_DESCR FIX_AXIS NO_INPUT_QUANTITY CM_IDENTITY 8 0 7 FIX_AXIS_PAR_DIST 0 1 8 /end AXIS_DESCR
/end CHARACTERISTIC
/begin CHARACTERISTIC KFWEEK "подтверждена | damos-точно | адрес 0x19038, данные 0x19038 | масштаб x6 Grad KW | map for end of injection angle (cold parameters)" MAP 0x19038 RL_GRID_DU8 0 CM_6_0_GradKW 0 255
 /begin AXIS_DESCR FIX_AXIS NO_INPUT_QUANTITY CM_IDENTITY 8 0 7 FIX_AXIS_PAR_DIST 0 1 8 /end AXIS_DESCR
 /begin AXIS_DESCR FIX_AXIS NO_INPUT_QUANTITY CM_IDENTITY 8 0 7 FIX_AXIS_PAR_DIST 0 1 8 /end AXIS_DESCR
/end CHARACTERISTIC
/begin CHARACTERISTIC SNM08GKUB "вероятная | damos-вероятно | адрес 0x19078, данные 0x19078 | Datapoint distribution mixture control 8 nmot datapoints" CURVE 0x19078 RL_GRID_DU8 0 CM_IDENTITY 0 255
 /begin AXIS_DESCR FIX_AXIS NO_INPUT_QUANTITY CM_IDENTITY 8 0 7 FIX_AXIS_PAR_DIST 0 1 8 /end AXIS_DESCR
/end CHARACTERISTIC
/begin CHARACTERISTIC MAP_493_19081_8 "вероятная | mapscan | адрес 0x19081, данные 0x1908A" CURVE 0x19081 RL_2D_A8_DU8 0 CM_IDENTITY 0 255 /begin AXIS_DESCR STD_AXIS NO_INPUT_QUANTITY CM_IDENTITY 8 0 255 /end AXIS_DESCR /end CHARACTERISTIC
/begin CHARACTERISTIC WEAN "вероятная | damos-вероятно | адрес 0x19093, данные 0x19093 | масштаб x6 Grad KW | angle injection break off" CURVE 0x19093 RL_GRID_DU8 0 CM_6_0_GradKW 0 255
 /begin AXIS_DESCR FIX_AXIS NO_INPUT_QUANTITY CM_IDENTITY 8 0 7 FIX_AXIS_PAR_DIST 0 1 8 /end AXIS_DESCR
/end CHARACTERISTIC
/begin CHARACTERISTIC WEEM "вероятная | damos-вероятно | адрес 0x1909B, данные 0x1909B | масштаб x6 Grad KW | correction of prestorage angle" CURVE 0x1909B RL_GRID_DU8 0 CM_6_0_GradKW 0 255
 /begin AXIS_DESCR FIX_AXIS NO_INPUT_QUANTITY CM_IDENTITY 8 0 7 FIX_AXIS_PAR_DIST 0 1 8 /end AXIS_DESCR
/end CHARACTERISTIC
/begin CHARACTERISTIC WEEMRFAN "вероятная | damos-вероятно | адрес 0x190A3, данные 0x190A3 | масштаб x6 Grad KW | end of injection angle at max relative driver request" CURVE 0x190A3 RL_GRID_DU8 0 CM_6_0_GradKW 0 255
 /begin AXIS_DESCR FIX_AXIS NO_INPUT_QUANTITY CM_IDENTITY 8 0 7 FIX_AXIS_PAR_DIST 0 1 8 /end AXIS_DESCR
/end CHARACTERISTIC
/begin CHARACTERISTIC WEESTM "вероятная | damos-вероятно | адрес 0x190AB, данные 0x190AB | масштаб x6 Grad KW | correction of pretiming of injection during start" CURVE 0x190AB RL_GRID_DU8 0 CM_6_0_GradKW 0 255
 /begin AXIS_DESCR FIX_AXIS NO_INPUT_QUANTITY CM_IDENTITY 8 0 7 FIX_AXIS_PAR_DIST 0 1 8 /end AXIS_DESCR
/end CHARACTERISTIC
/begin CHARACTERISTIC WEESTN "подтверждена | damos | адрес 0x190B4, данные 0x190B4 | масштаб x6 Grad KW | end of injection angle during start" CURVE 0x190B4 RL_GRID_DU8 0 CM_6_0_GradKW 0 255
 /begin AXIS_DESCR FIX_AXIS NO_INPUT_QUANTITY CM_IDENTITY 4 0 3 FIX_AXIS_PAR_DIST 0 1 4 /end AXIS_DESCR
/end CHARACTERISTIC
/begin CHARACTERISTIC ZZWEETM "вероятная | damos-вероятно | адрес 0x190BD, данные 0x190BD | Switchover threshold pattern angle" CURVE 0x190BD RL_GRID_DU8 0 CM_IDENTITY 0 255
 /begin AXIS_DESCR FIX_AXIS NO_INPUT_QUANTITY CM_IDENTITY 8 0 7 FIX_AXIS_PAR_DIST 0 1 8 /end AXIS_DESCR
/end CHARACTERISTIC
/begin CHARACTERISTIC KFLF "подтверждена | damos | адрес 0x190EC, данные 0x190EC | масштаб x0.0078125 - | lambda characteristic map at part load" MAP 0x190EC RL_GRID_DU8 0 CM_0p0078125_0 0 255
 /begin AXIS_DESCR FIX_AXIS NO_INPUT_QUANTITY CM_IDENTITY 16 0 15 FIX_AXIS_PAR_DIST 0 1 16 /end AXIS_DESCR
 /begin AXIS_DESCR FIX_AXIS NO_INPUT_QUANTITY CM_IDENTITY 12 0 11 FIX_AXIS_PAR_DIST 0 1 12 /end AXIS_DESCR
/end CHARACTERISTIC
/begin CHARACTERISTIC FSTHO "вероятная | damos-вероятно | адрес 0x191AD, данные 0x191AD | масштаб x0.0078125 - | weighting of factor start" CURVE 0x191AD RL_GRID_DU8 0 CM_0p0078125_0 0 255
 /begin AXIS_DESCR FIX_AXIS NO_INPUT_QUANTITY CM_IDENTITY 4 0 3 FIX_AXIS_PAR_DIST 0 1 4 /end AXIS_DESCR
/end CHARACTERISTIC
/begin CHARACTERISTIC FNSA "вероятная | damos-вероятно | адрес 0x191B5, данные 0x191B5 | масштаб x0.0078125 - | after start increase" CURVE 0x191B5 RL_GRID_DU8 0 CM_0p0078125_0 0 255
 /begin AXIS_DESCR FIX_AXIS NO_INPUT_QUANTITY CM_IDENTITY 6 0 5 FIX_AXIS_PAR_DIST 0 1 6 /end AXIS_DESCR
/end CHARACTERISTIC
/begin CHARACTERISTIC FNSHO "вероятная | damos-вероятно | адрес 0x191BC, данные 0x191BC | масштаб x0.0078125 - | weighting of afterstart enrichment" CURVE 0x191BC RL_GRID_DU8 0 CM_0p0078125_0 0 255
 /begin AXIS_DESCR FIX_AXIS NO_INPUT_QUANTITY CM_IDENTITY 4 0 3 FIX_AXIS_PAR_DIST 0 1 4 /end AXIS_DESCR
/end CHARACTERISTIC
/begin CHARACTERISTIC SZANSSM2 "вероятная | damos-вероятно | адрес 0x191D3, данные 0x191D3 | масштаб x0.00390625 - | switching level 2 of afterstart enrichment" CURVE 0x191D3 RL_GRID_DU8 0 CM_0p00390625_0 0 255
 /begin AXIS_DESCR FIX_AXIS NO_INPUT_QUANTITY CM_IDENTITY 12 0 11 FIX_AXIS_PAR_DIST 0 1 12 /end AXIS_DESCR
/end CHARACTERISTIC
/begin CHARACTERISTIC KFFWL "подтверждена | damos-точно | адрес 0x191DF, данные 0x191DF | масштаб x0.0078125 - | map warm-up factor" MAP 0x191DF RL_GRID_DU8 0 CM_0p0078125_0 0 255
 /begin AXIS_DESCR FIX_AXIS NO_INPUT_QUANTITY CM_IDENTITY 12 0 11 FIX_AXIS_PAR_DIST 0 1 12 /end AXIS_DESCR
 /begin AXIS_DESCR FIX_AXIS NO_INPUT_QUANTITY CM_IDENTITY 12 0 11 FIX_AXIS_PAR_DIST 0 1 12 /end AXIS_DESCR
/end CHARACTERISTIC
/begin CHARACTERISTIC KFLASWLR "сомнительная | damos-сомнительно | адрес 0x1926F, данные 0x1926F | масштаб x0.0078125 - | map lambda engine nominal at warming up with active A/F control" MAP 0x1926F RL_GRID_DU8 0 CM_0p0078125_0 0 255
 /begin AXIS_DESCR FIX_AXIS NO_INPUT_QUANTITY CM_IDENTITY 12 0 11 FIX_AXIS_PAR_DIST 0 1 12 /end AXIS_DESCR
 /begin AXIS_DESCR FIX_AXIS NO_INPUT_QUANTITY CM_IDENTITY 12 0 11 FIX_AXIS_PAR_DIST 0 1 12 /end AXIS_DESCR
/end CHARACTERISTIC
/begin CHARACTERISTIC LASWLTM "вероятная | damos-вероятно | адрес 0x192FF, данные 0x192FF | масштаб x0.0078125 - | offset lambda engine nominal with inactive A/F control" CURVE 0x192FF RL_GRID_DS8 0 CM_0p0078125_0 0 127
 /begin AXIS_DESCR FIX_AXIS NO_INPUT_QUANTITY CM_IDENTITY 12 0 11 FIX_AXIS_PAR_DIST 0 1 12 /end AXIS_DESCR
/end CHARACTERISTIC
/begin CHARACTERISTIC FUKNSTM "подтверждена | damos | адрес 0x1930C, данные 0x1930C | масштаб x0.015625 - | initial value of transient control post cranking factor" CURVE 0x1930C RL_GRID_DU8 0 CM_0p015625_0 0 255
 /begin AXIS_DESCR FIX_AXIS NO_INPUT_QUANTITY CM_IDENTITY 9 0 8 FIX_AXIS_PAR_DIST 0 1 9 /end AXIS_DESCR
/end CHARACTERISTIC
/begin CHARACTERISTIC KFABAK "вероятная | damos-вероятно | адрес 0x1931E, данные 0x1931E | масштаб x0.00390625 - | share factor wall wetting for acceleration enrichment" MAP 0x1931E RL_GRID_DU8 0 CM_0p00390625_0 0 255
 /begin AXIS_DESCR FIX_AXIS NO_INPUT_QUANTITY CM_IDENTITY 7 0 6 FIX_AXIS_PAR_DIST 0 1 7 /end AXIS_DESCR
 /begin AXIS_DESCR FIX_AXIS NO_INPUT_QUANTITY CM_IDENTITY 9 0 8 FIX_AXIS_PAR_DIST 0 1 9 /end AXIS_DESCR
/end CHARACTERISTIC
/begin CHARACTERISTIC KFAVAK "вероятная | damos-вероятно | адрес 0x1935D, данные 0x1935D | масштаб x0.00390625 - | share factor wall wetting for deceleration enleanment" MAP 0x1935D RL_GRID_DU8 0 CM_0p00390625_0 0 255
 /begin AXIS_DESCR FIX_AXIS NO_INPUT_QUANTITY CM_IDENTITY 7 0 6 FIX_AXIS_PAR_DIST 0 1 7 /end AXIS_DESCR
 /begin AXIS_DESCR FIX_AXIS NO_INPUT_QUANTITY CM_IDENTITY 9 0 8 FIX_AXIS_PAR_DIST 0 1 9 /end AXIS_DESCR
/end CHARACTERISTIC
/begin CHARACTERISTIC KFBAKL "вероятная | damos-вероятно | адрес 0x1939C, данные 0x1939C | масштаб x0.0625 - | factor accel. enrichment (short- and long-time part)" MAP 0x1939C RL_GRID_DU8 0 CM_0p0625_0 0 255
 /begin AXIS_DESCR FIX_AXIS NO_INPUT_QUANTITY CM_IDENTITY 7 0 6 FIX_AXIS_PAR_DIST 0 1 7 /end AXIS_DESCR
 /begin AXIS_DESCR FIX_AXIS NO_INPUT_QUANTITY CM_IDENTITY 9 0 8 FIX_AXIS_PAR_DIST 0 1 9 /end AXIS_DESCR
/end CHARACTERISTIC
/begin CHARACTERISTIC MAP_512_193E0_9 "вероятная | mapscan | адрес 0x193E0, данные 0x193EA" CURVE 0x193E0 RL_2D_A8_DU8 0 CM_IDENTITY 0 255 /begin AXIS_DESCR STD_AXIS NO_INPUT_QUANTITY CM_IDENTITY 9 0 255 /end AXIS_DESCR /end CHARACTERISTIC
/begin CHARACTERISTIC ZBALM "вероятная | damos-вероятно | адрес 0x1941A, данные 0x1941A | масштаб x0.000488281 - | reduction factor L-memory (tmot) for accel. enrichment" CURVE 0x1941A RL_GRID_DU8 0 CM_0p00048828125_0 0 255
 /begin AXIS_DESCR FIX_AXIS NO_INPUT_QUANTITY CM_IDENTITY 9 0 8 FIX_AXIS_PAR_DIST 0 1 9 /end AXIS_DESCR
/end CHARACTERISTIC
/begin CHARACTERISTIC ZVALM "вероятная | damos-вероятно | адрес 0x19423, данные 0x19423 | масштаб x0.000488281 - | reduction factor L-memory (tmot) for decel. enleanment" CURVE 0x19423 RL_GRID_DU8 0 CM_0p00048828125_0 0 255
 /begin AXIS_DESCR FIX_AXIS NO_INPUT_QUANTITY CM_IDENTITY 9 0 8 FIX_AXIS_PAR_DIST 0 1 9 /end AXIS_DESCR
/end CHARACTERISTIC
/begin CHARACTERISTIC LAMLGMTM "вероятная | damos-вероятно | адрес 0x19434, данные 0x19434 | масштаб x0.0078125 - | lambda limit 'lean'" CURVE 0x19434 RL_GRID_DU8 0 CM_0p0078125_0 0 255
 /begin AXIS_DESCR FIX_AXIS NO_INPUT_QUANTITY CM_IDENTITY 12 0 11 FIX_AXIS_PAR_DIST 0 1 12 /end AXIS_DESCR
/end CHARACTERISTIC
/begin CHARACTERISTIC WDKARN "вероятная | damos-вероятно | адрес 0x19441, данные 0x19441 | масштаб x0.390625 % | threshold throttle angle for activation of the mixture adaptation" CURVE 0x19441 RL_GRID_DU8 0 CM_0p390625_0 0 255
 /begin AXIS_DESCR FIX_AXIS NO_INPUT_QUANTITY CM_IDENTITY 10 0 9 FIX_AXIS_PAR_DIST 0 1 10 /end AXIS_DESCR
/end CHARACTERISTIC
/begin CHARACTERISTIC FMRFAZTE "вероятная | damos-вероятно | адрес 0x19457, данные 0x19457 | масштаб x0.015625 - | weighting of engine speed to calculate current power" CURVE 0x19457 RL_GRID_DU8 0 CM_0p015625_0 0 255
 /begin AXIS_DESCR FIX_AXIS NO_INPUT_QUANTITY CM_IDENTITY 4 0 3 FIX_AXIS_PAR_DIST 0 1 4 /end AXIS_DESCR
/end CHARACTERISTIC
/begin CHARACTERISTIC FBZFRAT "вероятная | damos-вероятно | адрес 0x19464, данные 0x19464 | масштаб x0.00390625 - | weighting factor for integration speed KFFRAT as f(abo)" CURVE 0x19464 RL_GRID_DU8 0 CM_0p00390625_0 0 255
 /begin AXIS_DESCR FIX_AXIS NO_INPUT_QUANTITY CM_IDENTITY 5 0 4 FIX_AXIS_PAR_DIST 0 1 5 /end AXIS_DESCR
/end CHARACTERISTIC
/begin CHARACTERISTIC KFFDLBTS "сомнительная | damos-сомнительно | адрес 0x194A1, данные 0x194A1 | масштаб x0.0078125 - | Factor delta nominal Lambda for component protection" MAP 0x194A1 RL_GRID_DU8 0 CM_0p0078125_0 0 255
 /begin AXIS_DESCR FIX_AXIS NO_INPUT_QUANTITY CM_IDENTITY 16 0 15 FIX_AXIS_PAR_DIST 0 1 16 /end AXIS_DESCR
 /begin AXIS_DESCR FIX_AXIS NO_INPUT_QUANTITY CM_IDENTITY 12 0 11 FIX_AXIS_PAR_DIST 0 1 12 /end AXIS_DESCR
/end CHARACTERISTIC
/begin CHARACTERISTIC KFLBTS "подтверждена | профиль | адрес 0x19636, данные 0x19636 | масштаб x0.0078125  | Целевая лямбда защиты компонентов. Сток обогащает до 0.789 на высокой нагрузке, csok до 0.844, MPower -- 1.000 во всех 192 ячейках, то есть обогащение защиты отключено полностью." MAP 0x19636 RL_GRID_DU8 0 CM_0p0078125_0 0 255
 /begin AXIS_DESCR FIX_AXIS NO_INPUT_QUANTITY CM_IDENTITY 16 0 15 FIX_AXIS_PAR_DIST 0 1 16 /end AXIS_DESCR
 /begin AXIS_DESCR FIX_AXIS NO_INPUT_QUANTITY CM_IDENTITY 12 0 11 FIX_AXIS_PAR_DIST 0 1 12 /end AXIS_DESCR
/end CHARACTERISTIC
/begin CHARACTERISTIC MAP_521_196F8_5 "вероятная | mapscan | адрес 0x196F8, данные 0x196FE" CURVE 0x196F8 RL_2D_A8_DU8 0 CM_IDENTITY 0 255 /begin AXIS_DESCR STD_AXIS NO_INPUT_QUANTITY CM_IDENTITY 5 0 255 /end AXIS_DESCR /end CHARACTERISTIC
/begin CHARACTERISTIC FQTEVA "неоднозначная | damos-сомнительно | адрес 0x19704, данные 0x19704 | масштаб x0.0625 - | progression of purge rate controller" CURVE 0x19704 RL_GRID_DU8 0 CM_0p0625_0 0 255
 /begin AXIS_DESCR FIX_AXIS NO_INPUT_QUANTITY CM_IDENTITY 6 0 5 FIX_AXIS_PAR_DIST 0 1 6 /end AXIS_DESCR
/end CHARACTERISTIC
/begin CHARACTERISTIC MAP_523_19719_8 "вероятная | mapscan | адрес 0x19719, данные 0x19722" CURVE 0x19719 RL_2D_A8_DU8 0 CM_IDENTITY 0 255 /begin AXIS_DESCR STD_AXIS NO_INPUT_QUANTITY CM_IDENTITY 8 0 255 /end AXIS_DESCR /end CHARACTERISTIC
/begin CHARACTERISTIC KFTKONS "подтверждена | damos-точно | адрес 0x1972A, данные 0x1972A | A/C switch-on delay time (morning brake sharpness)" MAP 0x1972A RL_GRID_DU8 0 CM_IDENTITY 0 255
 /begin AXIS_DESCR FIX_AXIS NO_INPUT_QUANTITY CM_IDENTITY 8 0 7 FIX_AXIS_PAR_DIST 0 1 8 /end AXIS_DESCR
 /begin AXIS_DESCR FIX_AXIS NO_INPUT_QUANTITY CM_IDENTITY 8 0 7 FIX_AXIS_PAR_DIST 0 1 8 /end AXIS_DESCR
/end CHARACTERISTIC
/begin CHARACTERISTIC MAP_525_1976E_6 "вероятная | mapscan | адрес 0x1976E, данные 0x19775" CURVE 0x1976E RL_2D_A8_DU8 0 CM_IDENTITY 0 255 /begin AXIS_DESCR STD_AXIS NO_INPUT_QUANTITY CM_IDENTITY 6 0 255 /end AXIS_DESCR /end CHARACTERISTIC
/begin CHARACTERISTIC MAP_526_1977E_5 "вероятная | mapscan | адрес 0x1977E, данные 0x19784" CURVE 0x1977E RL_2D_A8_DU8 0 CM_IDENTITY 0 255 /begin AXIS_DESCR STD_AXIS NO_INPUT_QUANTITY CM_IDENTITY 5 0 255 /end AXIS_DESCR /end CHARACTERISTIC
/begin CHARACTERISTIC MAP_527_1979E_6 "вероятная | mapscan | адрес 0x1979E, данные 0x197A5" CURVE 0x1979E RL_2D_A8_DU8 0 CM_IDENTITY 0 255 /begin AXIS_DESCR STD_AXIS NO_INPUT_QUANTITY CM_IDENTITY 6 0 255 /end AXIS_DESCR /end CHARACTERISTIC
/begin CHARACTERISTIC GRID_528_197BC_10x10 "вероятная | gridscan | адрес 0x197BC, данные 0x197BC" MAP 0x197BC RL_GRID_DU8 0 CM_IDENTITY 0 255
 /begin AXIS_DESCR FIX_AXIS NO_INPUT_QUANTITY CM_IDENTITY 10 0 9 FIX_AXIS_PAR_DIST 0 1 10 /end AXIS_DESCR
 /begin AXIS_DESCR FIX_AXIS NO_INPUT_QUANTITY CM_IDENTITY 10 0 9 FIX_AXIS_PAR_DIST 0 1 10 /end AXIS_DESCR
/end CHARACTERISTIC
/begin CHARACTERISTIC KFFTEAX "подтверждена | damos | адрес 0x1982B, данные 0x1982B | масштаб x0.00195312 - | Characteristic map for limitation of the purge rate" MAP 0x1982B RL_GRID_DU8 0 CM_0p001953125_0 0 255
 /begin AXIS_DESCR FIX_AXIS NO_INPUT_QUANTITY CM_IDENTITY 4 0 3 FIX_AXIS_PAR_DIST 0 1 4 /end AXIS_DESCR
 /begin AXIS_DESCR FIX_AXIS NO_INPUT_QUANTITY CM_IDENTITY 5 0 4 FIX_AXIS_PAR_DIST 0 1 5 /end AXIS_DESCR
/end CHARACTERISTIC
/begin CHARACTERISTIC KFQTE "подтверждена | damos-точно | адрес 0x1983F, данные 0x1983F | масштаб x4.76836e-05 1/s | Map for purge rate increase / decrease" MAP 0x1983F RL_GRID_DU8 0 CM_4p768359375En05_0_1s 0 255
 /begin AXIS_DESCR FIX_AXIS NO_INPUT_QUANTITY CM_IDENTITY 5 0 4 FIX_AXIS_PAR_DIST 0 1 5 /end AXIS_DESCR
 /begin AXIS_DESCR FIX_AXIS NO_INPUT_QUANTITY CM_IDENTITY 6 0 5 FIX_AXIS_PAR_DIST 0 1 6 /end AXIS_DESCR
/end CHARACTERISTIC
/begin CHARACTERISTIC KFTATX "подтверждена | damos | адрес 0x1986F, данные 0x1986F | масштаб x0.390625 % | map for max. duty cycle" MAP 0x1986F RL_GRID_DU8 0 CM_0p390625_0 0 255
 /begin AXIS_DESCR FIX_AXIS NO_INPUT_QUANTITY CM_IDENTITY 6 0 5 FIX_AXIS_PAR_DIST 0 1 6 /end AXIS_DESCR
 /begin AXIS_DESCR FIX_AXIS NO_INPUT_QUANTITY CM_IDENTITY 10 0 9 FIX_AXIS_PAR_DIST 0 1 10 /end AXIS_DESCR
/end CHARACTERISTIC
/begin CHARACTERISTIC ZBTEML "вероятная | damos-вероятно | адрес 0x198AD, данные 0x198AD | масштаб x0.0239258 1/s | integration speed for canister charge adaptation" CURVE 0x198AD RL_GRID_DU8 0 CM_0p02392578125_0_1s 0 255
 /begin AXIS_DESCR FIX_AXIS NO_INPUT_QUANTITY CM_IDENTITY 6 0 5 FIX_AXIS_PAR_DIST 0 1 6 /end AXIS_DESCR
/end CHARACTERISTIC
/begin CHARACTERISTIC MAP_533_198B4_5 "вероятная | mapscan | адрес 0x198B4, данные 0x198BA" CURVE 0x198B4 RL_2D_A8_DU16 0 CM_IDENTITY 0 65535 /begin AXIS_DESCR STD_AXIS NO_INPUT_QUANTITY CM_IDENTITY 5 0 255 /end AXIS_DESCR /end CHARACTERISTIC
/begin CHARACTERISTIC KFTEVP "подтверждена | damos-точно | адрес 0x198C4, данные 0x198C4 | масштаб x0.5 ms | Characteristic map for period time of the PCV" MAP 0x198C4 RL_GRID_DU8 0 CM_0p5_0_ms 0 255
 /begin AXIS_DESCR FIX_AXIS NO_INPUT_QUANTITY CM_IDENTITY 9 0 8 FIX_AXIS_PAR_DIST 0 1 9 /end AXIS_DESCR
 /begin AXIS_DESCR FIX_AXIS NO_INPUT_QUANTITY CM_IDENTITY 5 0 4 FIX_AXIS_PAR_DIST 0 1 5 /end AXIS_DESCR
/end CHARACTERISTIC
/begin CHARACTERISTIC KFTVTEV "подтверждена | damos | адрес 0x198FC, данные 0x198FC | масштаб x0.5 ms | characteristic map for CVP delay time" MAP 0x198FC RL_GRID_DU8 0 CM_0p5_0_ms 0 255
 /begin AXIS_DESCR FIX_AXIS NO_INPUT_QUANTITY CM_IDENTITY 3 0 2 FIX_AXIS_PAR_DIST 0 1 3 /end AXIS_DESCR
 /begin AXIS_DESCR FIX_AXIS NO_INPUT_QUANTITY CM_IDENTITY 6 0 5 FIX_AXIS_PAR_DIST 0 1 6 /end AXIS_DESCR
/end CHARACTERISTIC
/begin CHARACTERISTIC KFDETATE "подтверждена | damos-точно | адрес 0x19923, данные 0x19923 | масштаб x0.5 % | correction of ignition angle effectiveness for diagnosis of PCV" MAP 0x19923 RL_GRID_DU8 0 CM_0p5_0 0 255
 /begin AXIS_DESCR FIX_AXIS NO_INPUT_QUANTITY CM_IDENTITY 6 0 5 FIX_AXIS_PAR_DIST 0 1 6 /end AXIS_DESCR
 /begin AXIS_DESCR FIX_AXIS NO_INPUT_QUANTITY CM_IDENTITY 4 0 3 FIX_AXIS_PAR_DIST 0 1 4 /end AXIS_DESCR
/end CHARACTERISTIC
/begin CHARACTERISTIC MAP_537_19950_14 "вероятная | mapscan | адрес 0x19950, данные 0x1995F" CURVE 0x19950 RL_2D_A8_DU8 0 CM_IDENTITY 0 255 /begin AXIS_DESCR STD_AXIS NO_INPUT_QUANTITY CM_IDENTITY 14 0 255 /end AXIS_DESCR /end CHARACTERISTIC
/begin CHARACTERISTIC KFMDDAGR "подтверждена | damos-точно | адрес 0x199A7, данные 0x199A7 | масштаб x0.390625 % | Map torque reserve at tester demand of EGR-short test" MAP 0x199A7 RL_GRID_DU8 0 CM_0p390625_0 0 255
 /begin AXIS_DESCR FIX_AXIS NO_INPUT_QUANTITY CM_IDENTITY 8 0 7 FIX_AXIS_PAR_DIST 0 1 8 /end AXIS_DESCR
 /begin AXIS_DESCR FIX_AXIS NO_INPUT_QUANTITY CM_IDENTITY 8 0 7 FIX_AXIS_PAR_DIST 0 1 8 /end AXIS_DESCR
/end CHARACTERISTIC
/begin CHARACTERISTIC DTLRTML "вероятная | damos-вероятно | адрес 0x19A1B, данные 0x19A1B | масштаб x0.390625 % | proportion factor to decrease waiting time up to tmot-threshold for closed loop" CURVE 0x19A1B RL_GRID_DU8 0 CM_0p390625_0 0 255
 /begin AXIS_DESCR FIX_AXIS NO_INPUT_QUANTITY CM_IDENTITY 7 0 6 FIX_AXIS_PAR_DIST 0 1 7 /end AXIS_DESCR
/end CHARACTERISTIC
/begin CHARACTERISTIC TMLRTMS "вероятная | damos-вероятно | адрес 0x19A26, данные 0x19A26 | масштаб x0.75 Grad C | engine temp. threshold for lambda control depending on cranking temp. tmst" CURVE 0x19A26 RL_GRID_DS8 0 CM_0p75_48_GradC 0 127
 /begin AXIS_DESCR FIX_AXIS NO_INPUT_QUANTITY CM_IDENTITY 4 0 3 FIX_AXIS_PAR_DIST 0 1 4 /end AXIS_DESCR
/end CHARACTERISTIC
/begin CHARACTERISTIC MAP_541_19A2F_20 "вероятная | mapscan | адрес 0x19A2F, данные 0x19A44" CURVE 0x19A2F RL_2D_A8_DU8 0 CM_IDENTITY 0 255 /begin AXIS_DESCR STD_AXIS NO_INPUT_QUANTITY CM_IDENTITY 20 0 255 /end AXIS_DESCR /end CHARACTERISTIC
/begin CHARACTERISTIC TWLRTMS "вероятная | damos-вероятно | адрес 0x19A5A, данные 0x19A5A | масштаб x20 s | waiting time up to check engine temp. signal exceeding threshold for closed loop" CURVE 0x19A5A RL_GRID_DU8 0 CM_20_0_s 0 255
 /begin AXIS_DESCR FIX_AXIS NO_INPUT_QUANTITY CM_IDENTITY 4 0 3 FIX_AXIS_PAR_DIST 0 1 4 /end AXIS_DESCR
/end CHARACTERISTIC
/begin CHARACTERISTIC MAP_543_19A6B_20 "вероятная | mapscan | адрес 0x19A6B, данные 0x19A80" CURVE 0x19A6B RL_2D_A8_DU8 0 CM_IDENTITY 0 255 /begin AXIS_DESCR STD_AXIS NO_INPUT_QUANTITY CM_IDENTITY 20 0 255 /end AXIS_DESCR /end CHARACTERISTIC
/begin CHARACTERISTIC MAP_544_19AAC_4 "вероятная | mapscan | адрес 0x19AAC, данные 0x19AB1" CURVE 0x19AAC RL_2D_A8_DU8 0 CM_IDENTITY 0 255 /begin AXIS_DESCR STD_AXIS NO_INPUT_QUANTITY CM_IDENTITY 4 0 255 /end AXIS_DESCR /end CHARACTERISTIC
/begin CHARACTERISTIC KFIDTHM "подтверждена | damos-точно | адрес 0x19AB5, данные 0x19AB5 | масштаб x0.0910384 kg | Map value for threshold of integrated air mass for thermostat error detection" MAP 0x19AB5 RL_GRID_DU8 0 CM_0p09103840683_0_kg 0 255
 /begin AXIS_DESCR FIX_AXIS NO_INPUT_QUANTITY CM_IDENTITY 4 0 3 FIX_AXIS_PAR_DIST 0 1 4 /end AXIS_DESCR
 /begin AXIS_DESCR FIX_AXIS NO_INPUT_QUANTITY CM_IDENTITY 4 0 3 FIX_AXIS_PAR_DIST 0 1 4 /end AXIS_DESCR
/end CHARACTERISTIC
/begin CHARACTERISTIC LURKH "вероятная | damos-вероятно | адрес 0x19AD3, данные 0x19AD3 | масштаб x0.0078125 - | dmrkh-depen. engine roughness reference correction value, during cat heating" CURVE 0x19AD3 RL_GRID_DU8 0 CM_0p0078125_0 0 255
 /begin AXIS_DESCR FIX_AXIS NO_INPUT_QUANTITY CM_IDENTITY 4 0 3 FIX_AXIS_PAR_DIST 0 1 4 /end AXIS_DESCR
/end CHARACTERISTIC
/begin CHARACTERISTIC AINTKAN "вероятная | damos-вероятно | адрес 0x19ADB, данные 0x19ADB | number of interval misfire frequency at which ti- cutoff" CURVE 0x19ADB RL_GRID_DU8 0 CM_IDENTITY 0 255
 /begin AXIS_DESCR FIX_AXIS NO_INPUT_QUANTITY CM_IDENTITY 8 0 7 FIX_AXIS_PAR_DIST 0 1 8 /end AXIS_DESCR
/end CHARACTERISTIC
/begin CHARACTERISTIC SLX06TMUW "вероятная | damos-вероятно | адрес 0x19BE6, данные 0x19BE6 | lamsbg dependet basic point (number 6)" CURVE 0x19BE6 RL_GRID_DU8 0 CM_IDENTITY 0 255
 /begin AXIS_DESCR FIX_AXIS NO_INPUT_QUANTITY CM_IDENTITY 6 0 5 FIX_AXIS_PAR_DIST 0 1 6 /end AXIS_DESCR
/end CHARACTERISTIC
/begin CHARACTERISTIC SML07TMUW "вероятная | damos-вероятно | адрес 0x19BF4, данные 0x19BF4 | ml dependet basic point (number 7)" CURVE 0x19BF4 RL_GRID_DU8 0 CM_IDENTITY 0 255
 /begin AXIS_DESCR FIX_AXIS NO_INPUT_QUANTITY CM_IDENTITY 7 0 6 FIX_AXIS_PAR_DIST 0 1 7 /end AXIS_DESCR
/end CHARACTERISTIC
/begin CHARACTERISTIC SRL04DYUB "вероятная | damos-вероятно | адрес 0x19C04, данные 0x19C04 | basepoint distribution of rl, 4 basepoints" CURVE 0x19C04 RL_GRID_DU8 0 CM_IDENTITY 0 255
 /begin AXIS_DESCR FIX_AXIS NO_INPUT_QUANTITY CM_IDENTITY 4 0 3 FIX_AXIS_PAR_DIST 0 1 4 /end AXIS_DESCR
/end CHARACTERISTIC
/begin CHARACTERISTIC KFDMDARO "подтверждена | damos-точно | адрес 0x1A54E, данные 0x1A54E | масштаб x0.00305176 % | Upper threshold for torque intervension" MAP 0x1A54E RL_GRID_DS8 0 CM_0p003051757812_0 0 127
 /begin AXIS_DESCR FIX_AXIS NO_INPUT_QUANTITY CM_IDENTITY 6 0 5 FIX_AXIS_PAR_DIST 0 1 6 /end AXIS_DESCR
 /begin AXIS_DESCR FIX_AXIS NO_INPUT_QUANTITY CM_IDENTITY 8 0 7 FIX_AXIS_PAR_DIST 0 1 8 /end AXIS_DESCR
/end CHARACTERISTIC
/begin CHARACTERISTIC KFDMDARU "подтверждена | damos-точно | адрес 0x1A5C6, данные 0x1A5C6 | масштаб x0.00305176 % | Lower threshold for torque intervension" MAP 0x1A5C6 RL_GRID_DS8 0 CM_0p003051757812_0 0 127
 /begin AXIS_DESCR FIX_AXIS NO_INPUT_QUANTITY CM_IDENTITY 6 0 5 FIX_AXIS_PAR_DIST 0 1 6 /end AXIS_DESCR
 /begin AXIS_DESCR FIX_AXIS NO_INPUT_QUANTITY CM_IDENTITY 8 0 7 FIX_AXIS_PAR_DIST 0 1 8 /end AXIS_DESCR
/end CHARACTERISTIC
/begin CHARACTERISTIC KIFZGAG "вероятная | damos-вероятно | адрес 0x1A62E, данные 0x1A62E | масштаб x0.0742188 - | amplification of vehicle model integrator at AT" CURVE 0x1A62E RL_GRID_DU16 0 CM_0p07421875_0 0 65535
 /begin AXIS_DESCR FIX_AXIS NO_INPUT_QUANTITY CM_IDENTITY 6 0 5 FIX_AXIS_PAR_DIST 0 1 6 /end AXIS_DESCR
/end CHARACTERISTIC
/begin CHARACTERISTIC KIFZGAWG "вероятная | damos-вероятно | адрес 0x1A63A, данные 0x1A63A | масштаб x0.0742188 - | amplification of vehicle model integrator at AT" CURVE 0x1A63A RL_GRID_DU16 0 CM_0p07421875_0 0 65535
 /begin AXIS_DESCR FIX_AXIS NO_INPUT_QUANTITY CM_IDENTITY 6 0 5 FIX_AXIS_PAR_DIST 0 1 6 /end AXIS_DESCR
/end CHARACTERISTIC
/begin CHARACTERISTIC KIFZGHG "вероятная | damos-вероятно | адрес 0x1A646, данные 0x1A646 | масштаб x0.0742188 - | amplification of vehicle model integrator at AT" CURVE 0x1A646 RL_GRID_DU16 0 CM_0p07421875_0 0 65535
 /begin AXIS_DESCR FIX_AXIS NO_INPUT_QUANTITY CM_IDENTITY 6 0 5 FIX_AXIS_PAR_DIST 0 1 6 /end AXIS_DESCR
/end CHARACTERISTIC
/begin CHARACTERISTIC MKLWON "вероятная | damos-вероятно | адрес 0x1A652, данные 0x1A652 | масштаб x0.00305176 % | upper clutch torque threshold for antijerking function" CURVE 0x1A652 RL_GRID_DS8 0 CM_0p003051757812_0 0 127
 /begin AXIS_DESCR FIX_AXIS NO_INPUT_QUANTITY CM_IDENTITY 6 0 5 FIX_AXIS_PAR_DIST 0 1 6 /end AXIS_DESCR
/end CHARACTERISTIC
/begin CHARACTERISTIC MKLWOWKN "вероятная | damos-вероятно | адрес 0x1A65E, данные 0x1A65E | масштаб x0.00305176 % | upper clutch torque threshold for antijerking on an openned lockup clutch" CURVE 0x1A65E RL_GRID_DS8 0 CM_0p003051757812_0 0 127
 /begin AXIS_DESCR FIX_AXIS NO_INPUT_QUANTITY CM_IDENTITY 6 0 5 FIX_AXIS_PAR_DIST 0 1 6 /end AXIS_DESCR
/end CHARACTERISTIC
/begin CHARACTERISTIC MKLWSAN "вероятная | damos-вероятно | адрес 0x1A66A, данные 0x1A66A | масштаб x0.00305176 % | lower clutch torque threshold for antijerking on fuell cutoff restart" CURVE 0x1A66A RL_GRID_DS8 0 CM_0p003051757812_0 0 127
 /begin AXIS_DESCR FIX_AXIS NO_INPUT_QUANTITY CM_IDENTITY 6 0 5 FIX_AXIS_PAR_DIST 0 1 6 /end AXIS_DESCR
/end CHARACTERISTIC
/begin CHARACTERISTIC MKLWUN "вероятная | damos-вероятно | адрес 0x1A676, данные 0x1A676 | масштаб x0.00305176 % | lower clutch torque threshold for antijerking" CURVE 0x1A676 RL_GRID_DS8 0 CM_0p003051757812_0 0 127
 /begin AXIS_DESCR FIX_AXIS NO_INPUT_QUANTITY CM_IDENTITY 6 0 5 FIX_AXIS_PAR_DIST 0 1 6 /end AXIS_DESCR
/end CHARACTERISTIC
/begin CHARACTERISTIC MKLWUWKN "вероятная | damos-вероятно | адрес 0x1A682, данные 0x1A682 | масштаб x0.00305176 % | lower clutch torque threshold for antijerking on an openned lockup clutch" CURVE 0x1A682 RL_GRID_DS8 0 CM_0p003051757812_0 0 127
 /begin AXIS_DESCR FIX_AXIS NO_INPUT_QUANTITY CM_IDENTITY 6 0 5 FIX_AXIS_PAR_DIST 0 1 6 /end AXIS_DESCR
/end CHARACTERISTIC
/begin CHARACTERISTIC MAP_561_1A692_12 "вероятная | mapscan | адрес 0x1A692, данные 0x1A69F" CURVE 0x1A692 RL_2D_A8_DU16 0 CM_IDENTITY 0 65535 /begin AXIS_DESCR STD_AXIS NO_INPUT_QUANTITY CM_IDENTITY 12 0 255 /end AXIS_DESCR /end CHARACTERISTIC
/begin CHARACTERISTIC KFDZWKG "подтверждена | damos-точно | адрес 0x1A6BB, данные 0x1A6BB | масштаб x0.75 grad KW | ignition angle correction due to knock limit shift" MAP 0x1A6BB RL_GRID_DS8 0 CM_0p75_0_gradKW 0 127
 /begin AXIS_DESCR FIX_AXIS NO_INPUT_QUANTITY CM_IDENTITY 5 0 4 FIX_AXIS_PAR_DIST 0 1 5 /end AXIS_DESCR
 /begin AXIS_DESCR FIX_AXIS NO_INPUT_QUANTITY CM_IDENTITY 8 0 7 FIX_AXIS_PAR_DIST 0 1 8 /end AXIS_DESCR
/end CHARACTERISTIC
/begin CHARACTERISTIC KFZWNWSUE "подтверждена | damos | адрес 0x1A700, данные 0x1A700 | масштаб x0.75 grad KW | Delta ignition angle dependent on the camshaft overlap" MAP 0x1A700 RL_GRID_DS8 0 CM_0p75_0_gradKW 0 127
 /begin AXIS_DESCR FIX_AXIS NO_INPUT_QUANTITY CM_IDENTITY 16 0 15 FIX_AXIS_PAR_DIST 0 1 16 /end AXIS_DESCR
 /begin AXIS_DESCR FIX_AXIS NO_INPUT_QUANTITY CM_IDENTITY 10 0 9 FIX_AXIS_PAR_DIST 0 1 10 /end AXIS_DESCR
/end CHARACTERISTIC
/begin CHARACTERISTIC KFZWWLTM "подтверждена | damos-точно | адрес 0x1A7BA, данные 0x1A7BA | масштаб x0.75 grad KW | Delta ignition sparc advance during engine warm up phase" MAP 0x1A7BA RL_GRID_DS8 0 CM_0p75_0_gradKW 0 127
 /begin AXIS_DESCR FIX_AXIS NO_INPUT_QUANTITY CM_IDENTITY 12 0 11 FIX_AXIS_PAR_DIST 0 1 12 /end AXIS_DESCR
 /begin AXIS_DESCR FIX_AXIS NO_INPUT_QUANTITY CM_IDENTITY 12 0 11 FIX_AXIS_PAR_DIST 0 1 12 /end AXIS_DESCR
/end CHARACTERISTIC
/begin CHARACTERISTIC MAP_565_1A84A_6 "вероятная | mapscan | адрес 0x1A84A, данные 0x1A851" CURVE 0x1A84A RL_2D_A8_DU16 0 CM_IDENTITY 0 65535 /begin AXIS_DESCR STD_AXIS NO_INPUT_QUANTITY CM_IDENTITY 6 0 255 /end AXIS_DESCR /end CHARACTERISTIC
/begin CHARACTERISTIC MAP_566_1A88A_6 "вероятная | mapscan | адрес 0x1A88A, данные 0x1A891" CURVE 0x1A88A RL_2D_A8_DU16 0 CM_IDENTITY 0 65535 /begin AXIS_DESCR STD_AXIS NO_INPUT_QUANTITY CM_IDENTITY 6 0 255 /end AXIS_DESCR /end CHARACTERISTIC
/begin CHARACTERISTIC KFPSDMX "подтверждена | damos-точно | адрес 0x1A8F7, данные 0x1A8F7 | масштаб x0.0390625 hPa | pressure threshold for B_nplm failure (check DS-S)" MAP 0x1A8F7 RL_GRID_DU8 0 CM_0p0390625_0_hPa 0 255
 /begin AXIS_DESCR FIX_AXIS NO_INPUT_QUANTITY CM_IDENTITY 8 0 7 FIX_AXIS_PAR_DIST 0 1 8 /end AXIS_DESCR
 /begin AXIS_DESCR FIX_AXIS NO_INPUT_QUANTITY CM_IDENTITY 8 0 7 FIX_AXIS_PAR_DIST 0 1 8 /end AXIS_DESCR
/end CHARACTERISTIC
/begin CHARACTERISTIC MAP_568_1A945_4 "вероятная | mapscan | адрес 0x1A945, данные 0x1A94E" CURVE 0x1A945 RL_2D_A16_DU16 0 CM_IDENTITY 0 65535 /begin AXIS_DESCR STD_AXIS NO_INPUT_QUANTITY CM_IDENTITY 4 0 65535 /end AXIS_DESCR /end CHARACTERISTIC
/begin CHARACTERISTIC MAP_569_1A965_4 "вероятная | mapscan | адрес 0x1A965, данные 0x1A96E" CURVE 0x1A965 RL_2D_A16_DU16 0 CM_IDENTITY 0 65535 /begin AXIS_DESCR STD_AXIS NO_INPUT_QUANTITY CM_IDENTITY 4 0 65535 /end AXIS_DESCR /end CHARACTERISTIC
/begin CHARACTERISTIC FPVMXN "вероятная | damos-вероятно | адрес 0x1A986, данные 0x1A986 | масштаб x3.05176e-05 - | factor for pressure ratio maximum" CURVE 0x1A986 RL_GRID_DU16 0 CM_3p051757812En05_0 0 65535
 /begin AXIS_DESCR FIX_AXIS NO_INPUT_QUANTITY CM_IDENTITY 6 0 5 FIX_AXIS_PAR_DIST 0 1 6 /end AXIS_DESCR
/end CHARACTERISTIC
/begin CHARACTERISTIC FPVMXN2 "подтверждена | damos | адрес 0x1A9A0, данные 0x1A9A0 | масштаб x3.05176e-05 - | factor for pressure ratio maximum with secondary last sensor" CURVE 0x1A9A0 RL_GRID_DU16 0 CM_3p051757812En05_0 0 65535
 /begin AXIS_DESCR FIX_AXIS NO_INPUT_QUANTITY CM_IDENTITY 6 0 5 FIX_AXIS_PAR_DIST 0 1 6 /end AXIS_DESCR
/end CHARACTERISTIC
/begin CHARACTERISTIC MAP_572_1AA3A_4 "вероятная | mapscan | адрес 0x1AA3A, данные 0x1AA3F" CURVE 0x1AA3A RL_2D_A8_DU16 0 CM_IDENTITY 0 65535 /begin AXIS_DESCR STD_AXIS NO_INPUT_QUANTITY CM_IDENTITY 4 0 255 /end AXIS_DESCR /end CHARACTERISTIC
/begin CHARACTERISTIC MAP_573_1AB22_4 "вероятная | mapscan | адрес 0x1AB22, данные 0x1AB27" CURVE 0x1AB22 RL_2D_A8_DU16 0 CM_IDENTITY 0 65535 /begin AXIS_DESCR STD_AXIS NO_INPUT_QUANTITY CM_IDENTITY 4 0 255 /end AXIS_DESCR /end CHARACTERISTIC
/begin CHARACTERISTIC MAP_574_1AC8F_6 "вероятная | mapscan | адрес 0x1AC8F, данные 0x1AC9C" CURVE 0x1AC8F RL_2D_A16_DU16 0 CM_IDENTITY 0 65535 /begin AXIS_DESCR STD_AXIS NO_INPUT_QUANTITY CM_IDENTITY 6 0 65535 /end AXIS_DESCR /end CHARACTERISTIC
/begin CHARACTERISTIC MAP_575_1ADDB_5 "вероятная | mapscan | адрес 0x1ADDB, данные 0x1ADE6" CURVE 0x1ADDB RL_2D_A16_DU16 0 CM_IDENTITY 0 65535 /begin AXIS_DESCR STD_AXIS NO_INPUT_QUANTITY CM_IDENTITY 5 0 65535 /end AXIS_DESCR /end CHARACTERISTIC
/begin CHARACTERISTIC MAP_576_1AEC3_6 "вероятная | mapscan | адрес 0x1AEC3, данные 0x1AECA" CURVE 0x1AEC3 RL_2D_A8_DU8 0 CM_IDENTITY 0 255 /begin AXIS_DESCR STD_AXIS NO_INPUT_QUANTITY CM_IDENTITY 6 0 255 /end AXIS_DESCR /end CHARACTERISTIC
/begin CHARACTERISTIC MAP_577_1AF14_6 "вероятная | mapscan | адрес 0x1AF14, данные 0x1AF21" CURVE 0x1AF14 RL_2D_A16_DU16 0 CM_IDENTITY 0 65535 /begin AXIS_DESCR STD_AXIS NO_INPUT_QUANTITY CM_IDENTITY 6 0 65535 /end AXIS_DESCR /end CHARACTERISTIC
/begin CHARACTERISTIC MAP_578_1B0C2_5 "вероятная | mapscan | адрес 0x1B0C2, данные 0x1B0C8" CURVE 0x1B0C2 RL_2D_A8_DU16 0 CM_IDENTITY 0 65535 /begin AXIS_DESCR STD_AXIS NO_INPUT_QUANTITY CM_IDENTITY 5 0 255 /end AXIS_DESCR /end CHARACTERISTIC
/begin CHARACTERISTIC KFURL3SU "вероятная | damos-вероятно | адрес 0x1B0E9, данные 0x1B0E9 | масштаб x4.57764e-06 %/hPa | conversion factor from ps->rl dependent on camshaft adjustment sumode=3" MAP 0x1B0E9 RL_GRID_DU16 0 CM_4p577636719En06_0_hPa 0 65535
 /begin AXIS_DESCR FIX_AXIS NO_INPUT_QUANTITY CM_IDENTITY 14 0 13 FIX_AXIS_PAR_DIST 0 1 14 /end AXIS_DESCR
 /begin AXIS_DESCR FIX_AXIS NO_INPUT_QUANTITY CM_IDENTITY 10 0 9 FIX_AXIS_PAR_DIST 0 1 10 /end AXIS_DESCR
/end CHARACTERISTIC
/begin CHARACTERISTIC KFURLSU "вероятная | damos-вероятно | адрес 0x1B229, данные 0x1B229 | масштаб x4.57764e-06 %/hPa | conversion factor from ps->rl dependent on camshaft adjustment sumode=1" MAP 0x1B229 RL_GRID_DU16 0 CM_4p577636719En06_0_hPa 0 65535
 /begin AXIS_DESCR FIX_AXIS NO_INPUT_QUANTITY CM_IDENTITY 14 0 13 FIX_AXIS_PAR_DIST 0 1 14 /end AXIS_DESCR
 /begin AXIS_DESCR FIX_AXIS NO_INPUT_QUANTITY CM_IDENTITY 10 0 9 FIX_AXIS_PAR_DIST 0 1 10 /end AXIS_DESCR
/end CHARACTERISTIC
/begin CHARACTERISTIC DEVTMAGR "вероятная | damos-вероятно | адрес 0x1B352, данные 0x1B352 | масштаб x0.75 Grad C | offset for evtmod depending on tsges_w at high tans caused by EGR" CURVE 0x1B352 RL_GRID_DS8 0 CM_0p75_0_GradC 0 127
 /begin AXIS_DESCR FIX_AXIS NO_INPUT_QUANTITY CM_IDENTITY 8 0 7 FIX_AXIS_PAR_DIST 0 1 8 /end AXIS_DESCR
/end CHARACTERISTIC
/begin CHARACTERISTIC DPUPVDK "вероятная | damos-вероятно | адрес 0x1B378, данные 0x1B378 | масштаб x0.0390625 hPa | pressure difference pu-pvdk" CURVE 0x1B378 RL_GRID_DU8 0 CM_0p0390625_0_hPa 0 255
 /begin AXIS_DESCR FIX_AXIS NO_INPUT_QUANTITY CM_IDENTITY 8 0 7 FIX_AXIS_PAR_DIST 0 1 8 /end AXIS_DESCR
/end CHARACTERISTIC
/begin CHARACTERISTIC FKDISA "вероятная | damos-вероятно | адрес 0x1B39A, данные 0x1B39A | масштаб x6.10352e-05 - | faktor difference for integrator ambient pressure during fuel cut off" CURVE 0x1B39A RL_GRID_DU16 0 CM_6p103515625En05_0 0 65535
 /begin AXIS_DESCR FIX_AXIS NO_INPUT_QUANTITY CM_IDENTITY 8 0 7 FIX_AXIS_PAR_DIST 0 1 8 /end AXIS_DESCR
/end CHARACTERISTIC
/begin CHARACTERISTIC KFRLW "подтверждена | damos-точно | адрес 0x1B3F3, данные 0x1B3F3 | масштаб x0.0234375 % | rlw-map from throttle valve angle" MAP 0x1B3F3 RL_GRID_DU8 0 CM_0p0234375_0 0 255
 /begin AXIS_DESCR FIX_AXIS NO_INPUT_QUANTITY CM_IDENTITY 12 0 11 FIX_AXIS_PAR_DIST 0 1 12 /end AXIS_DESCR
 /begin AXIS_DESCR FIX_AXIS NO_INPUT_QUANTITY CM_IDENTITY 12 0 11 FIX_AXIS_PAR_DIST 0 1 12 /end AXIS_DESCR
/end CHARACTERISTIC
/begin CHARACTERISTIC MAP_585_1B497_8 "вероятная | mapscan | адрес 0x1B497, данные 0x1B4A8" CURVE 0x1B497 RL_2D_A16_DU8 0 CM_IDENTITY 0 255 /begin AXIS_DESCR STD_AXIS NO_INPUT_QUANTITY CM_IDENTITY 8 0 65535 /end AXIS_DESCR /end CHARACTERISTIC
/begin CHARACTERISTIC KFZKPUA "подтверждена | damos-точно | адрес 0x1B53F, данные 0x1B53F | time constant for ambient pressure" MAP 0x1B53F RL_GRID_DU8 0 CM_IDENTITY 0 255
 /begin AXIS_DESCR FIX_AXIS NO_INPUT_QUANTITY CM_IDENTITY 8 0 7 FIX_AXIS_PAR_DIST 0 1 8 /end AXIS_DESCR
 /begin AXIS_DESCR FIX_AXIS NO_INPUT_QUANTITY CM_IDENTITY 12 0 11 FIX_AXIS_PAR_DIST 0 1 12 /end AXIS_DESCR
/end CHARACTERISTIC
/begin CHARACTERISTIC MAP_587_1B5E1_6 "вероятная | mapscan | адрес 0x1B5E1, данные 0x1B5E8" CURVE 0x1B5E1 RL_2D_A8_DU16 0 CM_IDENTITY 0 65535 /begin AXIS_DESCR STD_AXIS NO_INPUT_QUANTITY CM_IDENTITY 6 0 255 /end AXIS_DESCR /end CHARACTERISTIC
/begin CHARACTERISTIC MAP_588_1B612_5 "вероятная | mapscan | адрес 0x1B612, данные 0x1B618" CURVE 0x1B612 RL_2D_A8_DU16 0 CM_IDENTITY 0 65535 /begin AXIS_DESCR STD_AXIS NO_INPUT_QUANTITY CM_IDENTITY 5 0 255 /end AXIS_DESCR /end CHARACTERISTIC
/begin CHARACTERISTIC PAGAVML "вероятная | damos-вероятно | адрес 0x1B640, данные 0x1B640 | масштаб x0.0390625 hPa | exhaust gas pressure at outlet valve" CURVE 0x1B640 RL_GRID_DU8 0 CM_0p0390625_0_hPa 0 255
 /begin AXIS_DESCR FIX_AXIS NO_INPUT_QUANTITY CM_IDENTITY 6 0 5 FIX_AXIS_PAR_DIST 0 1 6 /end AXIS_DESCR
/end CHARACTERISTIC
/begin CHARACTERISTIC NMOTNGAS "вероятная | damos-вероятно | адрес 0x1B660, данные 0x1B660 | масштаб x0.0078125 - | Engine speed correction factor dependend on rpm gradient" CURVE 0x1B660 RL_GRID_DU8 0 CM_0p0078125_0 0 255
 /begin AXIS_DESCR FIX_AXIS NO_INPUT_QUANTITY CM_IDENTITY 6 0 5 FIX_AXIS_PAR_DIST 0 1 6 /end AXIS_DESCR
/end CHARACTERISTIC
/begin CHARACTERISTIC ATMTANS "подтверждена | damos | адрес 0x1B67A, данные 0x1B67A | масштаб x5 Grad C | temperature correction of the exhaust model temperature" CURVE 0x1B67A RL_GRID_DS8 0 CM_5_0_GradC 0 127
 /begin AXIS_DESCR FIX_AXIS NO_INPUT_QUANTITY CM_IDENTITY 3 0 2 FIX_AXIS_PAR_DIST 0 1 3 /end AXIS_DESCR
/end CHARACTERISTIC
/begin CHARACTERISTIC KFWMABG "вероятная | damos-вероятно | адрес 0x1B681, данные 0x1B681 | масштаб x0.0566415 kJ | map for heat-quantity threshold dew-point end upstream bank1" MAP 0x1B681 RL_GRID_DU16 0 CM_0p05664148928_0_kJ 0 65535
 /begin AXIS_DESCR FIX_AXIS NO_INPUT_QUANTITY CM_IDENTITY 5 0 4 FIX_AXIS_PAR_DIST 0 1 5 /end AXIS_DESCR
 /begin AXIS_DESCR FIX_AXIS NO_INPUT_QUANTITY CM_IDENTITY 7 0 6 FIX_AXIS_PAR_DIST 0 1 7 /end AXIS_DESCR
/end CHARACTERISTIC
/begin CHARACTERISTIC KFWMKAT "вероятная | damos-вероятно | адрес 0x1B6C7, данные 0x1B6C7 | масштаб x0.0566415 kJ | map for heat quantity threshold dew-point end downstream" MAP 0x1B6C7 RL_GRID_DU16 0 CM_0p05664148928_0_kJ 0 65535
 /begin AXIS_DESCR FIX_AXIS NO_INPUT_QUANTITY CM_IDENTITY 5 0 4 FIX_AXIS_PAR_DIST 0 1 5 /end AXIS_DESCR
 /begin AXIS_DESCR FIX_AXIS NO_INPUT_QUANTITY CM_IDENTITY 7 0 6 FIX_AXIS_PAR_DIST 0 1 7 /end AXIS_DESCR
/end CHARACTERISTIC
/begin CHARACTERISTIC STS06TMUW "вероятная | damos-вероятно | адрес 0x1B70D, данные 0x1B70D | tabstatm dependet basic point (number 6)" CURVE 0x1B70D RL_GRID_DU8 0 CM_IDENTITY 0 255
 /begin AXIS_DESCR FIX_AXIS NO_INPUT_QUANTITY CM_IDENTITY 6 0 5 FIX_AXIS_PAR_DIST 0 1 6 /end AXIS_DESCR
/end CHARACTERISTIC
/begin CHARACTERISTIC ZATMAML "вероятная | damos-вероятно | адрес 0x1B71D, данные 0x1B71D | time constant for exhaust gas temperature model" CURVE 0x1B71D RL_GRID_DU8 0 CM_IDENTITY 0 255
 /begin AXIS_DESCR FIX_AXIS NO_INPUT_QUANTITY CM_IDENTITY 7 0 6 FIX_AXIS_PAR_DIST 0 1 7 /end AXIS_DESCR
/end CHARACTERISTIC
/begin CHARACTERISTIC ZATMKML "вероятная | damos-вероятно | адрес 0x1B72B, данные 0x1B72B | time constant for catalyst temperature model tkatm" CURVE 0x1B72B RL_GRID_DU8 0 CM_IDENTITY 0 255
 /begin AXIS_DESCR FIX_AXIS NO_INPUT_QUANTITY CM_IDENTITY 7 0 6 FIX_AXIS_PAR_DIST 0 1 7 /end AXIS_DESCR
/end CHARACTERISTIC
/begin CHARACTERISTIC ZATMRML "вероятная | damos-вероятно | адрес 0x1B739, данные 0x1B739 | time constant for exhaust model temperature - pipe temperature" CURVE 0x1B739 RL_GRID_DU8 0 CM_IDENTITY 0 255
 /begin AXIS_DESCR FIX_AXIS NO_INPUT_QUANTITY CM_IDENTITY 7 0 6 FIX_AXIS_PAR_DIST 0 1 7 /end AXIS_DESCR
/end CHARACTERISTIC
/begin CHARACTERISTIC THSHKTK "вероятная | damos-вероятно | адрес 0x1B807, данные 0x1B807 | масштаб x3.9062e-05 s | Line for switch off time of lambda sensor heating post cat dep. on temp" CURVE 0x1B807 RL_GRID_DS8 0 CM_3p9062En05_0p05_s 0 127
 /begin AXIS_DESCR FIX_AXIS NO_INPUT_QUANTITY CM_IDENTITY 8 0 7 FIX_AXIS_PAR_DIST 0 1 8 /end AXIS_DESCR
/end CHARACTERISTIC
/begin CHARACTERISTIC THSVKTA "вероятная | damos-вероятно | адрес 0x1B829, данные 0x1B829 | масштаб x3.9062e-05 s | Line of switching off time for lambda sensor heating depending on exh.gas temp" CURVE 0x1B829 RL_GRID_DS8 0 CM_3p9062En05_0p05_s 0 127
 /begin AXIS_DESCR FIX_AXIS NO_INPUT_QUANTITY CM_IDENTITY 8 0 7 FIX_AXIS_PAR_DIST 0 1 8 /end AXIS_DESCR
/end CHARACTERISTIC
/begin CHARACTERISTIC KFFRMIN "вероятная | damos-вероятно | адрес 0x1B85E, данные 0x1B85E | масштаб x3.05176e-05 - | lower limit of control range" MAP 0x1B85E RL_GRID_DU16 0 CM_3p051757812En05_0 0 65535
 /begin AXIS_DESCR FIX_AXIS NO_INPUT_QUANTITY CM_IDENTITY 5 0 4 FIX_AXIS_PAR_DIST 0 1 5 /end AXIS_DESCR
 /begin AXIS_DESCR FIX_AXIS NO_INPUT_QUANTITY CM_IDENTITY 5 0 4 FIX_AXIS_PAR_DIST 0 1 5 /end AXIS_DESCR
/end CHARACTERISTIC
/begin CHARACTERISTIC KDLASHKI "неоднозначная | damos-сомнительно | адрес 0x1B899, данные 0x1B899 | масштаб x3.05176e-05 - | evaluation factor of I-part of LRHK, f(dlashkm)" CURVE 0x1B899 RL_GRID_DS16 0 CM_3p051757812En05_0 0 32767
 /begin AXIS_DESCR FIX_AXIS NO_INPUT_QUANTITY CM_IDENTITY 10 0 9 FIX_AXIS_PAR_DIST 0 1 10 /end AXIS_DESCR
/end CHARACTERISTIC
/begin CHARACTERISTIC MAP_602_1B8C0_5 "вероятная | mapscan | адрес 0x1B8C0, данные 0x1B8C6" CURVE 0x1B8C0 RL_2D_A8_DU8 0 CM_IDENTITY 0 255 /begin AXIS_DESCR STD_AXIS NO_INPUT_QUANTITY CM_IDENTITY 5 0 255 /end AXIS_DESCR /end CHARACTERISTIC
/begin CHARACTERISTIC MAP_603_1B91F_5 "вероятная | mapscan | адрес 0x1B91F, данные 0x1B925" CURVE 0x1B91F RL_2D_A8_DU8 0 CM_IDENTITY 0 255 /begin AXIS_DESCR STD_AXIS NO_INPUT_QUANTITY CM_IDENTITY 5 0 255 /end AXIS_DESCR /end CHARACTERISTIC
/begin CHARACTERISTIC LAMKAML "вероятная | damos-вероятно | адрес 0x1B939, данные 0x1B939 | масштаб x0.000244141 - | lambda setpoint for catylyst deoxidation (dependent on air mass)" CURVE 0x1B939 RL_GRID_DU16 0 CM_0p000244140625_0 0 65535
 /begin AXIS_DESCR FIX_AXIS NO_INPUT_QUANTITY CM_IDENTITY 5 0 4 FIX_AXIS_PAR_DIST 0 1 5 /end AXIS_DESCR
/end CHARACTERISTIC
/begin CHARACTERISTIC LAMKAML2 "вероятная | damos-вероятно | адрес 0x1B943, данные 0x1B943 | масштаб x0.000244141 - | lambdasetpoint for catalyst deoxidation (air mass dependent), bank 2" CURVE 0x1B943 RL_GRID_DU16 0 CM_0p000244140625_0 0 65535
 /begin AXIS_DESCR FIX_AXIS NO_INPUT_QUANTITY CM_IDENTITY 5 0 4 FIX_AXIS_PAR_DIST 0 1 5 /end AXIS_DESCR
/end CHARACTERISTIC
/begin CHARACTERISTIC FKHLA "подтверждена | damos | адрес 0x1B950, данные 0x1B950 | масштаб x1.52588e-05 - | Weighting factor  Lambda nominal for catalyzer heating" CURVE 0x1B950 RL_GRID_DU16 0 CM_1p525878906En05_0 0 65535
 /begin AXIS_DESCR FIX_AXIS NO_INPUT_QUANTITY CM_IDENTITY 8 0 7 FIX_AXIS_PAR_DIST 0 1 8 /end AXIS_DESCR
/end CHARACTERISTIC
/begin CHARACTERISTIC FKHMD "подтверждена | damos | адрес 0x1B96C, данные 0x1B96C | масштаб x1.52588e-05 - | Weighting factor torque reserve for catalyzer heating" CURVE 0x1B96C RL_GRID_DU16 0 CM_1p525878906En05_0 0 65535
 /begin AXIS_DESCR FIX_AXIS NO_INPUT_QUANTITY CM_IDENTITY 8 0 7 FIX_AXIS_PAR_DIST 0 1 8 /end AXIS_DESCR
/end CHARACTERISTIC
/begin CHARACTERISTIC MAP_608_1B9EC_4 "вероятная | mapscan | адрес 0x1B9EC, данные 0x1B9F1" CURVE 0x1B9EC RL_2D_A8_DU8 0 CM_IDENTITY 0 255 /begin AXIS_DESCR STD_AXIS NO_INPUT_QUANTITY CM_IDENTITY 4 0 255 /end AXIS_DESCR /end CHARACTERISTIC
/begin CHARACTERISTIC KFDYESOF "сомнительная | damos-сомнительно | адрес 0x1BB4D, данные 0x1BB4D | масштаб x0.0234375 % | Offset threshold for dynamic presetting values" MAP 0x1BB4D RL_GRID_DU8 0 CM_0p0234375_0 0 255
 /begin AXIS_DESCR FIX_AXIS NO_INPUT_QUANTITY CM_IDENTITY 4 0 3 FIX_AXIS_PAR_DIST 0 1 4 /end AXIS_DESCR
 /begin AXIS_DESCR FIX_AXIS NO_INPUT_QUANTITY CM_IDENTITY 16 0 15 FIX_AXIS_PAR_DIST 0 1 16 /end AXIS_DESCR
/end CHARACTERISTIC
/begin CHARACTERISTIC KLDYMNT "вероятная | damos-вероятно | адрес 0x1BBC9, данные 0x1BBC9 | масштаб x-0.75 grad KW | min. value of dynamic response derivation" CURVE 0x1BBC9 RL_GRID_DS8 0 CM_n0p75_0_gradKW 0 127
 /begin AXIS_DESCR FIX_AXIS NO_INPUT_QUANTITY CM_IDENTITY 16 0 15 FIX_AXIS_PAR_DIST 0 1 16 /end AXIS_DESCR
/end CHARACTERISTIC
/begin CHARACTERISTIC UDKSNO "вероятная | damos-вероятно | адрес 0x1BBEA, данные 0x1BBEA | масштаб x0.0195313 V | upper reference voltage threshold for diagnosis knock sensors" CURVE 0x1BBEA RL_GRID_DU8 0 CM_0p0195313_0_V 0 255
 /begin AXIS_DESCR FIX_AXIS NO_INPUT_QUANTITY CM_IDENTITY 16 0 15 FIX_AXIS_PAR_DIST 0 1 16 /end AXIS_DESCR
/end CHARACTERISTIC
/begin CHARACTERISTIC UDKSNU "вероятная | damos-вероятно | адрес 0x1BC0A, данные 0x1BC0A | масштаб x0.0195313 V | lower reference voltage threshold for diagnosis knock sensors" CURVE 0x1BC0A RL_GRID_DU8 0 CM_0p0195313_0_V 0 255
 /begin AXIS_DESCR FIX_AXIS NO_INPUT_QUANTITY CM_IDENTITY 16 0 15 FIX_AXIS_PAR_DIST 0 1 16 /end AXIS_DESCR
/end CHARACTERISTIC
/begin CHARACTERISTIC MRFAVW "вероятная | damos-вероятно | адрес 0x1BC2C, данные 0x1BC2C | масштаб x0.00305176 % | threshold to switch end of injection angle at max. driver request" CURVE 0x1BC2C RL_GRID_DU16 0 CM_0p003051757812_0 0 65535
 /begin AXIS_DESCR FIX_AXIS NO_INPUT_QUANTITY CM_IDENTITY 8 0 7 FIX_AXIS_PAR_DIST 0 1 8 /end AXIS_DESCR
/end CHARACTERISTIC
/begin CHARACTERISTIC MAP_614_1BC7A_8 "вероятная | mapscan | адрес 0x1BC7A, данные 0x1BC83" CURVE 0x1BC7A RL_2D_A8_DU8 0 CM_IDENTITY 0 255 /begin AXIS_DESCR STD_AXIS NO_INPUT_QUANTITY CM_IDENTITY 8 0 255 /end AXIS_DESCR /end CHARACTERISTIC
/begin CHARACTERISTIC RKBAUM "вероятная | damos-вероятно | адрес 0x1BC96, данные 0x1BC96 | масштаб x0.1875 % | rk-threshold for acceleration enrichment display" CURVE 0x1BC96 RL_GRID_DS16 0 CM_0p1875_0 0 32767
 /begin AXIS_DESCR FIX_AXIS NO_INPUT_QUANTITY CM_IDENTITY 9 0 8 FIX_AXIS_PAR_DIST 0 1 9 /end AXIS_DESCR
/end CHARACTERISTIC
/begin CHARACTERISTIC RKVAUM "вероятная | damos-вероятно | адрес 0x1BCA8, данные 0x1BCA8 | масштаб x0.1875 % | rk-threshold for deceleration enleanment display" CURVE 0x1BCA8 RL_GRID_DS16 0 CM_0p1875_0 0 32767
 /begin AXIS_DESCR FIX_AXIS NO_INPUT_QUANTITY CM_IDENTITY 9 0 8 FIX_AXIS_PAR_DIST 0 1 9 /end AXIS_DESCR
/end CHARACTERISTIC
/begin CHARACTERISTIC ZMRFABN "вероятная | damos-вероятно | адрес 0x1BCDB, данные 0x1BCDB | calculation of current time constant of low pass (permanent high load) mrfabnf_w" CURVE 0x1BCDB RL_GRID_DU8 0 CM_IDENTITY 0 255
 /begin AXIS_DESCR FIX_AXIS NO_INPUT_QUANTITY CM_IDENTITY 5 0 4 FIX_AXIS_PAR_DIST 0 1 5 /end AXIS_DESCR
/end CHARACTERISTIC
/begin CHARACTERISTIC KFFRAT "вероятная | damos-вероятно | адрес 0x1BCFA, данные 0x1BCFA | масштаб x7.62939e-05 1/s | load and speed dependent gradient of FRAT integrator" MAP 0x1BCFA RL_GRID_DU16 0 CM_7p629394531En05_0_1s 0 65535
 /begin AXIS_DESCR FIX_AXIS NO_INPUT_QUANTITY CM_IDENTITY 4 0 3 FIX_AXIS_PAR_DIST 0 1 4 /end AXIS_DESCR
 /begin AXIS_DESCR FIX_AXIS NO_INPUT_QUANTITY CM_IDENTITY 4 0 3 FIX_AXIS_PAR_DIST 0 1 4 /end AXIS_DESCR
/end CHARACTERISTIC
/begin CHARACTERISTIC ZKFRAOA "вероятная | damos-вероятно | адрес 0x1BD41, данные 0x1BD41 | масштаб x7.62939e-05 1/s | time constant for frao-integrator, f(number of starts with fuel in oil)" CURVE 0x1BD41 RL_GRID_DU16 0 CM_7p629394531En05_0_1s 0 65535
 /begin AXIS_DESCR FIX_AXIS NO_INPUT_QUANTITY CM_IDENTITY 3 0 2 FIX_AXIS_PAR_DIST 0 1 3 /end AXIS_DESCR
/end CHARACTERISTIC
/begin CHARACTERISTIC ZKFRAUA "вероятная | damos-вероятно | адрес 0x1BD4F, данные 0x1BD4F | масштаб x7.62939e-05 1/s | time constant for frau-integrator, f(number of starts with" CURVE 0x1BD4F RL_GRID_DU16 0 CM_7p629394531En05_0_1s 0 65535
 /begin AXIS_DESCR FIX_AXIS NO_INPUT_QUANTITY CM_IDENTITY 3 0 2 FIX_AXIS_PAR_DIST 0 1 3 /end AXIS_DESCR
/end CHARACTERISTIC
/begin CHARACTERISTIC ZKRKATA "неоднозначная | damos-сомнительно | адрес 0x1BD5D, данные 0x1BD5D | масштаб x0.0146484 %/s | integration speed integrator rkat, f(abo)" CURVE 0x1BD5D RL_GRID_DU16 0 CM_0p0146484375_0_s 0 65535
 /begin AXIS_DESCR FIX_AXIS NO_INPUT_QUANTITY CM_IDENTITY 3 0 2 FIX_AXIS_PAR_DIST 0 1 3 /end AXIS_DESCR
/end CHARACTERISTIC
/begin CHARACTERISTIC ZKRKAZA "вероятная | damos-вероятно | адрес 0x1BD6B, данные 0x1BD6B | масштаб x0.0146484 %/s | integration speed integrator rkaz, f(abo)" CURVE 0x1BD6B RL_GRID_DU16 0 CM_0p0146484375_0_s 0 65535
 /begin AXIS_DESCR FIX_AXIS NO_INPUT_QUANTITY CM_IDENTITY 3 0 2 FIX_AXIS_PAR_DIST 0 1 3 /end AXIS_DESCR
/end CHARACTERISTIC
/begin CHARACTERISTIC MAP_623_1BD71_5 "вероятная | mapscan | адрес 0x1BD71, данные 0x1BD7C" CURVE 0x1BD71 RL_2D_A16_DU16 0 CM_IDENTITY 0 65535 /begin AXIS_DESCR STD_AXIS NO_INPUT_QUANTITY CM_IDENTITY 5 0 65535 /end AXIS_DESCR /end CHARACTERISTIC
/begin CHARACTERISTIC KLESUKKO "подтверждена | damos | адрес 0x1BD89, данные 0x1BD89 | масштаб x3.05176e-05 - | Characteristic line transient compensation at A/C on" CURVE 0x1BD89 RL_GRID_DU16 0 CM_3p051757812En05_0 0 65535
 /begin AXIS_DESCR FIX_AXIS NO_INPUT_QUANTITY CM_IDENTITY 5 0 4 FIX_AXIS_PAR_DIST 0 1 5 /end AXIS_DESCR
/end CHARACTERISTIC
/begin CHARACTERISTIC KLKESUKFS "вероятная | damos-вероятно | адрес 0x1BD99, данные 0x1BD99 | масштаб x3.05176e-05 - | characteristic line of integration factor for trans. comp. at engaging gear(A/T)" CURVE 0x1BD99 RL_GRID_DU16 0 CM_3p051757812En05_0 0 65535
 /begin AXIS_DESCR FIX_AXIS NO_INPUT_QUANTITY CM_IDENTITY 5 0 4 FIX_AXIS_PAR_DIST 0 1 5 /end AXIS_DESCR
/end CHARACTERISTIC
/begin CHARACTERISTIC KLKESUKKO "вероятная | damos-вероятно | адрес 0x1BDA9, данные 0x1BDA9 | масштаб x3.05176e-05 - | characteristic line of integration factor for transient compensation at A/C on" CURVE 0x1BDA9 RL_GRID_DU16 0 CM_3p051757812En05_0 0 65535
 /begin AXIS_DESCR FIX_AXIS NO_INPUT_QUANTITY CM_IDENTITY 5 0 4 FIX_AXIS_PAR_DIST 0 1 5 /end AXIS_DESCR
/end CHARACTERISTIC
/begin CHARACTERISTIC FRLFSDP "вероятная | damos-вероятно | адрес 0x1BDB9, данные 0x1BDB9 | масштаб x3.05176e-05 - | injection correction for RLFS" CURVE 0x1BDB9 RL_GRID_DU16 0 CM_3p051757812En05_0 0 65535
 /begin AXIS_DESCR FIX_AXIS NO_INPUT_QUANTITY CM_IDENTITY 11 0 10 FIX_AXIS_PAR_DIST 0 1 11 /end AXIS_DESCR
/end CHARACTERISTIC
/begin CHARACTERISTIC FQTEPT "подтверждена | damos | адрес 0x1BE3F, данные 0x1BE3F | масштаб x0.125 - | characteristic line: for fuel-tank underpressure limitation" CURVE 0x1BE3F RL_GRID_DS8 0 CM_0p125_0 0 127
 /begin AXIS_DESCR FIX_AXIS NO_INPUT_QUANTITY CM_IDENTITY 6 0 5 FIX_AXIS_PAR_DIST 0 1 6 /end AXIS_DESCR
/end CHARACTERISTIC
/begin CHARACTERISTIC KFETATE "вероятная | damos-вероятно | адрес 0x1BE5E, данные 0x1BE5E | масштаб x0.00195312 % | characteristic map for efficency at active purging when te is near TEMIN" MAP 0x1BE5E RL_GRID_DU16 0 CM_0p001953125_0 0 65535
 /begin AXIS_DESCR FIX_AXIS NO_INPUT_QUANTITY CM_IDENTITY 5 0 4 FIX_AXIS_PAR_DIST 0 1 5 /end AXIS_DESCR
 /begin AXIS_DESCR FIX_AXIS NO_INPUT_QUANTITY CM_IDENTITY 3 0 2 FIX_AXIS_PAR_DIST 0 1 3 /end AXIS_DESCR
/end CHARACTERISTIC
/begin CHARACTERISTIC KFTEKA "сомнительная | damos-сомнительно | адрес 0x1BE8A, данные 0x1BE8A | масштаб x0.0078125 - | characteristic map of desired fuel portion purge control" MAP 0x1BE8A RL_GRID_DS8 0 CM_0p0078125_0 0 127
 /begin AXIS_DESCR FIX_AXIS NO_INPUT_QUANTITY CM_IDENTITY 5 0 4 FIX_AXIS_PAR_DIST 0 1 5 /end AXIS_DESCR
 /begin AXIS_DESCR FIX_AXIS NO_INPUT_QUANTITY CM_IDENTITY 5 0 4 FIX_AXIS_PAR_DIST 0 1 5 /end AXIS_DESCR
/end CHARACTERISTIC
/begin CHARACTERISTIC KFDTMTE "вероятная | damos-вероятно | адрес 0x1BF29, данные 0x1BF29 | масштаб x0.000732422 Grad C | char. map for gradient of engine coolant temperature in substitute temp. model" MAP 0x1BF29 RL_GRID_DS8 0 CM_0p000732421875_0_GradC 0 127
 /begin AXIS_DESCR FIX_AXIS NO_INPUT_QUANTITY CM_IDENTITY 4 0 3 FIX_AXIS_PAR_DIST 0 1 4 /end AXIS_DESCR
 /begin AXIS_DESCR FIX_AXIS NO_INPUT_QUANTITY CM_IDENTITY 5 0 4 FIX_AXIS_PAR_DIST 0 1 5 /end AXIS_DESCR
/end CHARACTERISTIC
/begin CHARACTERISTIC KFDTMTR "вероятная | damos-вероятно | адрес 0x1BF49, данные 0x1BF49 | масштаб x0.000732422 Grad C | char. map for gradient of engine coolant temperature in reference model" MAP 0x1BF49 RL_GRID_DS8 0 CM_0p000732421875_0_GradC 0 127
 /begin AXIS_DESCR FIX_AXIS NO_INPUT_QUANTITY CM_IDENTITY 4 0 3 FIX_AXIS_PAR_DIST 0 1 4 /end AXIS_DESCR
 /begin AXIS_DESCR FIX_AXIS NO_INPUT_QUANTITY CM_IDENTITY 5 0 4 FIX_AXIS_PAR_DIST 0 1 5 /end AXIS_DESCR
/end CHARACTERISTIC
/begin CHARACTERISTIC KLDTMRS "вероятная | damos-вероятно | адрес 0x1BF5F, данные 0x1BF5F | масштаб x0.000732422 Grad C | char.line for gradient of engine coolant temp. during cutoff for reference model" CURVE 0x1BF5F RL_GRID_DS8 0 CM_0p000732421875_0_GradC 0 127
 /begin AXIS_DESCR FIX_AXIS NO_INPUT_QUANTITY CM_IDENTITY 5 0 4 FIX_AXIS_PAR_DIST 0 1 5 /end AXIS_DESCR
/end CHARACTERISTIC
/begin CHARACTERISTIC DFPSLBIT "вероятная | damos-вероятно | адрес 0x1BF7C, данные 0x1BF7C | Section bits for indication of the activated error paths" CURVE 0x1BF7C RL_GRID_DU8 0 CM_IDENTITY 0 255
 /begin AXIS_DESCR FIX_AXIS NO_INPUT_QUANTITY CM_IDENTITY 16 0 15 FIX_AXIS_PAR_DIST 0 1 16 /end AXIS_DESCR
/end CHARACTERISTIC
/begin CHARACTERISTIC LURBRL8 "вероятная | damos-вероятно | адрес 0x1BF9F, данные 0x1BF9F | reference value for engine roughness, vehicle speed zero" CURVE 0x1BF9F RL_GRID_DS8 0 CM_IDENTITY 0 127
 /begin AXIS_DESCR FIX_AXIS NO_INPUT_QUANTITY CM_IDENTITY 8 0 7 FIX_AXIS_PAR_DIST 0 1 8 /end AXIS_DESCR
/end CHARACTERISTIC
/begin CHARACTERISTIC FKKVS "вероятная | damos-вероятно | адрес 0x1C02E, данные 0x1C02E | масштаб x3.05176e-05 - | Factor to correct fuel delivery system" MAP 0x1C02E RL_GRID_DU16 0 CM_3p051757812En05_0 0 65535
 /begin AXIS_DESCR FIX_AXIS NO_INPUT_QUANTITY CM_IDENTITY 16 0 15 FIX_AXIS_PAR_DIST 0 1 16 /end AXIS_DESCR
 /begin AXIS_DESCR FIX_AXIS NO_INPUT_QUANTITY CM_IDENTITY 16 0 15 FIX_AXIS_PAR_DIST 0 1 16 /end AXIS_DESCR
/end CHARACTERISTIC
/begin CHARACTERISTIC CL30LINE "вероятная | damos-вероятно | адрес 0x1C3E2, данные 0x1C3E2 | 30th line of classtable" CURVE 0x1C3E2 RL_GRID_DU8 0 CM_IDENTITY 0 255
 /begin AXIS_DESCR FIX_AXIS NO_INPUT_QUANTITY CM_IDENTITY 13 0 12 FIX_AXIS_PAR_DIST 0 1 13 /end AXIS_DESCR
/end CHARACTERISTIC
/begin CHARACTERISTIC CL31LINE "вероятная | damos-вероятно | адрес 0x1C3F0, данные 0x1C3F0 | 31th line of classtable" CURVE 0x1C3F0 RL_GRID_DU8 0 CM_IDENTITY 0 255
 /begin AXIS_DESCR FIX_AXIS NO_INPUT_QUANTITY CM_IDENTITY 13 0 12 FIX_AXIS_PAR_DIST 0 1 13 /end AXIS_DESCR
/end CHARACTERISTIC
/begin CHARACTERISTIC CL32LINE "вероятная | damos-вероятно | адрес 0x1C3FE, данные 0x1C3FE | 32th line of classtable" CURVE 0x1C3FE RL_GRID_DU8 0 CM_IDENTITY 0 255
 /begin AXIS_DESCR FIX_AXIS NO_INPUT_QUANTITY CM_IDENTITY 13 0 12 FIX_AXIS_PAR_DIST 0 1 13 /end AXIS_DESCR
/end CHARACTERISTIC
/begin CHARACTERISTIC CL33LINE "вероятная | damos-вероятно | адрес 0x1C40C, данные 0x1C40C | 33th line of classtable" CURVE 0x1C40C RL_GRID_DU8 0 CM_IDENTITY 0 255
 /begin AXIS_DESCR FIX_AXIS NO_INPUT_QUANTITY CM_IDENTITY 13 0 12 FIX_AXIS_PAR_DIST 0 1 13 /end AXIS_DESCR
/end CHARACTERISTIC
/begin CHARACTERISTIC CL34LINE "вероятная | damos-вероятно | адрес 0x1C41A, данные 0x1C41A | 34th line of classtable" CURVE 0x1C41A RL_GRID_DU8 0 CM_IDENTITY 0 255
 /begin AXIS_DESCR FIX_AXIS NO_INPUT_QUANTITY CM_IDENTITY 13 0 12 FIX_AXIS_PAR_DIST 0 1 13 /end AXIS_DESCR
/end CHARACTERISTIC
/begin CHARACTERISTIC CL35LINE "вероятная | damos-вероятно | адрес 0x1C428, данные 0x1C428 | 35th line of classtable" CURVE 0x1C428 RL_GRID_DU8 0 CM_IDENTITY 0 255
 /begin AXIS_DESCR FIX_AXIS NO_INPUT_QUANTITY CM_IDENTITY 13 0 12 FIX_AXIS_PAR_DIST 0 1 13 /end AXIS_DESCR
/end CHARACTERISTIC
/begin CHARACTERISTIC CL36LINE "вероятная | damos-вероятно | адрес 0x1C436, данные 0x1C436 | 36th line of classtable" CURVE 0x1C436 RL_GRID_DU8 0 CM_IDENTITY 0 255
 /begin AXIS_DESCR FIX_AXIS NO_INPUT_QUANTITY CM_IDENTITY 13 0 12 FIX_AXIS_PAR_DIST 0 1 13 /end AXIS_DESCR
/end CHARACTERISTIC
/begin CHARACTERISTIC CL37LINE "вероятная | damos-вероятно | адрес 0x1C444, данные 0x1C444 | 37th line of classtable" CURVE 0x1C444 RL_GRID_DU8 0 CM_IDENTITY 0 255
 /begin AXIS_DESCR FIX_AXIS NO_INPUT_QUANTITY CM_IDENTITY 13 0 12 FIX_AXIS_PAR_DIST 0 1 13 /end AXIS_DESCR
/end CHARACTERISTIC
/begin CHARACTERISTIC CL38LINE "вероятная | damos-вероятно | адрес 0x1C452, данные 0x1C452 | 38th line of classtable" CURVE 0x1C452 RL_GRID_DU8 0 CM_IDENTITY 0 255
 /begin AXIS_DESCR FIX_AXIS NO_INPUT_QUANTITY CM_IDENTITY 13 0 12 FIX_AXIS_PAR_DIST 0 1 13 /end AXIS_DESCR
/end CHARACTERISTIC
/begin CHARACTERISTIC CL39LINE "вероятная | damos-вероятно | адрес 0x1C460, данные 0x1C460 | 39th line of classtable" CURVE 0x1C460 RL_GRID_DU8 0 CM_IDENTITY 0 255
 /begin AXIS_DESCR FIX_AXIS NO_INPUT_QUANTITY CM_IDENTITY 13 0 12 FIX_AXIS_PAR_DIST 0 1 13 /end AXIS_DESCR
/end CHARACTERISTIC
/begin CHARACTERISTIC LNXQTM "вероятная | damos-вероятно | адрес 0x1C471, данные 0x1C471 | масштаб x6.10352e-05 - | natural logarithm from temperature quotient" CURVE 0x1C471 RL_GRID_DU16 0 CM_6p103515625En05_0 0 65535
 /begin AXIS_DESCR FIX_AXIS NO_INPUT_QUANTITY CM_IDENTITY 12 0 11 FIX_AXIS_PAR_DIST 0 1 12 /end AXIS_DESCR
/end CHARACTERISTIC
/begin CHARACTERISTIC TNLSGM "вероятная | damos-вероятно | адрес 0x1C4A3, данные 0x1C4A3 | Delay time for ECU shut-off" CURVE 0x1C4A3 RL_GRID_DU8 0 CM_IDENTITY 0 255
 /begin AXIS_DESCR FIX_AXIS NO_INPUT_QUANTITY CM_IDENTITY 6 0 5 FIX_AXIS_PAR_DIST 0 1 6 /end AXIS_DESCR
/end CHARACTERISTIC
/begin CHARACTERISTIC ZKTABTU "вероятная | damos-вероятно | адрес 0x1C4BF, данные 0x1C4BF | time constant for engine cooling" CURVE 0x1C4BF RL_GRID_DU8 0 CM_IDENTITY 0 255
 /begin AXIS_DESCR FIX_AXIS NO_INPUT_QUANTITY CM_IDENTITY 4 0 3 FIX_AXIS_PAR_DIST 0 1 4 /end AXIS_DESCR
/end CHARACTERISTIC
/end MODULE
/end PROJECT
