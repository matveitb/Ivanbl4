ASAP2_VERSION 1 61
/begin PROJECT FBH3ID60 "Kia Spectra 1.6 Bosch M7.9.7 FBH3ID60"
/begin HEADER "Kia Spectra 1.6 Bosch M7.9.7 FBH3ID60" VERSION "1.0" /end HEADER
/begin MODULE FBH3ID60_MOD "Bosch M7.9.7 / Infineon C167"
/begin MOD_COMMON "little-endian, выравнивание 1" BYTE_ORDER MSB_LAST ALIGNMENT_BYTE 1 ALIGNMENT_WORD 1 ALIGNMENT_LONG 1 /end MOD_COMMON
/begin COMPU_METHOD CM_IDENTITY "без пересчёта (сырые значения)" RAT_FUNC "%.3f" "" COEFFS 0 1 0 0 0 1 /end COMPU_METHOD
/begin RECORD_LAYOUT RL_2D_A8_D8 NO_AXIS_PTS_X 1 UBYTE AXIS_PTS_X 2 UBYTE INDEX_INCR DIRECT FNC_VALUES 3 UBYTE ROW_DIR DIRECT /end RECORD_LAYOUT
/begin RECORD_LAYOUT RL_3D_A8_D8 NO_AXIS_PTS_X 1 UBYTE NO_AXIS_PTS_Y 2 UBYTE AXIS_PTS_X 3 UBYTE INDEX_INCR DIRECT AXIS_PTS_Y 4 UBYTE INDEX_INCR DIRECT FNC_VALUES 5 UBYTE ROW_DIR DIRECT /end RECORD_LAYOUT
/begin RECORD_LAYOUT RL_GRID_D8 FNC_VALUES 1 UBYTE ROW_DIR DIRECT /end RECORD_LAYOUT
/begin RECORD_LAYOUT RL_3D_A8_D16 NO_AXIS_PTS_X 1 UBYTE NO_AXIS_PTS_Y 2 UBYTE AXIS_PTS_X 3 UBYTE INDEX_INCR DIRECT AXIS_PTS_Y 4 UBYTE INDEX_INCR DIRECT FNC_VALUES 5 UWORD ROW_DIR DIRECT /end RECORD_LAYOUT
/begin RECORD_LAYOUT RL_2D_A16_D16 NO_AXIS_PTS_X 1 UBYTE AXIS_PTS_X 2 UWORD INDEX_INCR DIRECT FNC_VALUES 3 UWORD ROW_DIR DIRECT /end RECORD_LAYOUT
/begin RECORD_LAYOUT RL_2D_A8_D16 NO_AXIS_PTS_X 1 UBYTE AXIS_PTS_X 2 UBYTE INDEX_INCR DIRECT FNC_VALUES 3 UWORD ROW_DIR DIRECT /end RECORD_LAYOUT
/begin RECORD_LAYOUT RL_3D_A16_D16 NO_AXIS_PTS_X 1 UBYTE NO_AXIS_PTS_Y 2 UBYTE AXIS_PTS_X 3 UWORD INDEX_INCR DIRECT AXIS_PTS_Y 4 UWORD INDEX_INCR DIRECT FNC_VALUES 5 UWORD ROW_DIR DIRECT /end RECORD_LAYOUT
/begin RECORD_LAYOUT RL_2D_A16_D8 NO_AXIS_PTS_X 1 UBYTE AXIS_PTS_X 2 UWORD INDEX_INCR DIRECT FNC_VALUES 3 UBYTE ROW_DIR DIRECT /end RECORD_LAYOUT
/begin CHARACTERISTIC MAP_000_10070_5 "вероятная | mapscan | адрес 0x10070, данные 0x10076" CURVE 0x10070 RL_2D_A8_D8 0 CM_IDENTITY 0 255 /begin AXIS_DESCR STD_AXIS NO_INPUT_QUANTITY CM_IDENTITY 5 0 255 /end AXIS_DESCR /end CHARACTERISTIC
/begin CHARACTERISTIC MAP_001_10092_6 "вероятная | mapscan | адрес 0x10092, данные 0x10099" CURVE 0x10092 RL_2D_A8_D8 0 CM_IDENTITY 0 255 /begin AXIS_DESCR STD_AXIS NO_INPUT_QUANTITY CM_IDENTITY 6 0 255 /end AXIS_DESCR /end CHARACTERISTIC
/begin CHARACTERISTIC MAP_002_100A1_8 "вероятная | mapscan | адрес 0x100A1, данные 0x100AA" CURVE 0x100A1 RL_2D_A8_D8 0 CM_IDENTITY 0 255 /begin AXIS_DESCR STD_AXIS NO_INPUT_QUANTITY CM_IDENTITY 8 0 255 /end AXIS_DESCR /end CHARACTERISTIC
/begin CHARACTERISTIC MAP_003_100B3_8 "вероятная | mapscan | адрес 0x100B3, данные 0x100BC" CURVE 0x100B3 RL_2D_A8_D8 0 CM_IDENTITY 0 255 /begin AXIS_DESCR STD_AXIS NO_INPUT_QUANTITY CM_IDENTITY 8 0 255 /end AXIS_DESCR /end CHARACTERISTIC
/begin CHARACTERISTIC MAP_004_100C7_12 "вероятная | mapscan | адрес 0x100C7, данные 0x100D4" CURVE 0x100C7 RL_2D_A8_D8 0 CM_IDENTITY 0 255 /begin AXIS_DESCR STD_AXIS NO_INPUT_QUANTITY CM_IDENTITY 12 0 255 /end AXIS_DESCR /end CHARACTERISTIC
/begin CHARACTERISTIC MAP_005_100F2_16 "вероятная | mapscan | адрес 0x100F2, данные 0x10103" CURVE 0x100F2 RL_2D_A8_D8 0 CM_IDENTITY 0 255 /begin AXIS_DESCR STD_AXIS NO_INPUT_QUANTITY CM_IDENTITY 16 0 255 /end AXIS_DESCR /end CHARACTERISTIC
/begin CHARACTERISTIC MAP_006_1012D_5 "вероятная | mapscan | адрес 0x1012D, данные 0x10133" CURVE 0x1012D RL_2D_A8_D8 0 CM_IDENTITY 0 255 /begin AXIS_DESCR STD_AXIS NO_INPUT_QUANTITY CM_IDENTITY 5 0 255 /end AXIS_DESCR /end CHARACTERISTIC
/begin CHARACTERISTIC MAP_007_1013A_6 "вероятная | mapscan | адрес 0x1013A, данные 0x10141" CURVE 0x1013A RL_2D_A8_D8 0 CM_IDENTITY 0 255 /begin AXIS_DESCR STD_AXIS NO_INPUT_QUANTITY CM_IDENTITY 6 0 255 /end AXIS_DESCR /end CHARACTERISTIC
/begin CHARACTERISTIC MAP_008_1014A_12 "вероятная | mapscan | адрес 0x1014A, данные 0x10157" CURVE 0x1014A RL_2D_A8_D8 0 CM_IDENTITY 0 255 /begin AXIS_DESCR STD_AXIS NO_INPUT_QUANTITY CM_IDENTITY 12 0 255 /end AXIS_DESCR /end CHARACTERISTIC
/begin CHARACTERISTIC MAP_009_10164_16 "вероятная | mapscan | адрес 0x10164, данные 0x10175" CURVE 0x10164 RL_2D_A8_D8 0 CM_IDENTITY 0 255 /begin AXIS_DESCR STD_AXIS NO_INPUT_QUANTITY CM_IDENTITY 16 0 255 /end AXIS_DESCR /end CHARACTERISTIC
/begin CHARACTERISTIC MAP_16x16_0101F4 "подтверждена | профиль | адрес 0x101F4, данные 0x10216 | Классический формат Bosch с заголовком и осями внутри блока. Максимум ссылок из кода. Ось X 6..133, ось Y 10..150, данные 89..200." MAP 0x101F4 RL_3D_A8_D8 0 CM_IDENTITY 0 255 /begin AXIS_DESCR STD_AXIS NO_INPUT_QUANTITY CM_IDENTITY 16 0 255 /end AXIS_DESCR /begin AXIS_DESCR STD_AXIS NO_INPUT_QUANTITY CM_IDENTITY 16 0 255 /end AXIS_DESCR /end CHARACTERISTIC
/begin CHARACTERISTIC MAP_16x16_010316 "подтверждена | профиль | адрес 0x10316, данные 0x10338 | Данные 89..190. Найдена обоими сканерами независимо." MAP 0x10316 RL_3D_A8_D8 0 CM_IDENTITY 0 255 /begin AXIS_DESCR STD_AXIS NO_INPUT_QUANTITY CM_IDENTITY 16 0 255 /end AXIS_DESCR /begin AXIS_DESCR STD_AXIS NO_INPUT_QUANTITY CM_IDENTITY 16 0 255 /end AXIS_DESCR /end CHARACTERISTIC
/begin CHARACTERISTIC MAP_012_10438_16x8 "вероятная | mapscan | адрес 0x10438, данные 0x10452" MAP 0x10438 RL_3D_A8_D8 0 CM_IDENTITY 0 255 /begin AXIS_DESCR STD_AXIS NO_INPUT_QUANTITY CM_IDENTITY 16 0 255 /end AXIS_DESCR /begin AXIS_DESCR STD_AXIS NO_INPUT_QUANTITY CM_IDENTITY 8 0 255 /end AXIS_DESCR /end CHARACTERISTIC
/begin CHARACTERISTIC MAP_013_10514_10 "вероятная | mapscan | адрес 0x10514, данные 0x1051F" CURVE 0x10514 RL_2D_A8_D8 0 CM_IDENTITY 0 255 /begin AXIS_DESCR STD_AXIS NO_INPUT_QUANTITY CM_IDENTITY 10 0 255 /end AXIS_DESCR /end CHARACTERISTIC
/begin CHARACTERISTIC IGN_MAIN_11x16 "подтверждена | профиль | адрес 0x10529, данные 0x10529 | Карта зажигания. Столбцы = нагрузка (растёт вправо), строки = обороты (растут вниз). Сток 1..60. Меняется и между двумя csok, и относительно стока (+0..+9)." MAP 0x10529 RL_GRID_D8 0 CM_IDENTITY 0 255
 /begin AXIS_DESCR FIX_AXIS NO_INPUT_QUANTITY CM_IDENTITY 11 0 10 FIX_AXIS_PAR_DIST 0 1 11 /end AXIS_DESCR
 /begin AXIS_DESCR FIX_AXIS NO_INPUT_QUANTITY CM_IDENTITY 16 0 15 FIX_AXIS_PAR_DIST 0 1 16 /end AXIS_DESCR
/end CHARACTERISTIC
/begin CHARACTERISTIC MAP_015_1073A_8 "вероятная | mapscan | адрес 0x1073A, данные 0x10743" CURVE 0x1073A RL_2D_A8_D8 0 CM_IDENTITY 0 255 /begin AXIS_DESCR STD_AXIS NO_INPUT_QUANTITY CM_IDENTITY 8 0 255 /end AXIS_DESCR /end CHARACTERISTIC
/begin CHARACTERISTIC MAP_016_1081C_8x6 "вероятная | mapscan | адрес 0x1081C, данные 0x1082C" MAP 0x1081C RL_3D_A8_D16 0 CM_IDENTITY 0 65535 /begin AXIS_DESCR STD_AXIS NO_INPUT_QUANTITY CM_IDENTITY 8 0 255 /end AXIS_DESCR /begin AXIS_DESCR STD_AXIS NO_INPUT_QUANTITY CM_IDENTITY 6 0 255 /end AXIS_DESCR /end CHARACTERISTIC
/begin CHARACTERISTIC GRID_017_10935_4x48 "вероятная | gridscan | адрес 0x10935, данные 0x10935 | константная таблица (все значения 223)" MAP 0x10935 RL_GRID_D8 0 CM_IDENTITY 0 255
 /begin AXIS_DESCR FIX_AXIS NO_INPUT_QUANTITY CM_IDENTITY 4 0 3 FIX_AXIS_PAR_DIST 0 1 4 /end AXIS_DESCR
 /begin AXIS_DESCR FIX_AXIS NO_INPUT_QUANTITY CM_IDENTITY 48 0 47 FIX_AXIS_PAR_DIST 0 1 48 /end AXIS_DESCR
/end CHARACTERISTIC
/begin CHARACTERISTIC IGN_2_12x15 "подтверждена | профиль | адрес 0x10A01, данные 0x10A01 | Вторая карта зажигания. Сток 3..57. Меняется между csok и относительно стока (+0..+15)." MAP 0x10A01 RL_GRID_D8 0 CM_IDENTITY 0 255
 /begin AXIS_DESCR FIX_AXIS NO_INPUT_QUANTITY CM_IDENTITY 12 0 11 FIX_AXIS_PAR_DIST 0 1 12 /end AXIS_DESCR
 /begin AXIS_DESCR FIX_AXIS NO_INPUT_QUANTITY CM_IDENTITY 15 0 14 FIX_AXIS_PAR_DIST 0 1 15 /end AXIS_DESCR
/end CHARACTERISTIC
/begin CHARACTERISTIC IGN_3_12x16 "подтверждена | профиль | адрес 0x10AB5, данные 0x10AB5 | Третья карта зажигания. Сток 3..45." MAP 0x10AB5 RL_GRID_D8 0 CM_IDENTITY 0 255
 /begin AXIS_DESCR FIX_AXIS NO_INPUT_QUANTITY CM_IDENTITY 12 0 11 FIX_AXIS_PAR_DIST 0 1 12 /end AXIS_DESCR
 /begin AXIS_DESCR FIX_AXIS NO_INPUT_QUANTITY CM_IDENTITY 16 0 15 FIX_AXIS_PAR_DIST 0 1 16 /end AXIS_DESCR
/end CHARACTERISTIC
/begin CHARACTERISTIC MAP_020_10B86_8x8 "вероятная | mapscan | адрес 0x10B86, данные 0x10B98" MAP 0x10B86 RL_3D_A8_D8 0 CM_IDENTITY 0 255 /begin AXIS_DESCR STD_AXIS NO_INPUT_QUANTITY CM_IDENTITY 8 0 255 /end AXIS_DESCR /begin AXIS_DESCR STD_AXIS NO_INPUT_QUANTITY CM_IDENTITY 8 0 255 /end AXIS_DESCR /end CHARACTERISTIC
/begin CHARACTERISTIC MAP_021_10D9A_6 "вероятная | mapscan | адрес 0x10D9A, данные 0x10DA7" CURVE 0x10D9A RL_2D_A16_D16 0 CM_IDENTITY 0 65535 /begin AXIS_DESCR STD_AXIS NO_INPUT_QUANTITY CM_IDENTITY 6 0 65535 /end AXIS_DESCR /end CHARACTERISTIC
/begin CHARACTERISTIC GRID_022_10FF8_4x64 "вероятная | gridscan | адрес 0x10FF8, данные 0x10FF8 | константная таблица (все значения 128)" MAP 0x10FF8 RL_GRID_D8 0 CM_IDENTITY 0 255
 /begin AXIS_DESCR FIX_AXIS NO_INPUT_QUANTITY CM_IDENTITY 4 0 3 FIX_AXIS_PAR_DIST 0 1 4 /end AXIS_DESCR
 /begin AXIS_DESCR FIX_AXIS NO_INPUT_QUANTITY CM_IDENTITY 64 0 63 FIX_AXIS_PAR_DIST 0 1 64 /end AXIS_DESCR
/end CHARACTERISTIC
/begin CHARACTERISTIC MAP_023_110FD_14x14 "вероятная | mapscan | адрес 0x110FD, данные 0x1111B" MAP 0x110FD RL_3D_A8_D16 0 CM_IDENTITY 0 65535 /begin AXIS_DESCR STD_AXIS NO_INPUT_QUANTITY CM_IDENTITY 14 0 255 /end AXIS_DESCR /begin AXIS_DESCR STD_AXIS NO_INPUT_QUANTITY CM_IDENTITY 14 0 255 /end AXIS_DESCR /end CHARACTERISTIC
/begin CHARACTERISTIC MAP_024_112C2_14 "вероятная | mapscan | адрес 0x112C2, данные 0x112D1" CURVE 0x112C2 RL_2D_A8_D8 0 CM_IDENTITY 0 255 /begin AXIS_DESCR STD_AXIS NO_INPUT_QUANTITY CM_IDENTITY 14 0 255 /end AXIS_DESCR /end CHARACTERISTIC
/begin CHARACTERISTIC GRID_025_112DF_4x49 "вероятная | gridscan | адрес 0x112DF, данные 0x112DF | константная таблица (все значения 128)" MAP 0x112DF RL_GRID_D8 0 CM_IDENTITY 0 255
 /begin AXIS_DESCR FIX_AXIS NO_INPUT_QUANTITY CM_IDENTITY 4 0 3 FIX_AXIS_PAR_DIST 0 1 4 /end AXIS_DESCR
 /begin AXIS_DESCR FIX_AXIS NO_INPUT_QUANTITY CM_IDENTITY 49 0 48 FIX_AXIS_PAR_DIST 0 1 49 /end AXIS_DESCR
/end CHARACTERISTIC
/begin CHARACTERISTIC MAP_026_113A3_14x14 "вероятная | mapscan | адрес 0x113A3, данные 0x113C1" MAP 0x113A3 RL_3D_A8_D16 0 CM_IDENTITY 0 65535 /begin AXIS_DESCR STD_AXIS NO_INPUT_QUANTITY CM_IDENTITY 14 0 255 /end AXIS_DESCR /begin AXIS_DESCR STD_AXIS NO_INPUT_QUANTITY CM_IDENTITY 14 0 255 /end AXIS_DESCR /end CHARACTERISTIC
/begin CHARACTERISTIC MAP_027_11567_8 "вероятная | mapscan | адрес 0x11567, данные 0x11570" CURVE 0x11567 RL_2D_A8_D8 0 CM_IDENTITY 0 255 /begin AXIS_DESCR STD_AXIS NO_INPUT_QUANTITY CM_IDENTITY 8 0 255 /end AXIS_DESCR /end CHARACTERISTIC
/begin CHARACTERISTIC MAP_028_11580_6 "вероятная | mapscan | адрес 0x11580, данные 0x11587" CURVE 0x11580 RL_2D_A8_D8 0 CM_IDENTITY 0 255 /begin AXIS_DESCR STD_AXIS NO_INPUT_QUANTITY CM_IDENTITY 6 0 255 /end AXIS_DESCR /end CHARACTERISTIC
/begin CHARACTERISTIC MAP_029_11595_8 "вероятная | mapscan | адрес 0x11595, данные 0x1159E" CURVE 0x11595 RL_2D_A8_D8 0 CM_IDENTITY 0 255 /begin AXIS_DESCR STD_AXIS NO_INPUT_QUANTITY CM_IDENTITY 8 0 255 /end AXIS_DESCR /end CHARACTERISTIC
/begin CHARACTERISTIC MAP_030_115EC_7 "вероятная | mapscan | адрес 0x115EC, данные 0x115F4" CURVE 0x115EC RL_2D_A8_D8 0 CM_IDENTITY 0 255 /begin AXIS_DESCR STD_AXIS NO_INPUT_QUANTITY CM_IDENTITY 7 0 255 /end AXIS_DESCR /end CHARACTERISTIC
/begin CHARACTERISTIC MAP_031_115FB_7 "вероятная | mapscan | адрес 0x115FB, данные 0x11603" CURVE 0x115FB RL_2D_A8_D8 0 CM_IDENTITY 0 255 /begin AXIS_DESCR STD_AXIS NO_INPUT_QUANTITY CM_IDENTITY 7 0 255 /end AXIS_DESCR /end CHARACTERISTIC
/begin CHARACTERISTIC MAP_032_11616_8 "вероятная | mapscan | адрес 0x11616, данные 0x1161F" CURVE 0x11616 RL_2D_A8_D8 0 CM_IDENTITY 0 255 /begin AXIS_DESCR STD_AXIS NO_INPUT_QUANTITY CM_IDENTITY 8 0 255 /end AXIS_DESCR /end CHARACTERISTIC
/begin CHARACTERISTIC MAP_033_11673_6 "вероятная | mapscan | адрес 0x11673, данные 0x1167A" CURVE 0x11673 RL_2D_A8_D8 0 CM_IDENTITY 0 255 /begin AXIS_DESCR STD_AXIS NO_INPUT_QUANTITY CM_IDENTITY 6 0 255 /end AXIS_DESCR /end CHARACTERISTIC
/begin CHARACTERISTIC MAP_034_1168B_6 "вероятная | mapscan | адрес 0x1168B, данные 0x11692" CURVE 0x1168B RL_2D_A8_D8 0 CM_IDENTITY 0 255 /begin AXIS_DESCR STD_AXIS NO_INPUT_QUANTITY CM_IDENTITY 6 0 255 /end AXIS_DESCR /end CHARACTERISTIC
/begin CHARACTERISTIC MAP_035_11698_12 "вероятная | mapscan | адрес 0x11698, данные 0x116A5" CURVE 0x11698 RL_2D_A8_D8 0 CM_IDENTITY 0 255 /begin AXIS_DESCR STD_AXIS NO_INPUT_QUANTITY CM_IDENTITY 12 0 255 /end AXIS_DESCR /end CHARACTERISTIC
/begin CHARACTERISTIC MAP_036_116B2_6x6 "вероятная | mapscan | адрес 0x116B2, данные 0x116C0" MAP 0x116B2 RL_3D_A8_D8 0 CM_IDENTITY 0 255 /begin AXIS_DESCR STD_AXIS NO_INPUT_QUANTITY CM_IDENTITY 6 0 255 /end AXIS_DESCR /begin AXIS_DESCR STD_AXIS NO_INPUT_QUANTITY CM_IDENTITY 6 0 255 /end AXIS_DESCR /end CHARACTERISTIC
/begin CHARACTERISTIC MAP_037_116E5_4 "вероятная | mapscan | адрес 0x116E5, данные 0x116EA" CURVE 0x116E5 RL_2D_A8_D8 0 CM_IDENTITY 0 255 /begin AXIS_DESCR STD_AXIS NO_INPUT_QUANTITY CM_IDENTITY 4 0 255 /end AXIS_DESCR /end CHARACTERISTIC
/begin CHARACTERISTIC MAP_038_116FE_12x6 "вероятная | mapscan | адрес 0x116FE, данные 0x11712" MAP 0x116FE RL_3D_A8_D8 0 CM_IDENTITY 0 255 /begin AXIS_DESCR STD_AXIS NO_INPUT_QUANTITY CM_IDENTITY 12 0 255 /end AXIS_DESCR /begin AXIS_DESCR STD_AXIS NO_INPUT_QUANTITY CM_IDENTITY 6 0 255 /end AXIS_DESCR /end CHARACTERISTIC
/begin CHARACTERISTIC MAP_039_1175A_8 "вероятная | mapscan | адрес 0x1175A, данные 0x11763" CURVE 0x1175A RL_2D_A8_D8 0 CM_IDENTITY 0 255 /begin AXIS_DESCR STD_AXIS NO_INPUT_QUANTITY CM_IDENTITY 8 0 255 /end AXIS_DESCR /end CHARACTERISTIC
/begin CHARACTERISTIC MAP_040_117D4_4 "вероятная | mapscan | адрес 0x117D4, данные 0x117D9" CURVE 0x117D4 RL_2D_A8_D16 0 CM_IDENTITY 0 65535 /begin AXIS_DESCR STD_AXIS NO_INPUT_QUANTITY CM_IDENTITY 4 0 255 /end AXIS_DESCR /end CHARACTERISTIC
/begin CHARACTERISTIC MAP_041_11986_5x6 "вероятная | mapscan | адрес 0x11986, данные 0x11993" MAP 0x11986 RL_3D_A8_D8 0 CM_IDENTITY 0 255 /begin AXIS_DESCR STD_AXIS NO_INPUT_QUANTITY CM_IDENTITY 5 0 255 /end AXIS_DESCR /begin AXIS_DESCR STD_AXIS NO_INPUT_QUANTITY CM_IDENTITY 6 0 255 /end AXIS_DESCR /end CHARACTERISTIC
/begin CHARACTERISTIC MAP_042_11A1A_6 "вероятная | mapscan | адрес 0x11A1A, данные 0x11A21" CURVE 0x11A1A RL_2D_A8_D8 0 CM_IDENTITY 0 255 /begin AXIS_DESCR STD_AXIS NO_INPUT_QUANTITY CM_IDENTITY 6 0 255 /end AXIS_DESCR /end CHARACTERISTIC
/begin CHARACTERISTIC MAP_043_11A2E_6 "вероятная | mapscan | адрес 0x11A2E, данные 0x11A35" CURVE 0x11A2E RL_2D_A8_D8 0 CM_IDENTITY 0 255 /begin AXIS_DESCR STD_AXIS NO_INPUT_QUANTITY CM_IDENTITY 6 0 255 /end AXIS_DESCR /end CHARACTERISTIC
/begin CHARACTERISTIC MAP_044_11A40_10x10 "вероятная | mapscan | адрес 0x11A40, данные 0x11A56" MAP 0x11A40 RL_3D_A8_D8 0 CM_IDENTITY 0 255 /begin AXIS_DESCR STD_AXIS NO_INPUT_QUANTITY CM_IDENTITY 10 0 255 /end AXIS_DESCR /begin AXIS_DESCR STD_AXIS NO_INPUT_QUANTITY CM_IDENTITY 10 0 255 /end AXIS_DESCR /end CHARACTERISTIC
/begin CHARACTERISTIC MAP_045_11AD4_16x12 "вероятная | mapscan | адрес 0x11AD4, данные 0x11AF2" MAP 0x11AD4 RL_3D_A8_D16 0 CM_IDENTITY 0 65535 /begin AXIS_DESCR STD_AXIS NO_INPUT_QUANTITY CM_IDENTITY 16 0 255 /end AXIS_DESCR /begin AXIS_DESCR STD_AXIS NO_INPUT_QUANTITY CM_IDENTITY 12 0 255 /end AXIS_DESCR /end CHARACTERISTIC
/begin CHARACTERISTIC MAP_046_11F22_8 "вероятная | mapscan | адрес 0x11F22, данные 0x11F2B" CURVE 0x11F22 RL_2D_A8_D8 0 CM_IDENTITY 0 255 /begin AXIS_DESCR STD_AXIS NO_INPUT_QUANTITY CM_IDENTITY 8 0 255 /end AXIS_DESCR /end CHARACTERISTIC
/begin CHARACTERISTIC GRID_047_12146_4x32 "вероятная | gridscan | адрес 0x12146, данные 0x12146 | константная таблица (все значения 127)" MAP 0x12146 RL_GRID_D8 0 CM_IDENTITY 0 255
 /begin AXIS_DESCR FIX_AXIS NO_INPUT_QUANTITY CM_IDENTITY 4 0 3 FIX_AXIS_PAR_DIST 0 1 4 /end AXIS_DESCR
 /begin AXIS_DESCR FIX_AXIS NO_INPUT_QUANTITY CM_IDENTITY 32 0 31 FIX_AXIS_PAR_DIST 0 1 32 /end AXIS_DESCR
/end CHARACTERISTIC
/begin CHARACTERISTIC GRID_048_1236B_4x32 "вероятная | gridscan | адрес 0x1236B, данные 0x1236B | константная таблица (все значения 127)" MAP 0x1236B RL_GRID_D8 0 CM_IDENTITY 0 255
 /begin AXIS_DESCR FIX_AXIS NO_INPUT_QUANTITY CM_IDENTITY 4 0 3 FIX_AXIS_PAR_DIST 0 1 4 /end AXIS_DESCR
 /begin AXIS_DESCR FIX_AXIS NO_INPUT_QUANTITY CM_IDENTITY 32 0 31 FIX_AXIS_PAR_DIST 0 1 32 /end AXIS_DESCR
/end CHARACTERISTIC
/begin CHARACTERISTIC MAP_049_124D4_6 "вероятная | mapscan | адрес 0x124D4, данные 0x124DB" CURVE 0x124D4 RL_2D_A8_D8 0 CM_IDENTITY 0 255 /begin AXIS_DESCR STD_AXIS NO_INPUT_QUANTITY CM_IDENTITY 6 0 255 /end AXIS_DESCR /end CHARACTERISTIC
/begin CHARACTERISTIC MAP_050_128BD_21 "вероятная | mapscan | адрес 0x128BD, данные 0x128E8" CURVE 0x128BD RL_2D_A16_D16 0 CM_IDENTITY 0 65535 /begin AXIS_DESCR STD_AXIS NO_INPUT_QUANTITY CM_IDENTITY 21 0 65535 /end AXIS_DESCR /end CHARACTERISTIC
/begin CHARACTERISTIC MAP_051_14915_6 "вероятная | mapscan | адрес 0x14915, данные 0x14922" CURVE 0x14915 RL_2D_A16_D16 0 CM_IDENTITY 0 65535 /begin AXIS_DESCR STD_AXIS NO_INPUT_QUANTITY CM_IDENTITY 6 0 65535 /end AXIS_DESCR /end CHARACTERISTIC
/begin CHARACTERISTIC MAP_052_14998_10 "вероятная | mapscan | адрес 0x14998, данные 0x149A3" CURVE 0x14998 RL_2D_A8_D16 0 CM_IDENTITY 0 65535 /begin AXIS_DESCR STD_AXIS NO_INPUT_QUANTITY CM_IDENTITY 10 0 255 /end AXIS_DESCR /end CHARACTERISTIC
/begin CHARACTERISTIC MAP_053_149B8_10 "вероятная | mapscan | адрес 0x149B8, данные 0x149C3" CURVE 0x149B8 RL_2D_A8_D16 0 CM_IDENTITY 0 65535 /begin AXIS_DESCR STD_AXIS NO_INPUT_QUANTITY CM_IDENTITY 10 0 255 /end AXIS_DESCR /end CHARACTERISTIC
/begin CHARACTERISTIC MAP_054_149D8_10 "вероятная | mapscan | адрес 0x149D8, данные 0x149E3" CURVE 0x149D8 RL_2D_A8_D16 0 CM_IDENTITY 0 65535 /begin AXIS_DESCR STD_AXIS NO_INPUT_QUANTITY CM_IDENTITY 10 0 255 /end AXIS_DESCR /end CHARACTERISTIC
/begin CHARACTERISTIC MAP_055_14A11_10 "вероятная | mapscan | адрес 0x14A11, данные 0x14A26" CURVE 0x14A11 RL_2D_A16_D16 0 CM_IDENTITY 0 65535 /begin AXIS_DESCR STD_AXIS NO_INPUT_QUANTITY CM_IDENTITY 10 0 65535 /end AXIS_DESCR /end CHARACTERISTIC
/begin CHARACTERISTIC MAP_056_14BC5_12 "вероятная | mapscan | адрес 0x14BC5, данные 0x14BDE" CURVE 0x14BC5 RL_2D_A16_D16 0 CM_IDENTITY 0 65535 /begin AXIS_DESCR STD_AXIS NO_INPUT_QUANTITY CM_IDENTITY 12 0 65535 /end AXIS_DESCR /end CHARACTERISTIC
/begin CHARACTERISTIC MAP_057_14BFB_5 "вероятная | mapscan | адрес 0x14BFB, данные 0x14C06" CURVE 0x14BFB RL_2D_A16_D16 0 CM_IDENTITY 0 65535 /begin AXIS_DESCR STD_AXIS NO_INPUT_QUANTITY CM_IDENTITY 5 0 65535 /end AXIS_DESCR /end CHARACTERISTIC
/begin CHARACTERISTIC MAP_058_14C2D_4 "вероятная | mapscan | адрес 0x14C2D, данные 0x14C36" CURVE 0x14C2D RL_2D_A16_D16 0 CM_IDENTITY 0 65535 /begin AXIS_DESCR STD_AXIS NO_INPUT_QUANTITY CM_IDENTITY 4 0 65535 /end AXIS_DESCR /end CHARACTERISTIC
/begin CHARACTERISTIC MAP_059_14C45_4 "вероятная | mapscan | адрес 0x14C45, данные 0x14C4E" CURVE 0x14C45 RL_2D_A16_D16 0 CM_IDENTITY 0 65535 /begin AXIS_DESCR STD_AXIS NO_INPUT_QUANTITY CM_IDENTITY 4 0 65535 /end AXIS_DESCR /end CHARACTERISTIC
/begin CHARACTERISTIC MAP_060_14C5D_4 "вероятная | mapscan | адрес 0x14C5D, данные 0x14C66" CURVE 0x14C5D RL_2D_A16_D16 0 CM_IDENTITY 0 65535 /begin AXIS_DESCR STD_AXIS NO_INPUT_QUANTITY CM_IDENTITY 4 0 65535 /end AXIS_DESCR /end CHARACTERISTIC
/begin CHARACTERISTIC MAP_061_14C75_4 "вероятная | mapscan | адрес 0x14C75, данные 0x14C7E" CURVE 0x14C75 RL_2D_A16_D16 0 CM_IDENTITY 0 65535 /begin AXIS_DESCR STD_AXIS NO_INPUT_QUANTITY CM_IDENTITY 4 0 65535 /end AXIS_DESCR /end CHARACTERISTIC
/begin CHARACTERISTIC MAP_062_14C8D_4 "вероятная | mapscan | адрес 0x14C8D, данные 0x14C96" CURVE 0x14C8D RL_2D_A16_D16 0 CM_IDENTITY 0 65535 /begin AXIS_DESCR STD_AXIS NO_INPUT_QUANTITY CM_IDENTITY 4 0 65535 /end AXIS_DESCR /end CHARACTERISTIC
/begin CHARACTERISTIC MAP_063_14CA5_4 "вероятная | mapscan | адрес 0x14CA5, данные 0x14CAE" CURVE 0x14CA5 RL_2D_A16_D16 0 CM_IDENTITY 0 65535 /begin AXIS_DESCR STD_AXIS NO_INPUT_QUANTITY CM_IDENTITY 4 0 65535 /end AXIS_DESCR /end CHARACTERISTIC
/begin CHARACTERISTIC MAP_064_14CBD_4 "вероятная | mapscan | адрес 0x14CBD, данные 0x14CC6" CURVE 0x14CBD RL_2D_A16_D16 0 CM_IDENTITY 0 65535 /begin AXIS_DESCR STD_AXIS NO_INPUT_QUANTITY CM_IDENTITY 4 0 65535 /end AXIS_DESCR /end CHARACTERISTIC
/begin CHARACTERISTIC MAP_065_14CD5_4 "вероятная | mapscan | адрес 0x14CD5, данные 0x14CDE" CURVE 0x14CD5 RL_2D_A16_D16 0 CM_IDENTITY 0 65535 /begin AXIS_DESCR STD_AXIS NO_INPUT_QUANTITY CM_IDENTITY 4 0 65535 /end AXIS_DESCR /end CHARACTERISTIC
/begin CHARACTERISTIC MAP_066_14CED_4 "вероятная | mapscan | адрес 0x14CED, данные 0x14CF6" CURVE 0x14CED RL_2D_A16_D16 0 CM_IDENTITY 0 65535 /begin AXIS_DESCR STD_AXIS NO_INPUT_QUANTITY CM_IDENTITY 4 0 65535 /end AXIS_DESCR /end CHARACTERISTIC
/begin CHARACTERISTIC MAP_067_14D05_4 "вероятная | mapscan | адрес 0x14D05, данные 0x14D0E" CURVE 0x14D05 RL_2D_A16_D16 0 CM_IDENTITY 0 65535 /begin AXIS_DESCR STD_AXIS NO_INPUT_QUANTITY CM_IDENTITY 4 0 65535 /end AXIS_DESCR /end CHARACTERISTIC
/begin CHARACTERISTIC MAP_068_14D1D_4 "вероятная | mapscan | адрес 0x14D1D, данные 0x14D26" CURVE 0x14D1D RL_2D_A16_D16 0 CM_IDENTITY 0 65535 /begin AXIS_DESCR STD_AXIS NO_INPUT_QUANTITY CM_IDENTITY 4 0 65535 /end AXIS_DESCR /end CHARACTERISTIC
/begin CHARACTERISTIC MAP_069_14D35_4 "вероятная | mapscan | адрес 0x14D35, данные 0x14D3E" CURVE 0x14D35 RL_2D_A16_D16 0 CM_IDENTITY 0 65535 /begin AXIS_DESCR STD_AXIS NO_INPUT_QUANTITY CM_IDENTITY 4 0 65535 /end AXIS_DESCR /end CHARACTERISTIC
/begin CHARACTERISTIC MAP_070_14D4D_4 "вероятная | mapscan | адрес 0x14D4D, данные 0x14D56" CURVE 0x14D4D RL_2D_A16_D16 0 CM_IDENTITY 0 65535 /begin AXIS_DESCR STD_AXIS NO_INPUT_QUANTITY CM_IDENTITY 4 0 65535 /end AXIS_DESCR /end CHARACTERISTIC
/begin CHARACTERISTIC MAP_071_14D65_4 "вероятная | mapscan | адрес 0x14D65, данные 0x14D6E" CURVE 0x14D65 RL_2D_A16_D16 0 CM_IDENTITY 0 65535 /begin AXIS_DESCR STD_AXIS NO_INPUT_QUANTITY CM_IDENTITY 4 0 65535 /end AXIS_DESCR /end CHARACTERISTIC
/begin CHARACTERISTIC MAP_072_14DA4_16 "вероятная | mapscan | адрес 0x14DA4, данные 0x14DB5" CURVE 0x14DA4 RL_2D_A8_D16 0 CM_IDENTITY 0 65535 /begin AXIS_DESCR STD_AXIS NO_INPUT_QUANTITY CM_IDENTITY 16 0 255 /end AXIS_DESCR /end CHARACTERISTIC
/begin CHARACTERISTIC MAP_073_14E82_16 "вероятная | mapscan | адрес 0x14E82, данные 0x14E93" CURVE 0x14E82 RL_2D_A8_D16 0 CM_IDENTITY 0 65535 /begin AXIS_DESCR STD_AXIS NO_INPUT_QUANTITY CM_IDENTITY 16 0 255 /end AXIS_DESCR /end CHARACTERISTIC
/begin CHARACTERISTIC MAP_074_14F60_8 "вероятная | mapscan | адрес 0x14F60, данные 0x14F69" CURVE 0x14F60 RL_2D_A8_D16 0 CM_IDENTITY 0 65535 /begin AXIS_DESCR STD_AXIS NO_INPUT_QUANTITY CM_IDENTITY 8 0 255 /end AXIS_DESCR /end CHARACTERISTIC
/begin CHARACTERISTIC MAP_075_14F7F_6 "вероятная | mapscan | адрес 0x14F7F, данные 0x14F86" CURVE 0x14F7F RL_2D_A8_D8 0 CM_IDENTITY 0 255 /begin AXIS_DESCR STD_AXIS NO_INPUT_QUANTITY CM_IDENTITY 6 0 255 /end AXIS_DESCR /end CHARACTERISTIC
/begin CHARACTERISTIC GRID_076_14F96_6x16 "вероятная | gridscan | адрес 0x14F96, данные 0x14F96" MAP 0x14F96 RL_GRID_D8 0 CM_IDENTITY 0 255
 /begin AXIS_DESCR FIX_AXIS NO_INPUT_QUANTITY CM_IDENTITY 6 0 5 FIX_AXIS_PAR_DIST 0 1 6 /end AXIS_DESCR
 /begin AXIS_DESCR FIX_AXIS NO_INPUT_QUANTITY CM_IDENTITY 16 0 15 FIX_AXIS_PAR_DIST 0 1 16 /end AXIS_DESCR
/end CHARACTERISTIC
/begin CHARACTERISTIC MAP_077_14FF7_5 "вероятная | mapscan | адрес 0x14FF7, данные 0x14FFD" CURVE 0x14FF7 RL_2D_A8_D8 0 CM_IDENTITY 0 255 /begin AXIS_DESCR STD_AXIS NO_INPUT_QUANTITY CM_IDENTITY 5 0 255 /end AXIS_DESCR /end CHARACTERISTIC
/begin CHARACTERISTIC MAP_078_15005_6 "вероятная | mapscan | адрес 0x15005, данные 0x1500C" CURVE 0x15005 RL_2D_A8_D8 0 CM_IDENTITY 0 255 /begin AXIS_DESCR STD_AXIS NO_INPUT_QUANTITY CM_IDENTITY 6 0 255 /end AXIS_DESCR /end CHARACTERISTIC
/begin CHARACTERISTIC MAP_079_15037_6 "вероятная | mapscan | адрес 0x15037, данные 0x1503E" CURVE 0x15037 RL_2D_A8_D8 0 CM_IDENTITY 0 255 /begin AXIS_DESCR STD_AXIS NO_INPUT_QUANTITY CM_IDENTITY 6 0 255 /end AXIS_DESCR /end CHARACTERISTIC
/begin CHARACTERISTIC MAP_080_15137_6 "вероятная | mapscan | адрес 0x15137, данные 0x15144" CURVE 0x15137 RL_2D_A16_D16 0 CM_IDENTITY 0 65535 /begin AXIS_DESCR STD_AXIS NO_INPUT_QUANTITY CM_IDENTITY 6 0 65535 /end AXIS_DESCR /end CHARACTERISTIC
/begin CHARACTERISTIC MAP_081_15261_6 "вероятная | mapscan | адрес 0x15261, данные 0x1526E" CURVE 0x15261 RL_2D_A16_D16 0 CM_IDENTITY 0 65535 /begin AXIS_DESCR STD_AXIS NO_INPUT_QUANTITY CM_IDENTITY 6 0 65535 /end AXIS_DESCR /end CHARACTERISTIC
/begin CHARACTERISTIC MAP_082_15281_6 "вероятная | mapscan | адрес 0x15281, данные 0x1528E" CURVE 0x15281 RL_2D_A16_D16 0 CM_IDENTITY 0 65535 /begin AXIS_DESCR STD_AXIS NO_INPUT_QUANTITY CM_IDENTITY 6 0 65535 /end AXIS_DESCR /end CHARACTERISTIC
/begin CHARACTERISTIC MAP_083_152A1_6x7 "вероятная | mapscan | адрес 0x152A1, данные 0x152BD" MAP 0x152A1 RL_3D_A16_D16 0 CM_IDENTITY 0 65535 /begin AXIS_DESCR STD_AXIS NO_INPUT_QUANTITY CM_IDENTITY 6 0 65535 /end AXIS_DESCR /begin AXIS_DESCR STD_AXIS NO_INPUT_QUANTITY CM_IDENTITY 7 0 65535 /end AXIS_DESCR /end CHARACTERISTIC
/begin CHARACTERISTIC MAP_084_15311_7 "вероятная | mapscan | адрес 0x15311, данные 0x15320" CURVE 0x15311 RL_2D_A16_D16 0 CM_IDENTITY 0 65535 /begin AXIS_DESCR STD_AXIS NO_INPUT_QUANTITY CM_IDENTITY 7 0 65535 /end AXIS_DESCR /end CHARACTERISTIC
/begin CHARACTERISTIC MAP_085_15331_7 "вероятная | mapscan | адрес 0x15331, данные 0x15340" CURVE 0x15331 RL_2D_A16_D16 0 CM_IDENTITY 0 65535 /begin AXIS_DESCR STD_AXIS NO_INPUT_QUANTITY CM_IDENTITY 7 0 65535 /end AXIS_DESCR /end CHARACTERISTIC
/begin CHARACTERISTIC MAP_086_15362_8x24 "вероятная | mapscan | адрес 0x15362, данные 0x153A4" MAP 0x15362 RL_3D_A16_D16 0 CM_IDENTITY 0 65535 /begin AXIS_DESCR STD_AXIS NO_INPUT_QUANTITY CM_IDENTITY 8 0 65535 /end AXIS_DESCR /begin AXIS_DESCR STD_AXIS NO_INPUT_QUANTITY CM_IDENTITY 24 0 65535 /end AXIS_DESCR /end CHARACTERISTIC
/begin CHARACTERISTIC MAP_087_15528_12 "вероятная | mapscan | адрес 0x15528, данные 0x15541" CURVE 0x15528 RL_2D_A16_D16 0 CM_IDENTITY 0 65535 /begin AXIS_DESCR STD_AXIS NO_INPUT_QUANTITY CM_IDENTITY 12 0 65535 /end AXIS_DESCR /end CHARACTERISTIC
/begin CHARACTERISTIC MAP_088_15559_16 "вероятная | mapscan | адрес 0x15559, данные 0x1557A" CURVE 0x15559 RL_2D_A16_D16 0 CM_IDENTITY 0 65535 /begin AXIS_DESCR STD_AXIS NO_INPUT_QUANTITY CM_IDENTITY 16 0 65535 /end AXIS_DESCR /end CHARACTERISTIC
/begin CHARACTERISTIC MAP_089_1559A_20x32 "вероятная | mapscan | адрес 0x1559A, данные 0x15604" MAP 0x1559A RL_3D_A16_D16 0 CM_IDENTITY 0 65535 /begin AXIS_DESCR STD_AXIS NO_INPUT_QUANTITY CM_IDENTITY 20 0 65535 /end AXIS_DESCR /begin AXIS_DESCR STD_AXIS NO_INPUT_QUANTITY CM_IDENTITY 32 0 65535 /end AXIS_DESCR /end CHARACTERISTIC
/begin CHARACTERISTIC MAP_090_15BCB_7 "вероятная | mapscan | адрес 0x15BCB, данные 0x15BDA" CURVE 0x15BCB RL_2D_A16_D16 0 CM_IDENTITY 0 65535 /begin AXIS_DESCR STD_AXIS NO_INPUT_QUANTITY CM_IDENTITY 7 0 65535 /end AXIS_DESCR /end CHARACTERISTIC
/begin CHARACTERISTIC MAP_091_15C2D_7 "вероятная | mapscan | адрес 0x15C2D, данные 0x15C3C" CURVE 0x15C2D RL_2D_A16_D16 0 CM_IDENTITY 0 65535 /begin AXIS_DESCR STD_AXIS NO_INPUT_QUANTITY CM_IDENTITY 7 0 65535 /end AXIS_DESCR /end CHARACTERISTIC
/begin CHARACTERISTIC MAP_092_15F6B_4 "вероятная | mapscan | адрес 0x15F6B, данные 0x15F74" CURVE 0x15F6B RL_2D_A16_D8 0 CM_IDENTITY 0 255 /begin AXIS_DESCR STD_AXIS NO_INPUT_QUANTITY CM_IDENTITY 4 0 65535 /end AXIS_DESCR /end CHARACTERISTIC
/begin CHARACTERISTIC MAP_093_15F88_12 "вероятная | mapscan | адрес 0x15F88, данные 0x15FA1" CURVE 0x15F88 RL_2D_A16_D16 0 CM_IDENTITY 0 65535 /begin AXIS_DESCR STD_AXIS NO_INPUT_QUANTITY CM_IDENTITY 12 0 65535 /end AXIS_DESCR /end CHARACTERISTIC
/begin CHARACTERISTIC GRID_094_15FBC_4x66 "вероятная | gridscan | адрес 0x15FBC, данные 0x15FBC" MAP 0x15FBC RL_GRID_D8 0 CM_IDENTITY 0 255
 /begin AXIS_DESCR FIX_AXIS NO_INPUT_QUANTITY CM_IDENTITY 4 0 3 FIX_AXIS_PAR_DIST 0 1 4 /end AXIS_DESCR
 /begin AXIS_DESCR FIX_AXIS NO_INPUT_QUANTITY CM_IDENTITY 66 0 65 FIX_AXIS_PAR_DIST 0 1 66 /end AXIS_DESCR
/end CHARACTERISTIC
/begin CHARACTERISTIC MAP_095_1611B_4 "вероятная | mapscan | адрес 0x1611B, данные 0x16124" CURVE 0x1611B RL_2D_A16_D16 0 CM_IDENTITY 0 65535 /begin AXIS_DESCR STD_AXIS NO_INPUT_QUANTITY CM_IDENTITY 4 0 65535 /end AXIS_DESCR /end CHARACTERISTIC
/begin CHARACTERISTIC MAP_096_16156_5 "вероятная | mapscan | адрес 0x16156, данные 0x1615C" CURVE 0x16156 RL_2D_A8_D16 0 CM_IDENTITY 0 65535 /begin AXIS_DESCR STD_AXIS NO_INPUT_QUANTITY CM_IDENTITY 5 0 255 /end AXIS_DESCR /end CHARACTERISTIC
/begin CHARACTERISTIC GRID_097_1637C_16x7 "вероятная | gridscan | адрес 0x1637C, данные 0x1637C" MAP 0x1637C RL_GRID_D8 0 CM_IDENTITY 0 255
 /begin AXIS_DESCR FIX_AXIS NO_INPUT_QUANTITY CM_IDENTITY 16 0 15 FIX_AXIS_PAR_DIST 0 1 16 /end AXIS_DESCR
 /begin AXIS_DESCR FIX_AXIS NO_INPUT_QUANTITY CM_IDENTITY 7 0 6 FIX_AXIS_PAR_DIST 0 1 7 /end AXIS_DESCR
/end CHARACTERISTIC
/begin CHARACTERISTIC MAP_098_181AD_6 "вероятная | mapscan | адрес 0x181AD, данные 0x181B4" CURVE 0x181AD RL_2D_A8_D8 0 CM_IDENTITY 0 255 /begin AXIS_DESCR STD_AXIS NO_INPUT_QUANTITY CM_IDENTITY 6 0 255 /end AXIS_DESCR /end CHARACTERISTIC
/begin CHARACTERISTIC MAP_099_181BF_4 "вероятная | mapscan | адрес 0x181BF, данные 0x181C4" CURVE 0x181BF RL_2D_A8_D8 0 CM_IDENTITY 0 255 /begin AXIS_DESCR STD_AXIS NO_INPUT_QUANTITY CM_IDENTITY 4 0 255 /end AXIS_DESCR /end CHARACTERISTIC
/begin CHARACTERISTIC MAP_100_181C8_6 "вероятная | mapscan | адрес 0x181C8, данные 0x181CF" CURVE 0x181C8 RL_2D_A8_D8 0 CM_IDENTITY 0 255 /begin AXIS_DESCR STD_AXIS NO_INPUT_QUANTITY CM_IDENTITY 6 0 255 /end AXIS_DESCR /end CHARACTERISTIC
/begin CHARACTERISTIC MAP_101_181D6_6 "вероятная | mapscan | адрес 0x181D6, данные 0x181DD" CURVE 0x181D6 RL_2D_A8_D8 0 CM_IDENTITY 0 255 /begin AXIS_DESCR STD_AXIS NO_INPUT_QUANTITY CM_IDENTITY 6 0 255 /end AXIS_DESCR /end CHARACTERISTIC
/begin CHARACTERISTIC MAP_102_181E4_7 "вероятная | mapscan | адрес 0x181E4, данные 0x181EC" CURVE 0x181E4 RL_2D_A8_D8 0 CM_IDENTITY 0 255 /begin AXIS_DESCR STD_AXIS NO_INPUT_QUANTITY CM_IDENTITY 7 0 255 /end AXIS_DESCR /end CHARACTERISTIC
/begin CHARACTERISTIC MAP_103_181F7_16 "вероятная | mapscan | адрес 0x181F7, данные 0x18208" CURVE 0x181F7 RL_2D_A8_D8 0 CM_IDENTITY 0 255 /begin AXIS_DESCR STD_AXIS NO_INPUT_QUANTITY CM_IDENTITY 16 0 255 /end AXIS_DESCR /end CHARACTERISTIC
/begin CHARACTERISTIC MAP_104_18219_4 "вероятная | mapscan | адрес 0x18219, данные 0x1821E" CURVE 0x18219 RL_2D_A8_D16 0 CM_IDENTITY 0 65535 /begin AXIS_DESCR STD_AXIS NO_INPUT_QUANTITY CM_IDENTITY 4 0 255 /end AXIS_DESCR /end CHARACTERISTIC
/begin CHARACTERISTIC MAP_105_18234_4 "вероятная | mapscan | адрес 0x18234, данные 0x1823D" CURVE 0x18234 RL_2D_A16_D8 0 CM_IDENTITY 0 255 /begin AXIS_DESCR STD_AXIS NO_INPUT_QUANTITY CM_IDENTITY 4 0 65535 /end AXIS_DESCR /end CHARACTERISTIC
/begin CHARACTERISTIC MAP_106_18242_4 "вероятная | mapscan | адрес 0x18242, данные 0x18247" CURVE 0x18242 RL_2D_A8_D8 0 CM_IDENTITY 0 255 /begin AXIS_DESCR STD_AXIS NO_INPUT_QUANTITY CM_IDENTITY 4 0 255 /end AXIS_DESCR /end CHARACTERISTIC
/begin CHARACTERISTIC MAP_107_18253_6 "вероятная | mapscan | адрес 0x18253, данные 0x1825A" CURVE 0x18253 RL_2D_A8_D8 0 CM_IDENTITY 0 255 /begin AXIS_DESCR STD_AXIS NO_INPUT_QUANTITY CM_IDENTITY 6 0 255 /end AXIS_DESCR /end CHARACTERISTIC
/begin CHARACTERISTIC MAP_108_18261_8 "вероятная | mapscan | адрес 0x18261, данные 0x1826A" CURVE 0x18261 RL_2D_A8_D8 0 CM_IDENTITY 0 255 /begin AXIS_DESCR STD_AXIS NO_INPUT_QUANTITY CM_IDENTITY 8 0 255 /end AXIS_DESCR /end CHARACTERISTIC
/begin CHARACTERISTIC MAP_109_18273_9 "вероятная | mapscan | адрес 0x18273, данные 0x1827D" CURVE 0x18273 RL_2D_A8_D8 0 CM_IDENTITY 0 255 /begin AXIS_DESCR STD_AXIS NO_INPUT_QUANTITY CM_IDENTITY 9 0 255 /end AXIS_DESCR /end CHARACTERISTIC
/begin CHARACTERISTIC MAP_110_1828A_6 "вероятная | mapscan | адрес 0x1828A, данные 0x18291" CURVE 0x1828A RL_2D_A8_D8 0 CM_IDENTITY 0 255 /begin AXIS_DESCR STD_AXIS NO_INPUT_QUANTITY CM_IDENTITY 6 0 255 /end AXIS_DESCR /end CHARACTERISTIC
/begin CHARACTERISTIC MAP_111_182CD_11 "вероятная | mapscan | адрес 0x182CD, данные 0x182D9" CURVE 0x182CD RL_2D_A8_D8 0 CM_IDENTITY 0 255 /begin AXIS_DESCR STD_AXIS NO_INPUT_QUANTITY CM_IDENTITY 11 0 255 /end AXIS_DESCR /end CHARACTERISTIC
/begin CHARACTERISTIC MAP_112_1847C_8 "вероятная | mapscan | адрес 0x1847C, данные 0x18485" CURVE 0x1847C RL_2D_A8_D8 0 CM_IDENTITY 0 255 /begin AXIS_DESCR STD_AXIS NO_INPUT_QUANTITY CM_IDENTITY 8 0 255 /end AXIS_DESCR /end CHARACTERISTIC
/begin CHARACTERISTIC MAP_113_1848D_6 "вероятная | mapscan | адрес 0x1848D, данные 0x18494" CURVE 0x1848D RL_2D_A8_D16 0 CM_IDENTITY 0 65535 /begin AXIS_DESCR STD_AXIS NO_INPUT_QUANTITY CM_IDENTITY 6 0 255 /end AXIS_DESCR /end CHARACTERISTIC
/begin CHARACTERISTIC MAP_114_184C8_8 "вероятная | mapscan | адрес 0x184C8, данные 0x184D1" CURVE 0x184C8 RL_2D_A8_D8 0 CM_IDENTITY 0 255 /begin AXIS_DESCR STD_AXIS NO_INPUT_QUANTITY CM_IDENTITY 8 0 255 /end AXIS_DESCR /end CHARACTERISTIC
/begin CHARACTERISTIC MAP_115_184FB_6 "вероятная | mapscan | адрес 0x184FB, данные 0x18502" CURVE 0x184FB RL_2D_A8_D8 0 CM_IDENTITY 0 255 /begin AXIS_DESCR STD_AXIS NO_INPUT_QUANTITY CM_IDENTITY 6 0 255 /end AXIS_DESCR /end CHARACTERISTIC
/begin CHARACTERISTIC MAP_116_18508_6x6 "вероятная | mapscan | адрес 0x18508, данные 0x18516" MAP 0x18508 RL_3D_A8_D8 0 CM_IDENTITY 0 255 /begin AXIS_DESCR STD_AXIS NO_INPUT_QUANTITY CM_IDENTITY 6 0 255 /end AXIS_DESCR /begin AXIS_DESCR STD_AXIS NO_INPUT_QUANTITY CM_IDENTITY 6 0 255 /end AXIS_DESCR /end CHARACTERISTIC
/begin CHARACTERISTIC MAP_117_1854A_5 "вероятная | mapscan | адрес 0x1854A, данные 0x18550" CURVE 0x1854A RL_2D_A8_D8 0 CM_IDENTITY 0 255 /begin AXIS_DESCR STD_AXIS NO_INPUT_QUANTITY CM_IDENTITY 5 0 255 /end AXIS_DESCR /end CHARACTERISTIC
/begin CHARACTERISTIC MAP_118_1856E_8 "вероятная | mapscan | адрес 0x1856E, данные 0x18577" CURVE 0x1856E RL_2D_A8_D8 0 CM_IDENTITY 0 255 /begin AXIS_DESCR STD_AXIS NO_INPUT_QUANTITY CM_IDENTITY 8 0 255 /end AXIS_DESCR /end CHARACTERISTIC
/begin CHARACTERISTIC MAP_119_185E5_8 "вероятная | mapscan | адрес 0x185E5, данные 0x185EE" CURVE 0x185E5 RL_2D_A8_D8 0 CM_IDENTITY 0 255 /begin AXIS_DESCR STD_AXIS NO_INPUT_QUANTITY CM_IDENTITY 8 0 255 /end AXIS_DESCR /end CHARACTERISTIC
/begin CHARACTERISTIC MAP_120_185F6_14 "вероятная | mapscan | адрес 0x185F6, данные 0x18605" CURVE 0x185F6 RL_2D_A8_D8 0 CM_IDENTITY 0 255 /begin AXIS_DESCR STD_AXIS NO_INPUT_QUANTITY CM_IDENTITY 14 0 255 /end AXIS_DESCR /end CHARACTERISTIC
/begin CHARACTERISTIC MAP_121_18613_10x8 "вероятная | mapscan | адрес 0x18613, данные 0x18627" MAP 0x18613 RL_3D_A8_D8 0 CM_IDENTITY 0 255 /begin AXIS_DESCR STD_AXIS NO_INPUT_QUANTITY CM_IDENTITY 10 0 255 /end AXIS_DESCR /begin AXIS_DESCR STD_AXIS NO_INPUT_QUANTITY CM_IDENTITY 8 0 255 /end AXIS_DESCR /end CHARACTERISTIC
/begin CHARACTERISTIC MAP_122_186C7_12 "вероятная | mapscan | адрес 0x186C7, данные 0x186D4" CURVE 0x186C7 RL_2D_A8_D16 0 CM_IDENTITY 0 65535 /begin AXIS_DESCR STD_AXIS NO_INPUT_QUANTITY CM_IDENTITY 12 0 255 /end AXIS_DESCR /end CHARACTERISTIC
/begin CHARACTERISTIC MAP_123_18768_6 "вероятная | mapscan | адрес 0x18768, данные 0x1876F" CURVE 0x18768 RL_2D_A8_D8 0 CM_IDENTITY 0 255 /begin AXIS_DESCR STD_AXIS NO_INPUT_QUANTITY CM_IDENTITY 6 0 255 /end AXIS_DESCR /end CHARACTERISTIC
/begin CHARACTERISTIC MAP_124_1879A_6 "вероятная | mapscan | адрес 0x1879A, данные 0x187A1" CURVE 0x1879A RL_2D_A8_D8 0 CM_IDENTITY 0 255 /begin AXIS_DESCR STD_AXIS NO_INPUT_QUANTITY CM_IDENTITY 6 0 255 /end AXIS_DESCR /end CHARACTERISTIC
/begin CHARACTERISTIC MAP_125_18848_8x8 "вероятная | mapscan | адрес 0x18848, данные 0x1885A" MAP 0x18848 RL_3D_A8_D8 0 CM_IDENTITY 0 255 /begin AXIS_DESCR STD_AXIS NO_INPUT_QUANTITY CM_IDENTITY 8 0 255 /end AXIS_DESCR /begin AXIS_DESCR STD_AXIS NO_INPUT_QUANTITY CM_IDENTITY 8 0 255 /end AXIS_DESCR /end CHARACTERISTIC
/begin CHARACTERISTIC MAP_126_188BF_5 "вероятная | mapscan | адрес 0x188BF, данные 0x188C5" CURVE 0x188BF RL_2D_A8_D8 0 CM_IDENTITY 0 255 /begin AXIS_DESCR STD_AXIS NO_INPUT_QUANTITY CM_IDENTITY 5 0 255 /end AXIS_DESCR /end CHARACTERISTIC
/begin CHARACTERISTIC MAP_127_188CA_5 "вероятная | mapscan | адрес 0x188CA, данные 0x188D0" CURVE 0x188CA RL_2D_A8_D8 0 CM_IDENTITY 0 255 /begin AXIS_DESCR STD_AXIS NO_INPUT_QUANTITY CM_IDENTITY 5 0 255 /end AXIS_DESCR /end CHARACTERISTIC
/begin CHARACTERISTIC MAP_128_188F6_8 "вероятная | mapscan | адрес 0x188F6, данные 0x188FF" CURVE 0x188F6 RL_2D_A8_D16 0 CM_IDENTITY 0 65535 /begin AXIS_DESCR STD_AXIS NO_INPUT_QUANTITY CM_IDENTITY 8 0 255 /end AXIS_DESCR /end CHARACTERISTIC
/begin CHARACTERISTIC MAP_129_1898E_4 "вероятная | mapscan | адрес 0x1898E, данные 0x18997" CURVE 0x1898E RL_2D_A16_D8 0 CM_IDENTITY 0 255 /begin AXIS_DESCR STD_AXIS NO_INPUT_QUANTITY CM_IDENTITY 4 0 65535 /end AXIS_DESCR /end CHARACTERISTIC
/begin CHARACTERISTIC MAP_130_18ABF_8 "вероятная | mapscan | адрес 0x18ABF, данные 0x18AC8" CURVE 0x18ABF RL_2D_A8_D8 0 CM_IDENTITY 0 255 /begin AXIS_DESCR STD_AXIS NO_INPUT_QUANTITY CM_IDENTITY 8 0 255 /end AXIS_DESCR /end CHARACTERISTIC
/begin CHARACTERISTIC MAP_131_18BBA_4 "вероятная | mapscan | адрес 0x18BBA, данные 0x18BC3" CURVE 0x18BBA RL_2D_A16_D8 0 CM_IDENTITY 0 255 /begin AXIS_DESCR STD_AXIS NO_INPUT_QUANTITY CM_IDENTITY 4 0 65535 /end AXIS_DESCR /end CHARACTERISTIC
/begin CHARACTERISTIC MAP_132_18BE9_10 "вероятная | mapscan | адрес 0x18BE9, данные 0x18BF4" CURVE 0x18BE9 RL_2D_A8_D8 0 CM_IDENTITY 0 255 /begin AXIS_DESCR STD_AXIS NO_INPUT_QUANTITY CM_IDENTITY 10 0 255 /end AXIS_DESCR /end CHARACTERISTIC
/begin CHARACTERISTIC MAP_133_18C2A_8 "вероятная | mapscan | адрес 0x18C2A, данные 0x18C33" CURVE 0x18C2A RL_2D_A8_D8 0 CM_IDENTITY 0 255 /begin AXIS_DESCR STD_AXIS NO_INPUT_QUANTITY CM_IDENTITY 8 0 255 /end AXIS_DESCR /end CHARACTERISTIC
/begin CHARACTERISTIC MAP_134_18C7C_8 "вероятная | mapscan | адрес 0x18C7C, данные 0x18C85" CURVE 0x18C7C RL_2D_A8_D8 0 CM_IDENTITY 0 255 /begin AXIS_DESCR STD_AXIS NO_INPUT_QUANTITY CM_IDENTITY 8 0 255 /end AXIS_DESCR /end CHARACTERISTIC
/begin CHARACTERISTIC MAP_135_18CCE_4 "вероятная | mapscan | адрес 0x18CCE, данные 0x18CD3" CURVE 0x18CCE RL_2D_A8_D8 0 CM_IDENTITY 0 255 /begin AXIS_DESCR STD_AXIS NO_INPUT_QUANTITY CM_IDENTITY 4 0 255 /end AXIS_DESCR /end CHARACTERISTIC
/begin CHARACTERISTIC MAP_136_18CE9_8 "вероятная | mapscan | адрес 0x18CE9, данные 0x18CF2" CURVE 0x18CE9 RL_2D_A8_D8 0 CM_IDENTITY 0 255 /begin AXIS_DESCR STD_AXIS NO_INPUT_QUANTITY CM_IDENTITY 8 0 255 /end AXIS_DESCR /end CHARACTERISTIC
/begin CHARACTERISTIC MAP_137_18D3B_8 "вероятная | mapscan | адрес 0x18D3B, данные 0x18D44" CURVE 0x18D3B RL_2D_A8_D8 0 CM_IDENTITY 0 255 /begin AXIS_DESCR STD_AXIS NO_INPUT_QUANTITY CM_IDENTITY 8 0 255 /end AXIS_DESCR /end CHARACTERISTIC
/begin CHARACTERISTIC GRID_138_18E0D_16x8 "вероятная | gridscan | адрес 0x18E0D, данные 0x18E0D" MAP 0x18E0D RL_GRID_D8 0 CM_IDENTITY 0 255
 /begin AXIS_DESCR FIX_AXIS NO_INPUT_QUANTITY CM_IDENTITY 16 0 15 FIX_AXIS_PAR_DIST 0 1 16 /end AXIS_DESCR
 /begin AXIS_DESCR FIX_AXIS NO_INPUT_QUANTITY CM_IDENTITY 8 0 7 FIX_AXIS_PAR_DIST 0 1 8 /end AXIS_DESCR
/end CHARACTERISTIC
/begin CHARACTERISTIC MAP_139_18E8E_4 "вероятная | mapscan | адрес 0x18E8E, данные 0x18E97" CURVE 0x18E8E RL_2D_A16_D8 0 CM_IDENTITY 0 255 /begin AXIS_DESCR STD_AXIS NO_INPUT_QUANTITY CM_IDENTITY 4 0 65535 /end AXIS_DESCR /end CHARACTERISTIC
/begin CHARACTERISTIC MAP_140_18F3D_4 "вероятная | mapscan | адрес 0x18F3D, данные 0x18F42" CURVE 0x18F3D RL_2D_A8_D16 0 CM_IDENTITY 0 65535 /begin AXIS_DESCR STD_AXIS NO_INPUT_QUANTITY CM_IDENTITY 4 0 255 /end AXIS_DESCR /end CHARACTERISTIC
/begin CHARACTERISTIC MAP_141_18F61_4 "вероятная | mapscan | адрес 0x18F61, данные 0x18F66" CURVE 0x18F61 RL_2D_A8_D8 0 CM_IDENTITY 0 255 /begin AXIS_DESCR STD_AXIS NO_INPUT_QUANTITY CM_IDENTITY 4 0 255 /end AXIS_DESCR /end CHARACTERISTIC
/begin CHARACTERISTIC MAP_142_18F71_4 "вероятная | mapscan | адрес 0x18F71, данные 0x18F76" CURVE 0x18F71 RL_2D_A8_D8 0 CM_IDENTITY 0 255 /begin AXIS_DESCR STD_AXIS NO_INPUT_QUANTITY CM_IDENTITY 4 0 255 /end AXIS_DESCR /end CHARACTERISTIC
/begin CHARACTERISTIC MAP_143_18FA2_4 "вероятная | mapscan | адрес 0x18FA2, данные 0x18FA7" CURVE 0x18FA2 RL_2D_A8_D8 0 CM_IDENTITY 0 255 /begin AXIS_DESCR STD_AXIS NO_INPUT_QUANTITY CM_IDENTITY 4 0 255 /end AXIS_DESCR /end CHARACTERISTIC
/begin CHARACTERISTIC MAP_144_18FB2_4 "вероятная | mapscan | адрес 0x18FB2, данные 0x18FB7" CURVE 0x18FB2 RL_2D_A8_D8 0 CM_IDENTITY 0 255 /begin AXIS_DESCR STD_AXIS NO_INPUT_QUANTITY CM_IDENTITY 4 0 255 /end AXIS_DESCR /end CHARACTERISTIC
/begin CHARACTERISTIC MAP_145_18FD6_4 "вероятная | mapscan | адрес 0x18FD6, данные 0x18FDB" CURVE 0x18FD6 RL_2D_A8_D8 0 CM_IDENTITY 0 255 /begin AXIS_DESCR STD_AXIS NO_INPUT_QUANTITY CM_IDENTITY 4 0 255 /end AXIS_DESCR /end CHARACTERISTIC
/begin CHARACTERISTIC GRID_146_18FF8_8x8 "вероятная | gridscan | адрес 0x18FF8, данные 0x18FF8" MAP 0x18FF8 RL_GRID_D8 0 CM_IDENTITY 0 255
 /begin AXIS_DESCR FIX_AXIS NO_INPUT_QUANTITY CM_IDENTITY 8 0 7 FIX_AXIS_PAR_DIST 0 1 8 /end AXIS_DESCR
 /begin AXIS_DESCR FIX_AXIS NO_INPUT_QUANTITY CM_IDENTITY 8 0 7 FIX_AXIS_PAR_DIST 0 1 8 /end AXIS_DESCR
/end CHARACTERISTIC
/begin CHARACTERISTIC MAP_147_19081_8 "вероятная | mapscan | адрес 0x19081, данные 0x1908A" CURVE 0x19081 RL_2D_A8_D8 0 CM_IDENTITY 0 255 /begin AXIS_DESCR STD_AXIS NO_INPUT_QUANTITY CM_IDENTITY 8 0 255 /end AXIS_DESCR /end CHARACTERISTIC
/begin CHARACTERISTIC MAP_148_190CE_12x16 "вероятная | mapscan | адрес 0x190CE, данные 0x190EC" MAP 0x190CE RL_3D_A8_D16 0 CM_IDENTITY 0 65535 /begin AXIS_DESCR STD_AXIS NO_INPUT_QUANTITY CM_IDENTITY 12 0 255 /end AXIS_DESCR /begin AXIS_DESCR STD_AXIS NO_INPUT_QUANTITY CM_IDENTITY 16 0 255 /end AXIS_DESCR /end CHARACTERISTIC
/begin CHARACTERISTIC GRID_149_19344_4x39 "вероятная | gridscan | адрес 0x19344, данные 0x19344" MAP 0x19344 RL_GRID_D8 0 CM_IDENTITY 0 255
 /begin AXIS_DESCR FIX_AXIS NO_INPUT_QUANTITY CM_IDENTITY 4 0 3 FIX_AXIS_PAR_DIST 0 1 4 /end AXIS_DESCR
 /begin AXIS_DESCR FIX_AXIS NO_INPUT_QUANTITY CM_IDENTITY 39 0 38 FIX_AXIS_PAR_DIST 0 1 39 /end AXIS_DESCR
/end CHARACTERISTIC
/begin CHARACTERISTIC MAP_150_193E0_9 "вероятная | mapscan | адрес 0x193E0, данные 0x193EA" CURVE 0x193E0 RL_2D_A8_D8 0 CM_IDENTITY 0 255 /begin AXIS_DESCR STD_AXIS NO_INPUT_QUANTITY CM_IDENTITY 9 0 255 /end AXIS_DESCR /end CHARACTERISTIC
/begin CHARACTERISTIC CURVE_6_019559 "подтверждена | профиль | адрес 0x1955B, данные 0x19562 | Кривая на 6 точек, ось 37..162, данные 110..116. Меняется между двумя csok." CURVE 0x1955B RL_2D_A8_D8 0 CM_IDENTITY 0 255 /begin AXIS_DESCR STD_AXIS NO_INPUT_QUANTITY CM_IDENTITY 6 0 255 /end AXIS_DESCR /end CHARACTERISTIC
/begin CHARACTERISTIC CURVE_6_019568 "подтверждена | профиль | адрес 0x19568, данные 0x1956F | Вторая кривая на 6 точек с той же осью. Меняется между двумя csok." CURVE 0x19568 RL_2D_A8_D8 0 CM_IDENTITY 0 255 /begin AXIS_DESCR STD_AXIS NO_INPUT_QUANTITY CM_IDENTITY 6 0 255 /end AXIS_DESCR /end CHARACTERISTIC
/begin CHARACTERISTIC GRID_153_195FB_16x15 "вероятная | gridscan | адрес 0x195FB, данные 0x195FB" MAP 0x195FB RL_GRID_D8 0 CM_IDENTITY 0 255
 /begin AXIS_DESCR FIX_AXIS NO_INPUT_QUANTITY CM_IDENTITY 16 0 15 FIX_AXIS_PAR_DIST 0 1 16 /end AXIS_DESCR
 /begin AXIS_DESCR FIX_AXIS NO_INPUT_QUANTITY CM_IDENTITY 15 0 14 FIX_AXIS_PAR_DIST 0 1 15 /end AXIS_DESCR
/end CHARACTERISTIC
/begin CHARACTERISTIC MAP_154_196F8_5 "вероятная | mapscan | адрес 0x196F8, данные 0x196FE" CURVE 0x196F8 RL_2D_A8_D8 0 CM_IDENTITY 0 255 /begin AXIS_DESCR STD_AXIS NO_INPUT_QUANTITY CM_IDENTITY 5 0 255 /end AXIS_DESCR /end CHARACTERISTIC
/begin CHARACTERISTIC MAP_155_19719_8 "вероятная | mapscan | адрес 0x19719, данные 0x19722" CURVE 0x19719 RL_2D_A8_D8 0 CM_IDENTITY 0 255 /begin AXIS_DESCR STD_AXIS NO_INPUT_QUANTITY CM_IDENTITY 8 0 255 /end AXIS_DESCR /end CHARACTERISTIC
/begin CHARACTERISTIC MAP_156_1976E_6 "вероятная | mapscan | адрес 0x1976E, данные 0x19775" CURVE 0x1976E RL_2D_A8_D8 0 CM_IDENTITY 0 255 /begin AXIS_DESCR STD_AXIS NO_INPUT_QUANTITY CM_IDENTITY 6 0 255 /end AXIS_DESCR /end CHARACTERISTIC
/begin CHARACTERISTIC MAP_157_1977E_5 "вероятная | mapscan | адрес 0x1977E, данные 0x19784" CURVE 0x1977E RL_2D_A8_D8 0 CM_IDENTITY 0 255 /begin AXIS_DESCR STD_AXIS NO_INPUT_QUANTITY CM_IDENTITY 5 0 255 /end AXIS_DESCR /end CHARACTERISTIC
/begin CHARACTERISTIC MAP_158_1979E_6 "вероятная | mapscan | адрес 0x1979E, данные 0x197A5" CURVE 0x1979E RL_2D_A8_D8 0 CM_IDENTITY 0 255 /begin AXIS_DESCR STD_AXIS NO_INPUT_QUANTITY CM_IDENTITY 6 0 255 /end AXIS_DESCR /end CHARACTERISTIC
/begin CHARACTERISTIC GRID_159_197BC_10x10 "вероятная | gridscan | адрес 0x197BC, данные 0x197BC" MAP 0x197BC RL_GRID_D8 0 CM_IDENTITY 0 255
 /begin AXIS_DESCR FIX_AXIS NO_INPUT_QUANTITY CM_IDENTITY 10 0 9 FIX_AXIS_PAR_DIST 0 1 10 /end AXIS_DESCR
 /begin AXIS_DESCR FIX_AXIS NO_INPUT_QUANTITY CM_IDENTITY 10 0 9 FIX_AXIS_PAR_DIST 0 1 10 /end AXIS_DESCR
/end CHARACTERISTIC
/begin CHARACTERISTIC MAP_160_1985D_10 "вероятная | mapscan | адрес 0x1985D, данные 0x19868" CURVE 0x1985D RL_2D_A8_D16 0 CM_IDENTITY 0 65535 /begin AXIS_DESCR STD_AXIS NO_INPUT_QUANTITY CM_IDENTITY 10 0 255 /end AXIS_DESCR /end CHARACTERISTIC
/begin CHARACTERISTIC MAP_161_198B4_5 "вероятная | mapscan | адрес 0x198B4, данные 0x198BA" CURVE 0x198B4 RL_2D_A8_D16 0 CM_IDENTITY 0 65535 /begin AXIS_DESCR STD_AXIS NO_INPUT_QUANTITY CM_IDENTITY 5 0 255 /end AXIS_DESCR /end CHARACTERISTIC
/begin CHARACTERISTIC MAP_162_19950_14 "вероятная | mapscan | адрес 0x19950, данные 0x1995F" CURVE 0x19950 RL_2D_A8_D8 0 CM_IDENTITY 0 255 /begin AXIS_DESCR STD_AXIS NO_INPUT_QUANTITY CM_IDENTITY 14 0 255 /end AXIS_DESCR /end CHARACTERISTIC
/begin CHARACTERISTIC MAP_163_19995_8x8 "вероятная | mapscan | адрес 0x19995, данные 0x199A7" MAP 0x19995 RL_3D_A8_D8 0 CM_IDENTITY 0 255 /begin AXIS_DESCR STD_AXIS NO_INPUT_QUANTITY CM_IDENTITY 8 0 255 /end AXIS_DESCR /begin AXIS_DESCR STD_AXIS NO_INPUT_QUANTITY CM_IDENTITY 8 0 255 /end AXIS_DESCR /end CHARACTERISTIC
/begin CHARACTERISTIC MAP_164_19A2F_20 "вероятная | mapscan | адрес 0x19A2F, данные 0x19A44" CURVE 0x19A2F RL_2D_A8_D8 0 CM_IDENTITY 0 255 /begin AXIS_DESCR STD_AXIS NO_INPUT_QUANTITY CM_IDENTITY 20 0 255 /end AXIS_DESCR /end CHARACTERISTIC
/begin CHARACTERISTIC MAP_165_19A6B_20 "вероятная | mapscan | адрес 0x19A6B, данные 0x19A80" CURVE 0x19A6B RL_2D_A8_D8 0 CM_IDENTITY 0 255 /begin AXIS_DESCR STD_AXIS NO_INPUT_QUANTITY CM_IDENTITY 20 0 255 /end AXIS_DESCR /end CHARACTERISTIC
/begin CHARACTERISTIC MAP_166_19AAC_4 "вероятная | mapscan | адрес 0x19AAC, данные 0x19AB1" CURVE 0x19AAC RL_2D_A8_D8 0 CM_IDENTITY 0 255 /begin AXIS_DESCR STD_AXIS NO_INPUT_QUANTITY CM_IDENTITY 4 0 255 /end AXIS_DESCR /end CHARACTERISTIC
/begin CHARACTERISTIC MAP_167_1A692_12 "вероятная | mapscan | адрес 0x1A692, данные 0x1A69F" CURVE 0x1A692 RL_2D_A8_D16 0 CM_IDENTITY 0 65535 /begin AXIS_DESCR STD_AXIS NO_INPUT_QUANTITY CM_IDENTITY 12 0 255 /end AXIS_DESCR /end CHARACTERISTIC
/begin CHARACTERISTIC MAP_168_1A6E4_10x16 "вероятная | mapscan | адрес 0x1A6E4, данные 0x1A700" MAP 0x1A6E4 RL_3D_A8_D16 0 CM_IDENTITY 0 65535 /begin AXIS_DESCR STD_AXIS NO_INPUT_QUANTITY CM_IDENTITY 10 0 255 /end AXIS_DESCR /begin AXIS_DESCR STD_AXIS NO_INPUT_QUANTITY CM_IDENTITY 16 0 255 /end AXIS_DESCR /end CHARACTERISTIC
/begin CHARACTERISTIC MAP_169_1A84A_6 "вероятная | mapscan | адрес 0x1A84A, данные 0x1A851" CURVE 0x1A84A RL_2D_A8_D16 0 CM_IDENTITY 0 65535 /begin AXIS_DESCR STD_AXIS NO_INPUT_QUANTITY CM_IDENTITY 6 0 255 /end AXIS_DESCR /end CHARACTERISTIC
/begin CHARACTERISTIC MAP_170_1A88A_6 "вероятная | mapscan | адрес 0x1A88A, данные 0x1A891" CURVE 0x1A88A RL_2D_A8_D16 0 CM_IDENTITY 0 65535 /begin AXIS_DESCR STD_AXIS NO_INPUT_QUANTITY CM_IDENTITY 6 0 255 /end AXIS_DESCR /end CHARACTERISTIC
/begin CHARACTERISTIC MAP_171_1A945_4 "вероятная | mapscan | адрес 0x1A945, данные 0x1A94E" CURVE 0x1A945 RL_2D_A16_D16 0 CM_IDENTITY 0 65535 /begin AXIS_DESCR STD_AXIS NO_INPUT_QUANTITY CM_IDENTITY 4 0 65535 /end AXIS_DESCR /end CHARACTERISTIC
/begin CHARACTERISTIC MAP_172_1A965_4 "вероятная | mapscan | адрес 0x1A965, данные 0x1A96E" CURVE 0x1A965 RL_2D_A16_D16 0 CM_IDENTITY 0 65535 /begin AXIS_DESCR STD_AXIS NO_INPUT_QUANTITY CM_IDENTITY 4 0 65535 /end AXIS_DESCR /end CHARACTERISTIC
/begin CHARACTERISTIC MAP_173_1AA3A_4 "вероятная | mapscan | адрес 0x1AA3A, данные 0x1AA3F" CURVE 0x1AA3A RL_2D_A8_D16 0 CM_IDENTITY 0 65535 /begin AXIS_DESCR STD_AXIS NO_INPUT_QUANTITY CM_IDENTITY 4 0 255 /end AXIS_DESCR /end CHARACTERISTIC
/begin CHARACTERISTIC MAP_174_1AB22_4 "вероятная | mapscan | адрес 0x1AB22, данные 0x1AB27" CURVE 0x1AB22 RL_2D_A8_D16 0 CM_IDENTITY 0 65535 /begin AXIS_DESCR STD_AXIS NO_INPUT_QUANTITY CM_IDENTITY 4 0 255 /end AXIS_DESCR /end CHARACTERISTIC
/begin CHARACTERISTIC MAP_175_1AC8F_6 "вероятная | mapscan | адрес 0x1AC8F, данные 0x1AC9C" CURVE 0x1AC8F RL_2D_A16_D16 0 CM_IDENTITY 0 65535 /begin AXIS_DESCR STD_AXIS NO_INPUT_QUANTITY CM_IDENTITY 6 0 65535 /end AXIS_DESCR /end CHARACTERISTIC
/begin CHARACTERISTIC MAP_176_1ADDB_5 "вероятная | mapscan | адрес 0x1ADDB, данные 0x1ADE6" CURVE 0x1ADDB RL_2D_A16_D16 0 CM_IDENTITY 0 65535 /begin AXIS_DESCR STD_AXIS NO_INPUT_QUANTITY CM_IDENTITY 5 0 65535 /end AXIS_DESCR /end CHARACTERISTIC
/begin CHARACTERISTIC MAP_177_1AEC3_6 "вероятная | mapscan | адрес 0x1AEC3, данные 0x1AECA" CURVE 0x1AEC3 RL_2D_A8_D8 0 CM_IDENTITY 0 255 /begin AXIS_DESCR STD_AXIS NO_INPUT_QUANTITY CM_IDENTITY 6 0 255 /end AXIS_DESCR /end CHARACTERISTIC
/begin CHARACTERISTIC MAP_178_1AF14_6 "вероятная | mapscan | адрес 0x1AF14, данные 0x1AF21" CURVE 0x1AF14 RL_2D_A16_D16 0 CM_IDENTITY 0 65535 /begin AXIS_DESCR STD_AXIS NO_INPUT_QUANTITY CM_IDENTITY 6 0 65535 /end AXIS_DESCR /end CHARACTERISTIC
/begin CHARACTERISTIC MAP_179_1B0C2_5 "вероятная | mapscan | адрес 0x1B0C2, данные 0x1B0C8" CURVE 0x1B0C2 RL_2D_A8_D16 0 CM_IDENTITY 0 65535 /begin AXIS_DESCR STD_AXIS NO_INPUT_QUANTITY CM_IDENTITY 5 0 255 /end AXIS_DESCR /end CHARACTERISTIC
/begin CHARACTERISTIC GRID_180_1B212_4x36 "вероятная | gridscan | адрес 0x1B212, данные 0x1B212" MAP 0x1B212 RL_GRID_D8 0 CM_IDENTITY 0 255
 /begin AXIS_DESCR FIX_AXIS NO_INPUT_QUANTITY CM_IDENTITY 4 0 3 FIX_AXIS_PAR_DIST 0 1 4 /end AXIS_DESCR
 /begin AXIS_DESCR FIX_AXIS NO_INPUT_QUANTITY CM_IDENTITY 36 0 35 FIX_AXIS_PAR_DIST 0 1 36 /end AXIS_DESCR
/end CHARACTERISTIC
/begin CHARACTERISTIC MAP_181_1B422_16 "вероятная | mapscan | адрес 0x1B422, данные 0x1B433" CURVE 0x1B422 RL_2D_A8_D8 0 CM_IDENTITY 0 255 /begin AXIS_DESCR STD_AXIS NO_INPUT_QUANTITY CM_IDENTITY 16 0 255 /end AXIS_DESCR /end CHARACTERISTIC
/begin CHARACTERISTIC MAP_182_1B464_7 "вероятная | mapscan | адрес 0x1B464, данные 0x1B473" CURVE 0x1B464 RL_2D_A16_D16 0 CM_IDENTITY 0 65535 /begin AXIS_DESCR STD_AXIS NO_INPUT_QUANTITY CM_IDENTITY 7 0 65535 /end AXIS_DESCR /end CHARACTERISTIC
/begin CHARACTERISTIC MAP_183_1B497_8 "вероятная | mapscan | адрес 0x1B497, данные 0x1B4A8" CURVE 0x1B497 RL_2D_A16_D8 0 CM_IDENTITY 0 255 /begin AXIS_DESCR STD_AXIS NO_INPUT_QUANTITY CM_IDENTITY 8 0 65535 /end AXIS_DESCR /end CHARACTERISTIC
/begin CHARACTERISTIC MAP_184_1B54C_4 "вероятная | mapscan | адрес 0x1B54C, данные 0x1B555" CURVE 0x1B54C RL_2D_A16_D16 0 CM_IDENTITY 0 65535 /begin AXIS_DESCR STD_AXIS NO_INPUT_QUANTITY CM_IDENTITY 4 0 65535 /end AXIS_DESCR /end CHARACTERISTIC
/begin CHARACTERISTIC MAP_185_1B5E1_6 "вероятная | mapscan | адрес 0x1B5E1, данные 0x1B5E8" CURVE 0x1B5E1 RL_2D_A8_D16 0 CM_IDENTITY 0 65535 /begin AXIS_DESCR STD_AXIS NO_INPUT_QUANTITY CM_IDENTITY 6 0 255 /end AXIS_DESCR /end CHARACTERISTIC
/begin CHARACTERISTIC MAP_186_1B612_5 "вероятная | mapscan | адрес 0x1B612, данные 0x1B618" CURVE 0x1B612 RL_2D_A8_D16 0 CM_IDENTITY 0 65535 /begin AXIS_DESCR STD_AXIS NO_INPUT_QUANTITY CM_IDENTITY 5 0 255 /end AXIS_DESCR /end CHARACTERISTIC
/begin CHARACTERISTIC MAP_187_1B663_16 "вероятная | mapscan | адрес 0x1B663, данные 0x1B674" CURVE 0x1B663 RL_2D_A8_D16 0 CM_IDENTITY 0 65535 /begin AXIS_DESCR STD_AXIS NO_INPUT_QUANTITY CM_IDENTITY 16 0 255 /end AXIS_DESCR /end CHARACTERISTIC
/begin CHARACTERISTIC MAP_188_1B8C0_5 "вероятная | mapscan | адрес 0x1B8C0, данные 0x1B8C6" CURVE 0x1B8C0 RL_2D_A8_D8 0 CM_IDENTITY 0 255 /begin AXIS_DESCR STD_AXIS NO_INPUT_QUANTITY CM_IDENTITY 5 0 255 /end AXIS_DESCR /end CHARACTERISTIC
/begin CHARACTERISTIC MAP_189_1B91F_5 "вероятная | mapscan | адрес 0x1B91F, данные 0x1B925" CURVE 0x1B91F RL_2D_A8_D8 0 CM_IDENTITY 0 255 /begin AXIS_DESCR STD_AXIS NO_INPUT_QUANTITY CM_IDENTITY 5 0 255 /end AXIS_DESCR /end CHARACTERISTIC
/begin CHARACTERISTIC MAP_190_1B9EC_4 "вероятная | mapscan | адрес 0x1B9EC, данные 0x1B9F1" CURVE 0x1B9EC RL_2D_A8_D8 0 CM_IDENTITY 0 255 /begin AXIS_DESCR STD_AXIS NO_INPUT_QUANTITY CM_IDENTITY 4 0 255 /end AXIS_DESCR /end CHARACTERISTIC
/begin CHARACTERISTIC MAP_191_1BC7A_8 "вероятная | mapscan | адрес 0x1BC7A, данные 0x1BC83" CURVE 0x1BC7A RL_2D_A8_D8 0 CM_IDENTITY 0 255 /begin AXIS_DESCR STD_AXIS NO_INPUT_QUANTITY CM_IDENTITY 8 0 255 /end AXIS_DESCR /end CHARACTERISTIC
/begin CHARACTERISTIC MAP_192_1BD71_5 "вероятная | mapscan | адрес 0x1BD71, данные 0x1BD7C" CURVE 0x1BD71 RL_2D_A16_D16 0 CM_IDENTITY 0 65535 /begin AXIS_DESCR STD_AXIS NO_INPUT_QUANTITY CM_IDENTITY 5 0 65535 /end AXIS_DESCR /end CHARACTERISTIC
/end MODULE
/end PROJECT
