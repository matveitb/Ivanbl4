ASAP2_VERSION 1 61
/begin PROJECT FBH3ID60 "Kia Spectra 1.6 Bosch M7.9.7 FBH3ID60"
/begin HEADER "Kia Spectra 1.6 Bosch M7.9.7 FBH3ID60" VERSION "1.0" /end HEADER
/begin MODULE FBH3ID60_MOD "Bosch M7.9.7 / Infineon C167"
/begin MOD_COMMON "little-endian, выравнивание 1" BYTE_ORDER MSB_LAST ALIGNMENT_BYTE 1 ALIGNMENT_WORD 1 ALIGNMENT_LONG 1 /end MOD_COMMON
/begin COMPU_METHOD CM_IDENTITY "без пересчёта (сырые значения)" RAT_FUNC "%.3f" "" COEFFS 0 1 0 0 0 1 /end COMPU_METHOD
/begin COMPU_METHOD CM_40_0_Upm "nmot_ub_q40" RAT_FUNC "%.1f" "Upm" COEFFS 0 1 0 0 0 40 /end COMPU_METHOD
/begin COMPU_METHOD CM_0p5_0 "масштаб 0.5" RAT_FUNC "%.3f" "%" COEFFS 0 1 0 0 0 0.5 /end COMPU_METHOD
/begin COMPU_METHOD CM_0p390625_0 "rel_ub_b99p6" RAT_FUNC "%.3f" "%" COEFFS 0 1 0 0 0 0.390625 /end COMPU_METHOD
/begin COMPU_METHOD CM_0p75_0_gradKW "масштаб 0.75" RAT_FUNC "%.3f" "grad KW" COEFFS 0 1 0 0 0 0.75 /end COMPU_METHOD
/begin COMPU_METHOD CM_0p00390625_0_Umin "relnmot_q0p0039" RAT_FUNC "%.3f" "%/(U/min)" COEFFS 0 1 0 0 0 0.00390625 /end COMPU_METHOD
/begin COMPU_METHOD CM_0p75_0 "rel_ub_q0p75" RAT_FUNC "%.3f" "%" COEFFS 0 1 0 0 0 0.75 /end COMPU_METHOD
/begin COMPU_METHOD CM_0p09803921569_0 "bs_ub_q0p098" RAT_FUNC "%.3f" "" COEFFS 0 1 0 0 0 0.09803921569 /end COMPU_METHOD
/begin COMPU_METHOD CM_0p03125_0 "fak_ub_b8" RAT_FUNC "%.3f" "-" COEFFS 0 1 0 0 0 0.03125 /end COMPU_METHOD
/begin COMPU_METHOD CM_0p0078125_0 "fak_ub_b2" RAT_FUNC "%.3f" "-" COEFFS 0 1 0 0 0 0.0078125 /end COMPU_METHOD
/begin COMPU_METHOD CM_0p1_0_ms "txms_ub_q0p1" RAT_FUNC "%.3f" "ms" COEFFS 0 1 0 0 0 0.1 /end COMPU_METHOD
/begin COMPU_METHOD CM_0p3906_0 "rel_sb_q0p39" RAT_FUNC "%.3f" "%" COEFFS 0 1 0 0 0 0.3906 /end COMPU_METHOD
/begin COMPU_METHOD CM_n0p00048828125_n0_sUmin "rel_qn0p000488" RAT_FUNC "%.3f" "(%*s)/(U/min)" COEFFS 0 1 -0 0 0 -0.00048828125 /end COMPU_METHOD
/begin COMPU_METHOD CM_0p00390625_0 "fak_ub_b1" RAT_FUNC "%.3f" "-" COEFFS 0 1 0 0 0 0.00390625 /end COMPU_METHOD
/begin COMPU_METHOD CM_0p0023828125_0_sUmin "rel_q0p002383" RAT_FUNC "%.3f" "%/(s*U/min)" COEFFS 0 1 0 0 0 0.0023828125 /end COMPU_METHOD
/begin COMPU_METHOD CM_0p001525878906_0 "fak_q0p00153" RAT_FUNC "%.3f" "-" COEFFS 0 1 0 0 0 0.001525878906 /end COMPU_METHOD
/begin COMPU_METHOD CM_0p02_0_s "t20msxs_ub_b5p1" RAT_FUNC "%.3f" "s" COEFFS 0 1 0 0 0 0.02 /end COMPU_METHOD
/begin COMPU_METHOD CM_0p0625_0 "fak_ub_b16" RAT_FUNC "%.3f" "-" COEFFS 0 1 0 0 0 0.0625 /end COMPU_METHOD
/begin COMPU_METHOD CM_0p001953125_n0p75 "fak_ub_q0p0019_o0p75" RAT_FUNC "%.3f" "" COEFFS 0 1 -0.75 0 0 0.001953125 /end COMPU_METHOD
/begin COMPU_METHOD CM_n0p75_0_gradKW "zw_ub_qn0p75" RAT_FUNC "%.3f" "grad KW" COEFFS 0 1 0 0 0 -0.75 /end COMPU_METHOD
/begin COMPU_METHOD CM_0p3921568627_0_DK "relDK_ub_b100" RAT_FUNC "%.3f" "% DK" COEFFS 0 1 0 0 0 0.3921568627 /end COMPU_METHOD
/begin COMPU_METHOD CM_0p25_0 "fak_ub_b64" RAT_FUNC "%.3f" "-" COEFFS 0 1 0 0 0 0.25 /end COMPU_METHOD
/begin COMPU_METHOD CM_0p2_0_s "t200msxs_ub_b51" RAT_FUNC "%.3f" "s" COEFFS 0 1 0 0 0 0.2 /end COMPU_METHOD
/begin COMPU_METHOD CM_0p01953125_0_V "spg_ub_b5" RAT_FUNC "%.3f" "V" COEFFS 0 1 0 0 0 0.01953125 /end COMPU_METHOD
/begin COMPU_METHOD CM_0p03125_0_1s "zk10msxs_ub_b8" RAT_FUNC "%.3f" "1/s" COEFFS 0 1 0 0 0 0.03125 /end COMPU_METHOD
/begin COMPU_METHOD CM_0p25_0_Umin "nmot_uw_q0p25" RAT_FUNC "%.3f" "U/min" COEFFS 0 1 0 0 0 0.25 /end COMPU_METHOD
/begin COMPU_METHOD CM_0p01_0_s "t10msxs_ub_b2p55_@_UW" RAT_FUNC "%.3f" "s" COEFFS 0 1 0 0 0 0.01 /end COMPU_METHOD
/begin COMPU_METHOD CM_0p001953125_0 "rel_uw_b127p5" RAT_FUNC "%.3f" "%" COEFFS 0 1 0 0 0 0.001953125 /end COMPU_METHOD
/begin COMPU_METHOD CM_0p1960784314_0 "rel_ub_b50" RAT_FUNC "%.3f" "%" COEFFS 0 1 0 0 0 0.1960784314 /end COMPU_METHOD
/begin COMPU_METHOD CM_0p003051757812_0 "rel_sw_b100" RAT_FUNC "%.3f" "%" COEFFS 0 1 0 0 0 0.003051757812 /end COMPU_METHOD
/begin COMPU_METHOD CM_0p0030515625_0_Umin "rel_q0p00305" RAT_FUNC "%.3f" "%/(U/min)" COEFFS 0 1 0 0 0 0.0030515625 /end COMPU_METHOD
/begin COMPU_METHOD CM_0p78_0 "rel_sb_q0p78" RAT_FUNC "%.3f" "%" COEFFS 0 1 0 0 0 0.78 /end COMPU_METHOD
/begin COMPU_METHOD CM_0p0001220703125_0 "fak_uw_b8" RAT_FUNC "%.3f" "-" COEFFS 0 1 0 0 0 0.0001220703125 /end COMPU_METHOD
/begin COMPU_METHOD CM_0p000244140625_0 "fak_uw_b16" RAT_FUNC "%.3f" "-" COEFFS 0 1 0 0 0 0.000244140625 /end COMPU_METHOD
/begin COMPU_METHOD CM_0p0015625_0_kgh "m_uw_b102p4" RAT_FUNC "%.3f" "kg/h" COEFFS 0 1 0 0 0 0.0015625 /end COMPU_METHOD
/begin COMPU_METHOD CM_0p1_0_kgh "m_uw_b6553p5" RAT_FUNC "%.3f" "kg/h" COEFFS 0 1 0 0 0 0.1 /end COMPU_METHOD
/begin COMPU_METHOD CM_0p1_0_s "t100msxs_uw_b6553p5" RAT_FUNC "%.3f" "s" COEFFS 0 1 0 0 0 0.1 /end COMPU_METHOD
/begin COMPU_METHOD CM_0p39063_0_Umins "nmotg_sw_q0p39_@_UW" RAT_FUNC "%.3f" "U/min/s" COEFFS 0 1 0 0 0 0.39063 /end COMPU_METHOD
/begin COMPU_METHOD CM_0p0234375_0 "rel_uw_q0p0234" RAT_FUNC "%.3f" "%" COEFFS 0 1 0 0 0 0.0234375 /end COMPU_METHOD
/begin COMPU_METHOD CM_0p015625_0 "fak_ub_b4" RAT_FUNC "%.3f" "-" COEFFS 0 1 0 0 0 0.015625 /end COMPU_METHOD
/begin COMPU_METHOD CM_0p09375_0 "rel_uw_b6144" RAT_FUNC "%.3f" "%" COEFFS 0 1 0 0 0 0.09375 /end COMPU_METHOD
/begin COMPU_METHOD CM_0p002666666667_0_ms "tinjection_sy" RAT_FUNC "%.3f" "ms" COEFFS 0 1 0 0 0 0.002666666667 /end COMPU_METHOD
/begin COMPU_METHOD CM_0p046875_0 "rel_sw_b1536" RAT_FUNC "%.3f" "%" COEFFS 0 1 0 0 0 0.046875 /end COMPU_METHOD
/begin COMPU_METHOD CM_3p2_0_kgh "m_uw_q3p2" RAT_FUNC "%.1f" "kg/h" COEFFS 0 1 0 0 0 3.2 /end COMPU_METHOD
/begin COMPU_METHOD CM_5p96En08_0_Min "t_min_q5p96em8" RAT_FUNC "%.3f" "Min" COEFFS 0 1 0 0 0 5.96e-08 /end COMPU_METHOD
/begin COMPU_METHOD CM_1p525878906En05_0 "fak_uw_b1" RAT_FUNC "%.3f" "-" COEFFS 0 1 0 0 0 1.525878906e-05 /end COMPU_METHOD
/begin COMPU_METHOD CM_3p051757812En05_0 "fak_uw_b2" RAT_FUNC "%.3f" "-" COEFFS 0 1 0 0 0 3.051757812e-05 /end COMPU_METHOD
/begin COMPU_METHOD CM_0p000390625_0_kgh "m_uw_b25p6" RAT_FUNC "%.3f" "kg/h" COEFFS 0 1 0 0 0 0.000390625 /end COMPU_METHOD
/begin RECORD_LAYOUT RL_GRID_DU8 FNC_VALUES 1 UBYTE ROW_DIR DIRECT /end RECORD_LAYOUT
/begin RECORD_LAYOUT RL_3D_A8_DU8 NO_AXIS_PTS_X 1 UBYTE NO_AXIS_PTS_Y 2 UBYTE AXIS_PTS_X 3 UBYTE INDEX_INCR DIRECT AXIS_PTS_Y 4 UBYTE INDEX_INCR DIRECT FNC_VALUES 5 UBYTE ROW_DIR DIRECT /end RECORD_LAYOUT
/begin RECORD_LAYOUT RL_GRID_DS8 FNC_VALUES 1 SBYTE ROW_DIR DIRECT /end RECORD_LAYOUT
/begin RECORD_LAYOUT RL_2D_A16_DU16 NO_AXIS_PTS_X 1 UBYTE AXIS_PTS_X 2 UWORD INDEX_INCR DIRECT FNC_VALUES 3 UWORD ROW_DIR DIRECT /end RECORD_LAYOUT
/begin RECORD_LAYOUT RL_2D_A8_DU8 NO_AXIS_PTS_X 1 UBYTE AXIS_PTS_X 2 UBYTE INDEX_INCR DIRECT FNC_VALUES 3 UBYTE ROW_DIR DIRECT /end RECORD_LAYOUT
/begin RECORD_LAYOUT RL_3D_A8_DU16 NO_AXIS_PTS_X 1 UBYTE NO_AXIS_PTS_Y 2 UBYTE AXIS_PTS_X 3 UBYTE INDEX_INCR DIRECT AXIS_PTS_Y 4 UBYTE INDEX_INCR DIRECT FNC_VALUES 5 UWORD ROW_DIR DIRECT /end RECORD_LAYOUT
/begin RECORD_LAYOUT RL_2D_A8_DU16 NO_AXIS_PTS_X 1 UBYTE AXIS_PTS_X 2 UBYTE INDEX_INCR DIRECT FNC_VALUES 3 UWORD ROW_DIR DIRECT /end RECORD_LAYOUT
/begin RECORD_LAYOUT RL_GRID_DU16 FNC_VALUES 1 UWORD ROW_DIR DIRECT /end RECORD_LAYOUT
/begin RECORD_LAYOUT RL_3D_A16_DU16 NO_AXIS_PTS_X 1 UBYTE NO_AXIS_PTS_Y 2 UBYTE AXIS_PTS_X 3 UWORD INDEX_INCR DIRECT AXIS_PTS_Y 4 UWORD INDEX_INCR DIRECT FNC_VALUES 5 UWORD ROW_DIR DIRECT /end RECORD_LAYOUT
/begin RECORD_LAYOUT RL_GRID_DS16 FNC_VALUES 1 SWORD ROW_DIR DIRECT /end RECORD_LAYOUT
/begin CHARACTERISTIC SGA08MDUB "подтверждена | damos | адрес 0x10067, данные 0x10067 | base point distribution of actual gear 8 b.pt." CURVE 0x10067 RL_GRID_DU8 0 CM_IDENTITY 0 255
 /begin AXIS_DESCR FIX_AXIS NO_INPUT_QUANTITY CM_IDENTITY 8 0 7 FIX_AXIS_PAR_DIST 0 1 8 /end AXIS_DESCR
/end CHARACTERISTIC
/begin CHARACTERISTIC SML05DKUB "подтверждена | damos | адрес 0x10070, данные 0x10070 | base point distribution air mass" CURVE 0x10070 RL_GRID_DU8 0 CM_IDENTITY 0 255
 /begin AXIS_DESCR FIX_AXIS NO_INPUT_QUANTITY CM_IDENTITY 5 0 4 FIX_AXIS_PAR_DIST 0 1 5 /end AXIS_DESCR
/end CHARACTERISTIC
/begin CHARACTERISTIC SML05LKUB "подтверждена | damos | адрес 0x10076, данные 0x10076" CURVE 0x10076 RL_GRID_DU8 0 CM_IDENTITY 0 255
 /begin AXIS_DESCR FIX_AXIS NO_INPUT_QUANTITY CM_IDENTITY 5 0 4 FIX_AXIS_PAR_DIST 0 1 5 /end AXIS_DESCR
/end CHARACTERISTIC
/begin CHARACTERISTIC SML08LHUB "подтверждена | damos | адрес 0x1007C, данные 0x1007C | ml dependet basic point (number 8)" CURVE 0x1007C RL_GRID_DU8 0 CM_IDENTITY 0 255
 /begin AXIS_DESCR FIX_AXIS NO_INPUT_QUANTITY CM_IDENTITY 8 0 7 FIX_AXIS_PAR_DIST 0 1 8 /end AXIS_DESCR
/end CHARACTERISTIC
/begin CHARACTERISTIC SNG06LLSB "вероятная | damos-вероятно | адрес 0x10085, данные 0x10085 | Datapoint distribution, speed gradient, 6 datapoints" CURVE 0x10085 RL_GRID_DU8 0 CM_IDENTITY 0 255
 /begin AXIS_DESCR FIX_AXIS NO_INPUT_QUANTITY CM_IDENTITY 6 0 5 FIX_AXIS_PAR_DIST 0 1 6 /end AXIS_DESCR
/end CHARACTERISTIC
/begin CHARACTERISTIC SNM05DKUB "подтверждена | damos | адрес 0x1008C, данные 0x1008C | base point distribution nmot" CURVE 0x1008C RL_GRID_DU8 0 CM_IDENTITY 0 255
 /begin AXIS_DESCR FIX_AXIS NO_INPUT_QUANTITY CM_IDENTITY 5 0 4 FIX_AXIS_PAR_DIST 0 1 5 /end AXIS_DESCR
/end CHARACTERISTIC
/begin CHARACTERISTIC SNM06LLUB "подтверждена | damos | адрес 0x10092, данные 0x10092 | distribution of engine speed" CURVE 0x10092 RL_GRID_DU8 0 CM_IDENTITY 0 255
 /begin AXIS_DESCR FIX_AXIS NO_INPUT_QUANTITY CM_IDENTITY 6 0 5 FIX_AXIS_PAR_DIST 0 1 6 /end AXIS_DESCR
/end CHARACTERISTIC
/begin CHARACTERISTIC SNM07LRUB "подтверждена | damos | адрес 0x10099, данные 0x10099" CURVE 0x10099 RL_GRID_DU8 0 CM_IDENTITY 0 255
 /begin AXIS_DESCR FIX_AXIS NO_INPUT_QUANTITY CM_IDENTITY 7 0 6 FIX_AXIS_PAR_DIST 0 1 7 /end AXIS_DESCR
/end CHARACTERISTIC
/begin CHARACTERISTIC SNM08DMUB "подтверждена | damos | адрес 0x100A1, данные 0x100A1 | Datapoint distribution in DMD, 8 speed datapoints" CURVE 0x100A1 RL_GRID_DU8 0 CM_IDENTITY 0 255
 /begin AXIS_DESCR FIX_AXIS NO_INPUT_QUANTITY CM_IDENTITY 8 0 7 FIX_AXIS_PAR_DIST 0 1 8 /end AXIS_DESCR
/end CHARACTERISTIC
/begin CHARACTERISTIC SNM08LHUB "подтверждена | damos | адрес 0x100AA, данные 0x100AA | nmot dependet basic point (number 8)" CURVE 0x100AA RL_GRID_DU8 0 CM_IDENTITY 0 255
 /begin AXIS_DESCR FIX_AXIS NO_INPUT_QUANTITY CM_IDENTITY 8 0 7 FIX_AXIS_PAR_DIST 0 1 8 /end AXIS_DESCR
/end CHARACTERISTIC
/begin CHARACTERISTIC SNM08__UB "подтверждена | damos | адрес 0x100B3, данные 0x100B3 | Base point distribution engine speed, 8 base points" CURVE 0x100B3 RL_GRID_DU8 0 CM_IDENTITY 0 255
 /begin AXIS_DESCR FIX_AXIS NO_INPUT_QUANTITY CM_IDENTITY 8 0 7 FIX_AXIS_PAR_DIST 0 1 8 /end AXIS_DESCR
/end CHARACTERISTIC
/begin CHARACTERISTIC SNM10FEUB "подтверждена | damos | адрес 0x100BC, данные 0x100BC" CURVE 0x100BC RL_GRID_DU8 0 CM_IDENTITY 0 255
 /begin AXIS_DESCR FIX_AXIS NO_INPUT_QUANTITY CM_IDENTITY 10 0 9 FIX_AXIS_PAR_DIST 0 1 10 /end AXIS_DESCR
/end CHARACTERISTIC
/begin CHARACTERISTIC SNM12ESUB "подтверждена | damos | адрес 0x100C7, данные 0x100C7 | Distribution for the engine speed nmot" CURVE 0x100C7 RL_GRID_DU8 0 CM_IDENTITY 0 255
 /begin AXIS_DESCR FIX_AXIS NO_INPUT_QUANTITY CM_IDENTITY 12 0 11 FIX_AXIS_PAR_DIST 0 1 12 /end AXIS_DESCR
/end CHARACTERISTIC
/begin CHARACTERISTIC SNM12FEUB "подтверждена | damos | адрес 0x100D4, данные 0x100D4 | set points of WDKSMX, WDKUGDN" CURVE 0x100D4 RL_GRID_DU8 0 CM_IDENTITY 0 255
 /begin AXIS_DESCR FIX_AXIS NO_INPUT_QUANTITY CM_IDENTITY 12 0 11 FIX_AXIS_PAR_DIST 0 1 12 /end AXIS_DESCR
/end CHARACTERISTIC
/begin CHARACTERISTIC SNM16CIUB "подтверждена | damos | адрес 0x100E1, данные 0x100E1 | Base point distribution of engine speed, 16 base pts." CURVE 0x100E1 RL_GRID_DU8 0 CM_IDENTITY 0 255
 /begin AXIS_DESCR FIX_AXIS NO_INPUT_QUANTITY CM_IDENTITY 16 0 15 FIX_AXIS_PAR_DIST 0 1 16 /end AXIS_DESCR
/end CHARACTERISTIC
/begin CHARACTERISTIC SNM16OPUB "подтверждена | damos | адрес 0x100F2, данные 0x100F2" CURVE 0x100F2 RL_GRID_DU8 0 CM_IDENTITY 0 255
 /begin AXIS_DESCR FIX_AXIS NO_INPUT_QUANTITY CM_IDENTITY 16 0 15 FIX_AXIS_PAR_DIST 0 1 16 /end AXIS_DESCR
/end CHARACTERISTIC
/begin CHARACTERISTIC SNM16ZUUB "подтверждена | damos | адрес 0x10103, данные 0x10103 | datapoint distribution engine speed, 16 datapoints" CURVE 0x10103 RL_GRID_DU8 0 CM_IDENTITY 0 255
 /begin AXIS_DESCR FIX_AXIS NO_INPUT_QUANTITY CM_IDENTITY 16 0 15 FIX_AXIS_PAR_DIST 0 1 16 /end AXIS_DESCR
/end CHARACTERISTIC
/begin CHARACTERISTIC SNM24ZUUB "подтверждена | damos | адрес 0x10114, данные 0x10114 | datapoint distribution of engine speed, 24 datapoints" CURVE 0x10114 RL_GRID_DU8 0 CM_IDENTITY 0 255
 /begin AXIS_DESCR FIX_AXIS NO_INPUT_QUANTITY CM_IDENTITY 24 0 23 FIX_AXIS_PAR_DIST 0 1 24 /end AXIS_DESCR
/end CHARACTERISTIC
/begin CHARACTERISTIC SQM05TEUB "подтверждена | damos | адрес 0x1012D, данные 0x1012D | air mass quotient dependet basic point (number =5)" CURVE 0x1012D RL_GRID_DU8 0 CM_IDENTITY 0 255
 /begin AXIS_DESCR FIX_AXIS NO_INPUT_QUANTITY CM_IDENTITY 5 0 4 FIX_AXIS_PAR_DIST 0 1 5 /end AXIS_DESCR
/end CHARACTERISTIC
/begin CHARACTERISTIC SRL06LHUB "подтверждена | damos | адрес 0x10133, данные 0x10133" CURVE 0x10133 RL_GRID_DU8 0 CM_IDENTITY 0 255
 /begin AXIS_DESCR FIX_AXIS NO_INPUT_QUANTITY CM_IDENTITY 6 0 5 FIX_AXIS_PAR_DIST 0 1 6 /end AXIS_DESCR
/end CHARACTERISTIC
/begin CHARACTERISTIC SRL06LRUB "подтверждена | damos | адрес 0x1013A, данные 0x1013A" CURVE 0x1013A RL_GRID_DU8 0 CM_IDENTITY 0 255
 /begin AXIS_DESCR FIX_AXIS NO_INPUT_QUANTITY CM_IDENTITY 6 0 5 FIX_AXIS_PAR_DIST 0 1 6 /end AXIS_DESCR
/end CHARACTERISTIC
/begin CHARACTERISTIC SRL08DMUB "подтверждена | damos | адрес 0x10141, данные 0x10141" CURVE 0x10141 RL_GRID_DU8 0 CM_IDENTITY 0 255
 /begin AXIS_DESCR FIX_AXIS NO_INPUT_QUANTITY CM_IDENTITY 8 0 7 FIX_AXIS_PAR_DIST 0 1 8 /end AXIS_DESCR
/end CHARACTERISTIC
/begin CHARACTERISTIC SRL12ESUB "подтверждена | damos | адрес 0x1014A, данные 0x1014A | Distribution for the relative air charge rl" CURVE 0x1014A RL_GRID_DU8 0 CM_IDENTITY 0 255
 /begin AXIS_DESCR FIX_AXIS NO_INPUT_QUANTITY CM_IDENTITY 12 0 11 FIX_AXIS_PAR_DIST 0 1 12 /end AXIS_DESCR
/end CHARACTERISTIC
/begin CHARACTERISTIC SRL12ZUUB "подтверждена | damos | адрес 0x10157, данные 0x10157 | datapoint distribution relative air charge, 12 datapoints" CURVE 0x10157 RL_GRID_DU8 0 CM_IDENTITY 0 255
 /begin AXIS_DESCR FIX_AXIS NO_INPUT_QUANTITY CM_IDENTITY 12 0 11 FIX_AXIS_PAR_DIST 0 1 12 /end AXIS_DESCR
/end CHARACTERISTIC
/begin CHARACTERISTIC SRL16ZUUB "подтверждена | damos | адрес 0x10164, данные 0x10164 | datapoint distribution relative charge, 16 datapoints" CURVE 0x10164 RL_GRID_DU8 0 CM_IDENTITY 0 255
 /begin AXIS_DESCR FIX_AXIS NO_INPUT_QUANTITY CM_IDENTITY 16 0 15 FIX_AXIS_PAR_DIST 0 1 16 /end AXIS_DESCR
/end CHARACTERISTIC
/begin CHARACTERISTIC STM12ESUB "подтверждена | damos | адрес 0x10175, данные 0x10175 | Distribution for the engine coolant temperature tmot" CURVE 0x10175 RL_GRID_DU8 0 CM_IDENTITY 0 255
 /begin AXIS_DESCR FIX_AXIS NO_INPUT_QUANTITY CM_IDENTITY 12 0 11 FIX_AXIS_PAR_DIST 0 1 12 /end AXIS_DESCR
/end CHARACTERISTIC
/begin CHARACTERISTIC NARASTG "вероятная | damos-вероятно | адрес 0x101E9, данные 0x101E9 | масштаб x40 Upm | RPM threshold in higher gear for AR active" CURVE 0x101E9 RL_GRID_DU8 0 CM_40_0_Upm 0 255
 /begin AXIS_DESCR FIX_AXIS NO_INPUT_QUANTITY CM_IDENTITY 6 0 5 FIX_AXIS_PAR_DIST 0 1 6 /end AXIS_DESCR
/end CHARACTERISTIC
/begin CHARACTERISTIC KFETAZW "подтверждена | профиль | адрес 0x101F4, данные 0x10216 | масштаб x0.5 % | Карта КПД по углу опережения зажигания. Классический формат Bosch: заголовок nx/ny и оси внутри блока." MAP 0x101F4 RL_3D_A8_DU8 0 CM_0p5_0 0 255 /begin AXIS_DESCR STD_AXIS NO_INPUT_QUANTITY CM_IDENTITY 16 0 255 /end AXIS_DESCR /begin AXIS_DESCR STD_AXIS NO_INPUT_QUANTITY CM_IDENTITY 16 0 255 /end AXIS_DESCR /end CHARACTERISTIC
/begin CHARACTERISTIC KFETAZWN "подтверждена | профиль | адрес 0x10316, данные 0x10338 | масштаб x0.5 % | То же на холостом ходу." MAP 0x10316 RL_3D_A8_DU8 0 CM_0p5_0 0 255 /begin AXIS_DESCR STD_AXIS NO_INPUT_QUANTITY CM_IDENTITY 16 0 255 /end AXIS_DESCR /begin AXIS_DESCR STD_AXIS NO_INPUT_QUANTITY CM_IDENTITY 16 0 255 /end AXIS_DESCR /end CHARACTERISTIC
/begin CHARACTERISTIC KFMPED "подтверждена | damos-точно | адрес 0x10452, данные 0x10452 | масштаб x0.390625 % | MDFAW" MAP 0x10452 RL_GRID_DU8 0 CM_0p390625_0 0 255
 /begin AXIS_DESCR FIX_AXIS NO_INPUT_QUANTITY CM_IDENTITY 8 0 7 FIX_AXIS_PAR_DIST 0 1 8 /end AXIS_DESCR
 /begin AXIS_DESCR FIX_AXIS NO_INPUT_QUANTITY CM_IDENTITY 16 0 15 FIX_AXIS_PAR_DIST 0 1 16 /end AXIS_DESCR
/end CHARACTERISTIC
/begin CHARACTERISTIC ETADZW "вероятная | damos-вероятно | адрес 0x104D3, данные 0x104D3 | масштаб x0.5 % | ignition efficiency depending on delta ignition angle" CURVE 0x104D3 RL_GRID_DU8 0 CM_0p5_0 0 255
 /begin AXIS_DESCR FIX_AXIS NO_INPUT_QUANTITY CM_IDENTITY 65 0 64 FIX_AXIS_PAR_DIST 0 1 65 /end AXIS_DESCR
/end CHARACTERISTIC
/begin CHARACTERISTIC ETALAM "подтверждена | damos | адрес 0x10515, данные 0x10515 | масштаб x0.5 % | Lambda effectiveness" CURVE 0x10515 RL_GRID_DU8 0 CM_0p5_0 0 255
 /begin AXIS_DESCR FIX_AXIS NO_INPUT_QUANTITY CM_IDENTITY 10 0 9 FIX_AXIS_PAR_DIST 0 1 10 /end AXIS_DESCR
/end CHARACTERISTIC
/begin CHARACTERISTIC KFZWOP "подтверждена | профиль | адрес 0x10529, данные 0x10529 | масштаб x0.75 grad KW | Оптимальный угол опережения зажигания. Столбцы = нагрузка (11 точек, ось SRL11OPUW), строки = обороты (16 точек, ось SNM16OPUB, x40 об/мин). Сток 0.75..45 град. Меняется и в тюнинге, и между двумя csok." MAP 0x10529 RL_GRID_DS8 0 CM_0p75_0_gradKW 0 127
 /begin AXIS_DESCR FIX_AXIS NO_INPUT_QUANTITY CM_IDENTITY 11 0 10 FIX_AXIS_PAR_DIST 0 1 11 /end AXIS_DESCR
 /begin AXIS_DESCR FIX_AXIS NO_INPUT_QUANTITY CM_IDENTITY 16 0 15 FIX_AXIS_PAR_DIST 0 1 16 /end AXIS_DESCR
/end CHARACTERISTIC
/begin CHARACTERISTIC NMAXPRL "подтверждена | damos | адрес 0x105DB, данные 0x105DB | масштаб x0.00390625 %/(U/min) | P-element in NMAX control" CURVE 0x105DB RL_GRID_DU8 0 CM_0p00390625_0_Umin 0 255
 /begin AXIS_DESCR FIX_AXIS NO_INPUT_QUANTITY CM_IDENTITY 8 0 7 FIX_AXIS_PAR_DIST 0 1 8 /end AXIS_DESCR
/end CHARACTERISTIC
/begin CHARACTERISTIC NMXDAEF "подтверждена | damos | адрес 0x105EC, данные 0x105EC | масштаб x40 Upm | maximum permitted engine speed for throttle actuator substitute function" CURVE 0x105EC RL_GRID_DU8 0 CM_40_0_Upm 0 255
 /begin AXIS_DESCR FIX_AXIS NO_INPUT_QUANTITY CM_IDENTITY 6 0 5 FIX_AXIS_PAR_DIST 0 1 6 /end AXIS_DESCR
/end CHARACTERISTIC
/begin CHARACTERISTIC ZINMAXRL "подтверждена | damos | адрес 0x105FA, данные 0x105FA | I-gradient for NMAX control" CURVE 0x105FA RL_GRID_DU8 0 CM_IDENTITY 0 255
 /begin AXIS_DESCR FIX_AXIS NO_INPUT_QUANTITY CM_IDENTITY 8 0 7 FIX_AXIS_PAR_DIST 0 1 8 /end AXIS_DESCR
/end CHARACTERISTIC
/begin CHARACTERISTIC RLMNN "вероятная | damos-вероятно | адрес 0x1060D, данные 0x1060D | масштаб x0.75 % | characteristic minimum charge" CURVE 0x1060D RL_GRID_DU8 0 CM_0p75_0 0 255
 /begin AXIS_DESCR FIX_AXIS NO_INPUT_QUANTITY CM_IDENTITY 10 0 9 FIX_AXIS_PAR_DIST 0 1 10 /end AXIS_DESCR
/end CHARACTERISTIC
/begin CHARACTERISTIC RLMNSAN "вероятная | damos-вероятно | адрес 0x10617, данные 0x10617 | масштаб x0.75 % | characteristic minimum charge in overrun" CURVE 0x10617 RL_GRID_DU8 0 CM_0p75_0 0 255
 /begin AXIS_DESCR FIX_AXIS NO_INPUT_QUANTITY CM_IDENTITY 10 0 9 FIX_AXIS_PAR_DIST 0 1 10 /end AXIS_DESCR
/end CHARACTERISTIC
/begin CHARACTERISTIC KFMIRED "вероятная | damos-вероятно | адрес 0x10622, данные 0x10622 | масштаб x0.390625 % | Map of decreasing control torque for VMAX control" MAP 0x10622 RL_GRID_DU8 0 CM_0p390625_0 0 255
 /begin AXIS_DESCR FIX_AXIS NO_INPUT_QUANTITY CM_IDENTITY 3 0 2 FIX_AXIS_PAR_DIST 0 1 3 /end AXIS_DESCR
 /begin AXIS_DESCR FIX_AXIS NO_INPUT_QUANTITY CM_IDENTITY 2 0 1 FIX_AXIS_PAR_DIST 0 1 2 /end AXIS_DESCR
/end CHARACTERISTIC
/begin CHARACTERISTIC SBF02MFSB "подтверждена | damos | адрес 0x10629, данные 0x10629" CURVE 0x10629 RL_GRID_DU8 0 CM_IDENTITY 0 255
 /begin AXIS_DESCR FIX_AXIS NO_INPUT_QUANTITY CM_IDENTITY 2 0 1 FIX_AXIS_PAR_DIST 0 1 2 /end AXIS_DESCR
/end CHARACTERISTIC
/begin CHARACTERISTIC FSWALUV "вероятная | damos-вероятно | адрес 0x10631, данные 0x10631 | масштаб x0.0980392  | rough road detection threshold = f (vehicle speed)" CURVE 0x10631 RL_GRID_DU8 0 CM_0p09803921569_0 0 255
 /begin AXIS_DESCR FIX_AXIS NO_INPUT_QUANTITY CM_IDENTITY 4 0 3 FIX_AXIS_PAR_DIST 0 1 4 /end AXIS_DESCR
/end CHARACTERISTIC
/begin CHARACTERISTIC FUGKUE "вероятная | damos-вероятно | адрес 0x10639, данные 0x10639 | Gear box ratio detection" CURVE 0x10639 RL_GRID_DU8 0 CM_IDENTITY 0 255
 /begin AXIS_DESCR FIX_AXIS NO_INPUT_QUANTITY CM_IDENTITY 255 0 254 FIX_AXIS_PAR_DIST 0 1 255 /end AXIS_DESCR
/end CHARACTERISTIC
/begin CHARACTERISTIC FKODASH "подтверждена | damos | адрес 0x1073B, данные 0x1073B | масштаб x0.03125 - | A/C dependent line for correction factor" CURVE 0x1073B RL_GRID_DU8 0 CM_0p03125_0 0 255
 /begin AXIS_DESCR FIX_AXIS NO_INPUT_QUANTITY CM_IDENTITY 8 0 7 FIX_AXIS_PAR_DIST 0 1 8 /end AXIS_DESCR
/end CHARACTERISTIC
/begin CHARACTERISTIC FVDASHM "подтверждена | damos | адрес 0x1074C, данные 0x1074C | масштаб x0.03125 - | Gain factor for dashpot" CURVE 0x1074C RL_GRID_DU8 0 CM_0p03125_0 0 255
 /begin AXIS_DESCR FIX_AXIS NO_INPUT_QUANTITY CM_IDENTITY 8 0 7 FIX_AXIS_PAR_DIST 0 1 8 /end AXIS_DESCR
/end CHARACTERISTIC
/begin CHARACTERISTIC KFMIDSH0 "подтверждена | damos-точно | адрес 0x1076C, данные 0x1076C | масштаб x0.390625 % | torque for dashpot (geardependent)" MAP 0x1076C RL_GRID_DU8 0 CM_0p390625_0 0 255
 /begin AXIS_DESCR FIX_AXIS NO_INPUT_QUANTITY CM_IDENTITY 6 0 5 FIX_AXIS_PAR_DIST 0 1 6 /end AXIS_DESCR
 /begin AXIS_DESCR FIX_AXIS NO_INPUT_QUANTITY CM_IDENTITY 8 0 7 FIX_AXIS_PAR_DIST 0 1 8 /end AXIS_DESCR
/end CHARACTERISTIC
/begin CHARACTERISTIC KFMIDSH1 "подтверждена | damos-точно | адрес 0x107AC, данные 0x107AC | масштаб x0.390625 % | torque for dashpot (geardependent)" MAP 0x107AC RL_GRID_DU8 0 CM_0p390625_0 0 255
 /begin AXIS_DESCR FIX_AXIS NO_INPUT_QUANTITY CM_IDENTITY 6 0 5 FIX_AXIS_PAR_DIST 0 1 6 /end AXIS_DESCR
 /begin AXIS_DESCR FIX_AXIS NO_INPUT_QUANTITY CM_IDENTITY 8 0 7 FIX_AXIS_PAR_DIST 0 1 8 /end AXIS_DESCR
/end CHARACTERISTIC
/begin CHARACTERISTIC KFMIDSH2 "подтверждена | damos-точно | адрес 0x107EC, данные 0x107EC | масштаб x0.390625 % | torque for dashpot (geardependent)" MAP 0x107EC RL_GRID_DU8 0 CM_0p390625_0 0 255
 /begin AXIS_DESCR FIX_AXIS NO_INPUT_QUANTITY CM_IDENTITY 6 0 5 FIX_AXIS_PAR_DIST 0 1 6 /end AXIS_DESCR
 /begin AXIS_DESCR FIX_AXIS NO_INPUT_QUANTITY CM_IDENTITY 8 0 7 FIX_AXIS_PAR_DIST 0 1 8 /end AXIS_DESCR
/end CHARACTERISTIC
/begin CHARACTERISTIC KFMIDSH3 "подтверждена | damos-точно | адрес 0x1082C, данные 0x1082C | масштаб x0.390625 % | torque for dashpot (geardependent)" MAP 0x1082C RL_GRID_DU8 0 CM_0p390625_0 0 255
 /begin AXIS_DESCR FIX_AXIS NO_INPUT_QUANTITY CM_IDENTITY 6 0 5 FIX_AXIS_PAR_DIST 0 1 6 /end AXIS_DESCR
 /begin AXIS_DESCR FIX_AXIS NO_INPUT_QUANTITY CM_IDENTITY 8 0 7 FIX_AXIS_PAR_DIST 0 1 8 /end AXIS_DESCR
/end CHARACTERISTIC
/begin CHARACTERISTIC ZDSH1GS "вероятная | damos-вероятно | адрес 0x1085C, данные 0x1085C | time constant for dash pot decay speed (geardependent)" CURVE 0x1085C RL_GRID_DU8 0 CM_IDENTITY 0 255
 /begin AXIS_DESCR FIX_AXIS NO_INPUT_QUANTITY CM_IDENTITY 6 0 5 FIX_AXIS_PAR_DIST 0 1 6 /end AXIS_DESCR
/end CHARACTERISTIC
/begin CHARACTERISTIC ZDSHGS "вероятная | damos-вероятно | адрес 0x10862, данные 0x10862 | time constant for dash pot decay speed (geardependent)" CURVE 0x10862 RL_GRID_DU8 0 CM_IDENTITY 0 255
 /begin AXIS_DESCR FIX_AXIS NO_INPUT_QUANTITY CM_IDENTITY 6 0 5 FIX_AXIS_PAR_DIST 0 1 6 /end AXIS_DESCR
/end CHARACTERISTIC
/begin CHARACTERISTIC DZWETA "вероятная | damos-вероятно | адрес 0x1086C, данные 0x1086C | масштаб x0.75 grad KW | delta ignition angle from efficiency" CURVE 0x1086C RL_GRID_DS8 0 CM_0p75_0_gradKW 0 127
 /begin AXIS_DESCR FIX_AXIS NO_INPUT_QUANTITY CM_IDENTITY 201 0 200 FIX_AXIS_PAR_DIST 0 1 201 /end AXIS_DESCR
/end CHARACTERISTIC
/begin CHARACTERISTIC KFZWMS "подтверждена | профиль | адрес 0x10935, данные 0x10935 | масштаб x0.75 grad KW | Предельно поздний угол зажигания. В стоке вся карта равна -33 (-24.75 град). Правится тюнингом." MAP 0x10935 RL_GRID_DS8 0 CM_0p75_0_gradKW 0 127
 /begin AXIS_DESCR FIX_AXIS NO_INPUT_QUANTITY CM_IDENTITY 12 0 11 FIX_AXIS_PAR_DIST 0 1 12 /end AXIS_DESCR
 /begin AXIS_DESCR FIX_AXIS NO_INPUT_QUANTITY CM_IDENTITY 16 0 15 FIX_AXIS_PAR_DIST 0 1 16 /end AXIS_DESCR
/end CHARACTERISTIC
/begin CHARACTERISTIC KFZW "подтверждена | профиль | адрес 0x109F5, данные 0x109F5 | масштаб x0.75 grad KW | Основная карта угла опережения зажигания. Столбцы = нагрузка (12 точек, ось SRL12ZUUB), строки = обороты (16 точек, SNM16ZUUB). Сток -0.75..42.75 град." MAP 0x109F5 RL_GRID_DS8 0 CM_0p75_0_gradKW 0 127
 /begin AXIS_DESCR FIX_AXIS NO_INPUT_QUANTITY CM_IDENTITY 12 0 11 FIX_AXIS_PAR_DIST 0 1 12 /end AXIS_DESCR
 /begin AXIS_DESCR FIX_AXIS NO_INPUT_QUANTITY CM_IDENTITY 16 0 15 FIX_AXIS_PAR_DIST 0 1 16 /end AXIS_DESCR
/end CHARACTERISTIC
/begin CHARACTERISTIC KFZW2 "подтверждена | профиль | адрес 0x10AB5, данные 0x10AB5 | масштаб x0.75 grad KW | Карта зажигания, вариант 2. Сток 2.25..33.75 град." MAP 0x10AB5 RL_GRID_DS8 0 CM_0p75_0_gradKW 0 127
 /begin AXIS_DESCR FIX_AXIS NO_INPUT_QUANTITY CM_IDENTITY 12 0 11 FIX_AXIS_PAR_DIST 0 1 12 /end AXIS_DESCR
 /begin AXIS_DESCR FIX_AXIS NO_INPUT_QUANTITY CM_IDENTITY 16 0 15 FIX_AXIS_PAR_DIST 0 1 16 /end AXIS_DESCR
/end CHARACTERISTIC
/begin CHARACTERISTIC FSZTM "подтверждена | damos | адрес 0x10B76, данные 0x10B76 | масштаб x0.0078125 - | Factor dwell angle correction tmot depending" CURVE 0x10B76 RL_GRID_DU8 0 CM_0p0078125_0 0 255
 /begin AXIS_DESCR FIX_AXIS NO_INPUT_QUANTITY CM_IDENTITY 8 0 7 FIX_AXIS_PAR_DIST 0 1 8 /end AXIS_DESCR
/end CHARACTERISTIC
/begin CHARACTERISTIC KFSZT "подтверждена | damos | адрес 0x10B98, данные 0x10B98 | масштаб x0.1 ms | Dwell angle characteristic map" MAP 0x10B98 RL_GRID_DU8 0 CM_0p1_0_ms 0 255
 /begin AXIS_DESCR FIX_AXIS NO_INPUT_QUANTITY CM_IDENTITY 8 0 7 FIX_AXIS_PAR_DIST 0 1 8 /end AXIS_DESCR
 /begin AXIS_DESCR FIX_AXIS NO_INPUT_QUANTITY CM_IDENTITY 8 0 7 FIX_AXIS_PAR_DIST 0 1 8 /end AXIS_DESCR
/end CHARACTERISTIC
/begin CHARACTERISTIC MAP_056_10D9A_6 "вероятная | mapscan | адрес 0x10D9A, данные 0x10DA7" CURVE 0x10D9A RL_2D_A16_DU16 0 CM_IDENTITY 0 65535 /begin AXIS_DESCR STD_AXIS NO_INPUT_QUANTITY CM_IDENTITY 6 0 65535 /end AXIS_DESCR /end CHARACTERISTIC
/begin CHARACTERISTIC SNS06LLSB "вероятная | damos-вероятно | адрес 0x10F01, данные 0x10F01 | Datapoint distribution, set-speed deviation, 06 datapoints., idle-speed control." CURVE 0x10F01 RL_GRID_DU8 0 CM_IDENTITY 0 255
 /begin AXIS_DESCR FIX_AXIS NO_INPUT_QUANTITY CM_IDENTITY 6 0 5 FIX_AXIS_PAR_DIST 0 1 6 /end AXIS_DESCR
/end CHARACTERISTIC
/begin CHARACTERISTIC ZNSMST "вероятная | damos-вероятно | адрес 0x10F14, данные 0x10F14 | time constant for decay of reference speed at start" CURVE 0x10F14 RL_GRID_DU8 0 CM_IDENTITY 0 255
 /begin AXIS_DESCR FIX_AXIS NO_INPUT_QUANTITY CM_IDENTITY 6 0 5 FIX_AXIS_PAR_DIST 0 1 6 /end AXIS_DESCR
/end CHARACTERISTIC
/begin CHARACTERISTIC DMLLRIMXN "вероятная | damos-вероятно | адрес 0x10F1B, данные 0x10F1B | масштаб x0.390625 % | Safety concept: upper limit for dmllri" CURVE 0x10F1B RL_GRID_DU8 0 CM_0p390625_0 0 255
 /begin AXIS_DESCR FIX_AXIS NO_INPUT_QUANTITY CM_IDENTITY 6 0 5 FIX_AXIS_PAR_DIST 0 1 6 /end AXIS_DESCR
/end CHARACTERISTIC
/begin CHARACTERISTIC DMLLRLMNN "вероятная | damos-вероятно | адрес 0x10F21, данные 0x10F21 | масштаб x0.3906 % | Lower limit for dmllrl" CURVE 0x10F21 RL_GRID_DS8 0 CM_0p3906_0 0 127
 /begin AXIS_DESCR FIX_AXIS NO_INPUT_QUANTITY CM_IDENTITY 6 0 5 FIX_AXIS_PAR_DIST 0 1 6 /end AXIS_DESCR
/end CHARACTERISTIC
/begin CHARACTERISTIC DMLLRLMXN "вероятная | damos-вероятно | адрес 0x10F27, данные 0x10F27 | масштаб x0.390625 % | Safety concept: upper limit for dmllrl" CURVE 0x10F27 RL_GRID_DU8 0 CM_0p390625_0 0 255
 /begin AXIS_DESCR FIX_AXIS NO_INPUT_QUANTITY CM_IDENTITY 6 0 5 FIX_AXIS_PAR_DIST 0 1 6 /end AXIS_DESCR
/end CHARACTERISTIC
/begin CHARACTERISTIC DMLLRMNN "вероятная | damos-вероятно | адрес 0x10F2D, данные 0x10F2D | масштаб x0.3906 % | Lower limit for dmllr_w" CURVE 0x10F2D RL_GRID_DS8 0 CM_0p3906_0 0 127
 /begin AXIS_DESCR FIX_AXIS NO_INPUT_QUANTITY CM_IDENTITY 6 0 5 FIX_AXIS_PAR_DIST 0 1 6 /end AXIS_DESCR
/end CHARACTERISTIC
/begin CHARACTERISTIC DMLLRMXN "вероятная | damos-вероятно | адрес 0x10F33, данные 0x10F33 | масштаб x0.390625 % | Safety concept: upper limit for dmllr" CURVE 0x10F33 RL_GRID_DU8 0 CM_0p390625_0 0 255
 /begin AXIS_DESCR FIX_AXIS NO_INPUT_QUANTITY CM_IDENTITY 6 0 5 FIX_AXIS_PAR_DIST 0 1 6 /end AXIS_DESCR
/end CHARACTERISTIC
/begin CHARACTERISTIC DVNG "вероятная | damos-вероятно | адрес 0x10F3B, данные 0x10F3B | масштаб x-0.000488281 (%*s)/(U/min) | LLR: D-gain depending of ngfil for vehicle at rest" CURVE 0x10F3B RL_GRID_DS8 0 CM_n0p00048828125_n0_sUmin 0 127
 /begin AXIS_DESCR FIX_AXIS NO_INPUT_QUANTITY CM_IDENTITY 6 0 5 FIX_AXIS_PAR_DIST 0 1 6 /end AXIS_DESCR
/end CHARACTERISTIC
/begin CHARACTERISTIC DVNGV "вероятная | damos-вероятно | адрес 0x10F41, данные 0x10F41 | масштаб x-0.000488281 (%*s)/(U/min) | LLR: D-gain depending of ngfil for vehicle rolling" CURVE 0x10F41 RL_GRID_DS8 0 CM_n0p00048828125_n0_sUmin 0 127
 /begin AXIS_DESCR FIX_AXIS NO_INPUT_QUANTITY CM_IDENTITY 6 0 5 FIX_AXIS_PAR_DIST 0 1 6 /end AXIS_DESCR
/end CHARACTERISTIC
/begin CHARACTERISTIC FDDN "вероятная | damos-вероятно | адрес 0x10F47, данные 0x10F47 | масштаб x0.00390625 - | LLR: weightning factor for D-amplification" CURVE 0x10F47 RL_GRID_DU8 0 CM_0p00390625_0 0 255
 /begin AXIS_DESCR FIX_AXIS NO_INPUT_QUANTITY CM_IDENTITY 6 0 5 FIX_AXIS_PAR_DIST 0 1 6 /end AXIS_DESCR
/end CHARACTERISTIC
/begin CHARACTERISTIC GFDLDN "вероятная | damos-вероятно | адрес 0x10F4E, данные 0x10F4E | масштаб x0.00390625 % | LLR: weightning factor for D-amplification on the air path" CURVE 0x10F4E RL_GRID_DU8 0 CM_0p00390625_0 0 255
 /begin AXIS_DESCR FIX_AXIS NO_INPUT_QUANTITY CM_IDENTITY 6 0 5 FIX_AXIS_PAR_DIST 0 1 6 /end AXIS_DESCR
/end CHARACTERISTIC
/begin CHARACTERISTIC IVDN "вероятная | damos-вероятно | адрес 0x10F54, данные 0x10F54 | масштаб x0.00238281 %/(s*U/min) | LLR: I-gain for vehicle at rest" CURVE 0x10F54 RL_GRID_DU8 0 CM_0p0023828125_0_sUmin 0 255
 /begin AXIS_DESCR FIX_AXIS NO_INPUT_QUANTITY CM_IDENTITY 6 0 5 FIX_AXIS_PAR_DIST 0 1 6 /end AXIS_DESCR
/end CHARACTERISTIC
/begin CHARACTERISTIC IVDNDTE "вероятная | damos-вероятно | адрес 0x10F5A, данные 0x10F5A | масштаб x0.00238281 %/(s*U/min) | LLR: I-gain at DTEV" CURVE 0x10F5A RL_GRID_DU8 0 CM_0p0023828125_0_sUmin 0 255
 /begin AXIS_DESCR FIX_AXIS NO_INPUT_QUANTITY CM_IDENTITY 6 0 5 FIX_AXIS_PAR_DIST 0 1 6 /end AXIS_DESCR
/end CHARACTERISTIC
/begin CHARACTERISTIC PVDN "вероятная | damos-вероятно | адрес 0x10F71, данные 0x10F71 | масштаб x0.00152588 - | LLR: P-gain for vehicle at rest" CURVE 0x10F71 RL_GRID_DU8 0 CM_0p001525878906_0 0 255
 /begin AXIS_DESCR FIX_AXIS NO_INPUT_QUANTITY CM_IDENTITY 6 0 5 FIX_AXIS_PAR_DIST 0 1 6 /end AXIS_DESCR
/end CHARACTERISTIC
/begin CHARACTERISTIC PVLDN "вероятная | damos-вероятно | адрес 0x10F83, данные 0x10F83 | масштаб x0.00152588 - | LLR: P-gain for vehicle at rest (air path)" CURVE 0x10F83 RL_GRID_DU8 0 CM_0p001525878906_0 0 255
 /begin AXIS_DESCR FIX_AXIS NO_INPUT_QUANTITY CM_IDENTITY 6 0 5 FIX_AXIS_PAR_DIST 0 1 6 /end AXIS_DESCR
/end CHARACTERISTIC
/begin CHARACTERISTIC PVLDNV "вероятная | damos-вероятно | адрес 0x10F89, данные 0x10F89 | масштаб x0.00152588 - | LLR: P-gain for vehicle at rest (air path)" CURVE 0x10F89 RL_GRID_DU8 0 CM_0p001525878906_0 0 255
 /begin AXIS_DESCR FIX_AXIS NO_INPUT_QUANTITY CM_IDENTITY 6 0 5 FIX_AXIS_PAR_DIST 0 1 6 /end AXIS_DESCR
/end CHARACTERISTIC
/begin CHARACTERISTIC SDN06LLSB "вероятная | damos-вероятно | адрес 0x10F8F, данные 0x10F8F | 10 Sst." CURVE 0x10F8F RL_GRID_DU8 0 CM_IDENTITY 0 255
 /begin AXIS_DESCR FIX_AXIS NO_INPUT_QUANTITY CM_IDENTITY 6 0 5 FIX_AXIS_PAR_DIST 0 1 6 /end AXIS_DESCR
/end CHARACTERISTIC
/begin CHARACTERISTIC SNS206LLSB "вероятная | damos-вероятно | адрес 0x10F96, данные 0x10F96" CURVE 0x10F96 RL_GRID_DU8 0 CM_IDENTITY 0 255
 /begin AXIS_DESCR FIX_AXIS NO_INPUT_QUANTITY CM_IDENTITY 6 0 5 FIX_AXIS_PAR_DIST 0 1 6 /end AXIS_DESCR
/end CHARACTERISTIC
/begin CHARACTERISTIC KLMDLOAD2 "подтверждена | damos | адрес 0x10FA3, данные 0x10FA3 | масштаб x0.390625 % | charact. line for torque for electrical load 2" CURVE 0x10FA3 RL_GRID_DU8 0 CM_0p390625_0 0 255
 /begin AXIS_DESCR FIX_AXIS NO_INPUT_QUANTITY CM_IDENTITY 8 0 7 FIX_AXIS_PAR_DIST 0 1 8 /end AXIS_DESCR
/end CHARACTERISTIC
/begin CHARACTERISTIC FABMDWA "подтверждена | damos | адрес 0x10FBB, данные 0x10FBB | масштаб x0.00390625 - | Factor to decrease the converter torque depending of nturb" CURVE 0x10FBB RL_GRID_DU8 0 CM_0p00390625_0 0 255
 /begin AXIS_DESCR FIX_AXIS NO_INPUT_QUANTITY CM_IDENTITY 6 0 5 FIX_AXIS_PAR_DIST 0 1 6 /end AXIS_DESCR
/end CHARACTERISTIC
/begin CHARACTERISTIC TVFSAM "вероятная | damos-вероятно | адрес 0x10FC9, данные 0x10FC9 | масштаб x0.02 s | Delay time after DRIVE-position switch off" CURVE 0x10FC9 RL_GRID_DU8 0 CM_0p02_0_s 0 255
 /begin AXIS_DESCR FIX_AXIS NO_INPUT_QUANTITY CM_IDENTITY 6 0 5 FIX_AXIS_PAR_DIST 0 1 6 /end AXIS_DESCR
/end CHARACTERISTIC
/begin CHARACTERISTIC TVFSAMR "вероятная | damos-вероятно | адрес 0x10FCF, данные 0x10FCF | масштаб x0.02 s | delay time after DRIVE-position switch off (Reverse)" CURVE 0x10FCF RL_GRID_DU8 0 CM_0p02_0_s 0 255
 /begin AXIS_DESCR FIX_AXIS NO_INPUT_QUANTITY CM_IDENTITY 6 0 5 FIX_AXIS_PAR_DIST 0 1 6 /end AXIS_DESCR
/end CHARACTERISTIC
/begin CHARACTERISTIC TVFSEM "вероятная | damos-вероятно | адрес 0x10FD5, данные 0x10FD5 | масштаб x0.02 s | delay time after DRIVE-position switch on" CURVE 0x10FD5 RL_GRID_DU8 0 CM_0p02_0_s 0 255
 /begin AXIS_DESCR FIX_AXIS NO_INPUT_QUANTITY CM_IDENTITY 6 0 5 FIX_AXIS_PAR_DIST 0 1 6 /end AXIS_DESCR
/end CHARACTERISTIC
/begin CHARACTERISTIC TVFSEMR "вероятная | damos-вероятно | адрес 0x10FDB, данные 0x10FDB | масштаб x0.02 s | delay time after DRIVE-position switch on (Reverse)" CURVE 0x10FDB RL_GRID_DU8 0 CM_0p02_0_s 0 255
 /begin AXIS_DESCR FIX_AXIS NO_INPUT_QUANTITY CM_IDENTITY 6 0 5 FIX_AXIS_PAR_DIST 0 1 6 /end AXIS_DESCR
/end CHARACTERISTIC
/begin CHARACTERISTIC UEVERG "вероятная | damos-вероятно | адрес 0x10FE2, данные 0x10FE2 | масштаб x0.0625 - | Gear ratio depending of the gear" CURVE 0x10FE2 RL_GRID_DU8 0 CM_0p0625_0 0 255
 /begin AXIS_DESCR FIX_AXIS NO_INPUT_QUANTITY CM_IDENTITY 14 0 13 FIX_AXIS_PAR_DIST 0 1 14 /end AXIS_DESCR
/end CHARACTERISTIC
/begin CHARACTERISTIC ZKMDWAM "вероятная | damos-вероятно | адрес 0x10FF0, данные 0x10FF0 | Time constant for converter torque change" CURVE 0x10FF0 RL_GRID_DU8 0 CM_IDENTITY 0 255
 /begin AXIS_DESCR FIX_AXIS NO_INPUT_QUANTITY CM_IDENTITY 6 0 5 FIX_AXIS_PAR_DIST 0 1 6 /end AXIS_DESCR
/end CHARACTERISTIC
/begin CHARACTERISTIC FZN0 "вероятная | damos-вероятно | адрес 0x10FF8, данные 0x10FF8 | масштаб x0.00195312  | Cylinder individual factor at neutral camshaft position EV 1" CURVE 0x10FF8 RL_GRID_DU8 0 CM_0p001953125_n0p75 0 255
 /begin AXIS_DESCR FIX_AXIS NO_INPUT_QUANTITY CM_IDENTITY 16 0 15 FIX_AXIS_PAR_DIST 0 1 16 /end AXIS_DESCR
/end CHARACTERISTIC
/begin CHARACTERISTIC FZN1 "вероятная | damos-вероятно | адрес 0x11008, данные 0x11008 | масштаб x0.00195312  | Cylinder individual factor at neutral camshaft position EV 1" CURVE 0x11008 RL_GRID_DU8 0 CM_0p001953125_n0p75 0 255
 /begin AXIS_DESCR FIX_AXIS NO_INPUT_QUANTITY CM_IDENTITY 16 0 15 FIX_AXIS_PAR_DIST 0 1 16 /end AXIS_DESCR
/end CHARACTERISTIC
/begin CHARACTERISTIC FZN2 "вероятная | damos-вероятно | адрес 0x11018, данные 0x11018 | масштаб x0.00195312  | Cylinder individual factor at neutral camshaft position EV 2" CURVE 0x11018 RL_GRID_DU8 0 CM_0p001953125_n0p75 0 255
 /begin AXIS_DESCR FIX_AXIS NO_INPUT_QUANTITY CM_IDENTITY 16 0 15 FIX_AXIS_PAR_DIST 0 1 16 /end AXIS_DESCR
/end CHARACTERISTIC
/begin CHARACTERISTIC FZN3 "вероятная | damos-вероятно | адрес 0x11028, данные 0x11028 | масштаб x0.00195312  | Cylinder individual factor at neutral camshaft position EV 3" CURVE 0x11028 RL_GRID_DU8 0 CM_0p001953125_n0p75 0 255
 /begin AXIS_DESCR FIX_AXIS NO_INPUT_QUANTITY CM_IDENTITY 16 0 15 FIX_AXIS_PAR_DIST 0 1 16 /end AXIS_DESCR
/end CHARACTERISTIC
/begin CHARACTERISTIC FZN4 "вероятная | damos-вероятно | адрес 0x11038, данные 0x11038 | масштаб x0.00195312  | Cylinder individual factor at neutral camshaft position EV 4" CURVE 0x11038 RL_GRID_DU8 0 CM_0p001953125_n0p75 0 255
 /begin AXIS_DESCR FIX_AXIS NO_INPUT_QUANTITY CM_IDENTITY 16 0 15 FIX_AXIS_PAR_DIST 0 1 16 /end AXIS_DESCR
/end CHARACTERISTIC
/begin CHARACTERISTIC FZN5 "вероятная | damos-вероятно | адрес 0x11048, данные 0x11048 | масштаб x0.00195312  | Cylinder individual factor at neutral camshaft position EV 5" CURVE 0x11048 RL_GRID_DU8 0 CM_0p001953125_n0p75 0 255
 /begin AXIS_DESCR FIX_AXIS NO_INPUT_QUANTITY CM_IDENTITY 16 0 15 FIX_AXIS_PAR_DIST 0 1 16 /end AXIS_DESCR
/end CHARACTERISTIC
/begin CHARACTERISTIC FZN6 "вероятная | damos-вероятно | адрес 0x11058, данные 0x11058 | масштаб x0.00195312  | Cylinder individual factor at neutral camshaft position EV 6" CURVE 0x11058 RL_GRID_DU8 0 CM_0p001953125_n0p75 0 255
 /begin AXIS_DESCR FIX_AXIS NO_INPUT_QUANTITY CM_IDENTITY 16 0 15 FIX_AXIS_PAR_DIST 0 1 16 /end AXIS_DESCR
/end CHARACTERISTIC
/begin CHARACTERISTIC FZN7 "вероятная | damos-вероятно | адрес 0x11068, данные 0x11068 | масштаб x0.00195312  | Cylinder individual factor at neutral camshaft position EV 7" CURVE 0x11068 RL_GRID_DU8 0 CM_0p001953125_n0p75 0 255
 /begin AXIS_DESCR FIX_AXIS NO_INPUT_QUANTITY CM_IDENTITY 16 0 15 FIX_AXIS_PAR_DIST 0 1 16 /end AXIS_DESCR
/end CHARACTERISTIC
/begin CHARACTERISTIC FZNWN0 "вероятная | damos-вероятно | адрес 0x11078, данные 0x11078 | масштаб x0.00195312  | Cylinder individual factor at active camshaft position EV 1" CURVE 0x11078 RL_GRID_DU8 0 CM_0p001953125_n0p75 0 255
 /begin AXIS_DESCR FIX_AXIS NO_INPUT_QUANTITY CM_IDENTITY 16 0 15 FIX_AXIS_PAR_DIST 0 1 16 /end AXIS_DESCR
/end CHARACTERISTIC
/begin CHARACTERISTIC FZNWN1 "вероятная | damos-вероятно | адрес 0x11088, данные 0x11088 | масштаб x0.00195312  | Cylinder individual factor at active camshaft position EV 1" CURVE 0x11088 RL_GRID_DU8 0 CM_0p001953125_n0p75 0 255
 /begin AXIS_DESCR FIX_AXIS NO_INPUT_QUANTITY CM_IDENTITY 16 0 15 FIX_AXIS_PAR_DIST 0 1 16 /end AXIS_DESCR
/end CHARACTERISTIC
/begin CHARACTERISTIC FZNWN2 "вероятная | damos-вероятно | адрес 0x11098, данные 0x11098 | масштаб x0.00195312  | Cylinder individual factor at active camshaft position EV 2" CURVE 0x11098 RL_GRID_DU8 0 CM_0p001953125_n0p75 0 255
 /begin AXIS_DESCR FIX_AXIS NO_INPUT_QUANTITY CM_IDENTITY 16 0 15 FIX_AXIS_PAR_DIST 0 1 16 /end AXIS_DESCR
/end CHARACTERISTIC
/begin CHARACTERISTIC FZNWN3 "вероятная | damos-вероятно | адрес 0x110A8, данные 0x110A8 | масштаб x0.00195312  | Cylinder individual factor at active camshaft position EV 3" CURVE 0x110A8 RL_GRID_DU8 0 CM_0p001953125_n0p75 0 255
 /begin AXIS_DESCR FIX_AXIS NO_INPUT_QUANTITY CM_IDENTITY 16 0 15 FIX_AXIS_PAR_DIST 0 1 16 /end AXIS_DESCR
/end CHARACTERISTIC
/begin CHARACTERISTIC FZNWN4 "вероятная | damos-вероятно | адрес 0x1110C, данные 0x1110C | масштаб x0.00195312  | Cylinder individual factor at active camshaft position EV 4" CURVE 0x1110C RL_GRID_DU8 0 CM_0p001953125_n0p75 0 255
 /begin AXIS_DESCR FIX_AXIS NO_INPUT_QUANTITY CM_IDENTITY 16 0 15 FIX_AXIS_PAR_DIST 0 1 16 /end AXIS_DESCR
/end CHARACTERISTIC
/begin CHARACTERISTIC FZNWN5 "вероятная | damos-вероятно | адрес 0x1111C, данные 0x1111C | масштаб x0.00195312  | Cylinder individual factor at active camshaft position EV 5" CURVE 0x1111C RL_GRID_DU8 0 CM_0p001953125_n0p75 0 255
 /begin AXIS_DESCR FIX_AXIS NO_INPUT_QUANTITY CM_IDENTITY 16 0 15 FIX_AXIS_PAR_DIST 0 1 16 /end AXIS_DESCR
/end CHARACTERISTIC
/begin CHARACTERISTIC FZNWN6 "вероятная | damos-вероятно | адрес 0x1112C, данные 0x1112C | масштаб x0.00195312  | Cylinder individual factor at active camshaft position EV 6" CURVE 0x1112C RL_GRID_DU8 0 CM_0p001953125_n0p75 0 255
 /begin AXIS_DESCR FIX_AXIS NO_INPUT_QUANTITY CM_IDENTITY 16 0 15 FIX_AXIS_PAR_DIST 0 1 16 /end AXIS_DESCR
/end CHARACTERISTIC
/begin CHARACTERISTIC FZNWN7 "вероятная | damos-вероятно | адрес 0x1113C, данные 0x1113C | масштаб x0.00195312  | Cylinder individual factor at active camshaft position EV 7" CURVE 0x1113C RL_GRID_DU8 0 CM_0p001953125_n0p75 0 255
 /begin AXIS_DESCR FIX_AXIS NO_INPUT_QUANTITY CM_IDENTITY 16 0 15 FIX_AXIS_PAR_DIST 0 1 16 /end AXIS_DESCR
/end CHARACTERISTIC
/begin CHARACTERISTIC KFWHSTT "вероятная | damos-вероятно | адрес 0x11156, данные 0x11156 | масштаб x0.0078125 - | map weighting of hot start factor" MAP 0x11156 RL_GRID_DU8 0 CM_0p0078125_0 0 255
 /begin AXIS_DESCR FIX_AXIS NO_INPUT_QUANTITY CM_IDENTITY 6 0 5 FIX_AXIS_PAR_DIST 0 1 6 /end AXIS_DESCR
 /begin AXIS_DESCR FIX_AXIS NO_INPUT_QUANTITY CM_IDENTITY 6 0 5 FIX_AXIS_PAR_DIST 0 1 6 /end AXIS_DESCR
/end CHARACTERISTIC
/begin CHARACTERISTIC KFWKSTN "вероятная | damos-вероятно | адрес 0x11184, данные 0x11184 | масштаб x0.00390625 - | map weighting of factor cold start" MAP 0x11184 RL_GRID_DU8 0 CM_0p00390625_0 0 255
 /begin AXIS_DESCR FIX_AXIS NO_INPUT_QUANTITY CM_IDENTITY 4 0 3 FIX_AXIS_PAR_DIST 0 1 4 /end AXIS_DESCR
 /begin AXIS_DESCR FIX_AXIS NO_INPUT_QUANTITY CM_IDENTITY 4 0 3 FIX_AXIS_PAR_DIST 0 1 4 /end AXIS_DESCR
/end CHARACTERISTIC
/begin CHARACTERISTIC KFWKSTT "подтверждена | damos-точно | адрес 0x111A8, данные 0x111A8 | масштаб x0.0078125 - | map weighting of factor cold start" MAP 0x111A8 RL_GRID_DU8 0 CM_0p0078125_0 0 255
 /begin AXIS_DESCR FIX_AXIS NO_INPUT_QUANTITY CM_IDENTITY 6 0 5 FIX_AXIS_PAR_DIST 0 1 6 /end AXIS_DESCR
 /begin AXIS_DESCR FIX_AXIS NO_INPUT_QUANTITY CM_IDENTITY 12 0 11 FIX_AXIS_PAR_DIST 0 1 12 /end AXIS_DESCR
/end CHARACTERISTIC
/begin CHARACTERISTIC PLRHAV "неоднозначная | damos-сомнительно | адрес 0x111F1, данные 0x111F1 | масштаб x0.00390625 - | Weighting factor of P-part LRHK depending on catalyst age" CURVE 0x111F1 RL_GRID_DU8 0 CM_0p00390625_0 0 255
 /begin AXIS_DESCR FIX_AXIS NO_INPUT_QUANTITY CM_IDENTITY 8 0 7 FIX_AXIS_PAR_DIST 0 1 8 /end AXIS_DESCR
/end CHARACTERISTIC
/begin CHARACTERISTIC FWSTAA1 "неоднозначная | damos-сомнительно | адрес 0x11205, данные 0x11205 | масштаб x0.0078125 - | afterstart correction" CURVE 0x11205 RL_GRID_DU8 0 CM_0p0078125_0 0 255
 /begin AXIS_DESCR FIX_AXIS NO_INPUT_QUANTITY CM_IDENTITY 6 0 5 FIX_AXIS_PAR_DIST 0 1 6 /end AXIS_DESCR
/end CHARACTERISTIC
/begin CHARACTERISTIC FWSTAB1 "неоднозначная | damos-сомнительно | адрес 0x1120B, данные 0x1120B | масштаб x0.0078125 - | weighting afterstart decrease range 1" CURVE 0x1120B RL_GRID_DU8 0 CM_0p0078125_0 0 255
 /begin AXIS_DESCR FIX_AXIS NO_INPUT_QUANTITY CM_IDENTITY 6 0 5 FIX_AXIS_PAR_DIST 0 1 6 /end AXIS_DESCR
/end CHARACTERISTIC
/begin CHARACTERISTIC FWSTAB2 "неоднозначная | damos-сомнительно | адрес 0x11211, данные 0x11211 | масштаб x0.0078125 - | weighting afterstart decrease range 2" CURVE 0x11211 RL_GRID_DU8 0 CM_0p0078125_0 0 255
 /begin AXIS_DESCR FIX_AXIS NO_INPUT_QUANTITY CM_IDENTITY 6 0 5 FIX_AXIS_PAR_DIST 0 1 6 /end AXIS_DESCR
/end CHARACTERISTIC
/begin CHARACTERISTIC FWSTAB3 "неоднозначная | damos-сомнительно | адрес 0x11217, данные 0x11217 | масштаб x0.0078125 - | weighting afterstart decrease range 3" CURVE 0x11217 RL_GRID_DU8 0 CM_0p0078125_0 0 255
 /begin AXIS_DESCR FIX_AXIS NO_INPUT_QUANTITY CM_IDENTITY 6 0 5 FIX_AXIS_PAR_DIST 0 1 6 /end AXIS_DESCR
/end CHARACTERISTIC
/begin CHARACTERISTIC FWSTAS1 "неоднозначная | damos-сомнительно | адрес 0x1121D, данные 0x1121D | масштаб x0.0078125 - | correction of threshold 1 for afterstart" CURVE 0x1121D RL_GRID_DU8 0 CM_0p0078125_0 0 255
 /begin AXIS_DESCR FIX_AXIS NO_INPUT_QUANTITY CM_IDENTITY 6 0 5 FIX_AXIS_PAR_DIST 0 1 6 /end AXIS_DESCR
/end CHARACTERISTIC
/begin CHARACTERISTIC FWSTAS2 "вероятная | damos-вероятно | адрес 0x11223, данные 0x11223 | масштаб x0.0078125 - | correction of threshold 2 for afterstart" CURVE 0x11223 RL_GRID_DU8 0 CM_0p0078125_0 0 255
 /begin AXIS_DESCR FIX_AXIS NO_INPUT_QUANTITY CM_IDENTITY 6 0 5 FIX_AXIS_PAR_DIST 0 1 6 /end AXIS_DESCR
/end CHARACTERISTIC
/begin CHARACTERISTIC LZFUER "вероятная | damos-вероятно | адрес 0x1122D, данные 0x1122D | guide cylinder assignment" CURVE 0x1122D RL_GRID_DU8 0 CM_IDENTITY 0 255
 /begin AXIS_DESCR FIX_AXIS NO_INPUT_QUANTITY CM_IDENTITY 8 0 7 FIX_AXIS_PAR_DIST 0 1 8 /end AXIS_DESCR
/end CHARACTERISTIC
/begin CHARACTERISTIC WKRLZOF "вероятная | damos-вероятно | адрес 0x11235, данные 0x11235 | масштаб x-0.75 grad KW | Bloc of fixed values: ignition reatard offset for guided cylinder" CURVE 0x11235 RL_GRID_DS8 0 CM_n0p75_0_gradKW 0 127
 /begin AXIS_DESCR FIX_AXIS NO_INPUT_QUANTITY CM_IDENTITY 8 0 7 FIX_AXIS_PAR_DIST 0 1 8 /end AXIS_DESCR
/end CHARACTERISTIC
/begin CHARACTERISTIC WDKNLN "вероятная | damos-вероятно | адрес 0x1124E, данные 0x1124E | масштаб x0.392157 % DK | limp home throttle plate angle" CURVE 0x1124E RL_GRID_DU8 0 CM_0p3921568627_0_DK 0 255
 /begin AXIS_DESCR FIX_AXIS NO_INPUT_QUANTITY CM_IDENTITY 6 0 5 FIX_AXIS_PAR_DIST 0 1 6 /end AXIS_DESCR
/end CHARACTERISTIC
/begin CHARACTERISTIC KFDMDN1 "сомнительная | damos-сомнительно | адрес 0x1126F, данные 0x1126F | масштаб x0.390625 % | Torque reduction at downshift by 1 gear" MAP 0x1126F RL_GRID_DU8 0 CM_0p390625_0 0 255
 /begin AXIS_DESCR FIX_AXIS NO_INPUT_QUANTITY CM_IDENTITY 4 0 3 FIX_AXIS_PAR_DIST 0 1 4 /end AXIS_DESCR
 /begin AXIS_DESCR FIX_AXIS NO_INPUT_QUANTITY CM_IDENTITY 5 0 4 FIX_AXIS_PAR_DIST 0 1 5 /end AXIS_DESCR
/end CHARACTERISTIC
/begin CHARACTERISTIC KFDMUP "сомнительная | damos-сомнительно | адрес 0x1128E, данные 0x1128E | масштаб x0.390625 % | Torque reduction at shift up" MAP 0x1128E RL_GRID_DU8 0 CM_0p390625_0 0 255
 /begin AXIS_DESCR FIX_AXIS NO_INPUT_QUANTITY CM_IDENTITY 4 0 3 FIX_AXIS_PAR_DIST 0 1 4 /end AXIS_DESCR
 /begin AXIS_DESCR FIX_AXIS NO_INPUT_QUANTITY CM_IDENTITY 5 0 4 FIX_AXIS_PAR_DIST 0 1 5 /end AXIS_DESCR
/end CHARACTERISTIC
/begin CHARACTERISTIC FHSTT "вероятная | damos-вероятно | адрес 0x112BA, данные 0x112BA | масштаб x0.25 - | factor hot start" CURVE 0x112BA RL_GRID_DU8 0 CM_0p25_0 0 255
 /begin AXIS_DESCR FIX_AXIS NO_INPUT_QUANTITY CM_IDENTITY 6 0 5 FIX_AXIS_PAR_DIST 0 1 6 /end AXIS_DESCR
/end CHARACTERISTIC
/begin CHARACTERISTIC MAP_115_112C2_14 "вероятная | mapscan | адрес 0x112C2, данные 0x112D1" CURVE 0x112C2 RL_2D_A8_DU8 0 CM_IDENTITY 0 255 /begin AXIS_DESCR STD_AXIS NO_INPUT_QUANTITY CM_IDENTITY 14 0 255 /end AXIS_DESCR /end CHARACTERISTIC
/begin CHARACTERISTIC GRID_116_112DF_4x49 "вероятная | gridscan | адрес 0x112DF, данные 0x112DF | константная таблица (все значения 128)" MAP 0x112DF RL_GRID_DU8 0 CM_IDENTITY 0 255
 /begin AXIS_DESCR FIX_AXIS NO_INPUT_QUANTITY CM_IDENTITY 4 0 3 FIX_AXIS_PAR_DIST 0 1 4 /end AXIS_DESCR
 /begin AXIS_DESCR FIX_AXIS NO_INPUT_QUANTITY CM_IDENTITY 49 0 48 FIX_AXIS_PAR_DIST 0 1 49 /end AXIS_DESCR
/end CHARACTERISTIC
/begin CHARACTERISTIC MAP_117_113A3_14x14 "вероятная | mapscan | адрес 0x113A3, данные 0x113C1" MAP 0x113A3 RL_3D_A8_DU16 0 CM_IDENTITY 0 65535 /begin AXIS_DESCR STD_AXIS NO_INPUT_QUANTITY CM_IDENTITY 14 0 255 /end AXIS_DESCR /begin AXIS_DESCR STD_AXIS NO_INPUT_QUANTITY CM_IDENTITY 14 0 255 /end AXIS_DESCR /end CHARACTERISTIC
/begin CHARACTERISTIC TKOAMXN "вероятная | damos-вероятно | адрес 0x11550, данные 0x11550 | масштаб x0.2 s | maximum shutdown time for air-conditioning compressor" CURVE 0x11550 RL_GRID_DU8 0 CM_0p2_0_s 0 255
 /begin AXIS_DESCR FIX_AXIS NO_INPUT_QUANTITY CM_IDENTITY 8 0 7 FIX_AXIS_PAR_DIST 0 1 8 /end AXIS_DESCR
/end CHARACTERISTIC
/begin CHARACTERISTIC TKOEMNN "вероятная | damos-вероятно | адрес 0x11558, данные 0x11558 | масштаб x0.2 s | minimal time of air-condition compressor beeing swiched on" CURVE 0x11558 RL_GRID_DU8 0 CM_0p2_0_s 0 255
 /begin AXIS_DESCR FIX_AXIS NO_INPUT_QUANTITY CM_IDENTITY 8 0 7 FIX_AXIS_PAR_DIST 0 1 8 /end AXIS_DESCR
/end CHARACTERISTIC
/begin CHARACTERISTIC MAP_120_11567_8 "вероятная | mapscan | адрес 0x11567, данные 0x11570" CURVE 0x11567 RL_2D_A8_DU8 0 CM_IDENTITY 0 255 /begin AXIS_DESCR STD_AXIS NO_INPUT_QUANTITY CM_IDENTITY 8 0 255 /end AXIS_DESCR /end CHARACTERISTIC
/begin CHARACTERISTIC FVRMDYN "вероятная | damos-вероятно | адрес 0x11579, данные 0x11579 | масштаб x0.03125 - | dynamic factor for purge flow in the manifold with fresh air" CURVE 0x11579 RL_GRID_DU8 0 CM_0p03125_0 0 255
 /begin AXIS_DESCR FIX_AXIS NO_INPUT_QUANTITY CM_IDENTITY 5 0 4 FIX_AXIS_PAR_DIST 0 1 5 /end AXIS_DESCR
/end CHARACTERISTIC
/begin CHARACTERISTIC MAP_122_11580_6 "вероятная | mapscan | адрес 0x11580, данные 0x11587" CURVE 0x11580 RL_2D_A8_DU8 0 CM_IDENTITY 0 255 /begin AXIS_DESCR STD_AXIS NO_INPUT_QUANTITY CM_IDENTITY 6 0 255 /end AXIS_DESCR /end CHARACTERISTIC
/begin CHARACTERISTIC MAP_123_11595_8 "вероятная | mapscan | адрес 0x11595, данные 0x1159E" CURVE 0x11595 RL_2D_A8_DU8 0 CM_IDENTITY 0 255 /begin AXIS_DESCR STD_AXIS NO_INPUT_QUANTITY CM_IDENTITY 8 0 255 /end AXIS_DESCR /end CHARACTERISTIC
/begin CHARACTERISTIC MAP_124_115EC_7 "вероятная | mapscan | адрес 0x115EC, данные 0x115F4" CURVE 0x115EC RL_2D_A8_DU8 0 CM_IDENTITY 0 255 /begin AXIS_DESCR STD_AXIS NO_INPUT_QUANTITY CM_IDENTITY 7 0 255 /end AXIS_DESCR /end CHARACTERISTIC
/begin CHARACTERISTIC MAP_125_115FB_7 "вероятная | mapscan | адрес 0x115FB, данные 0x11603" CURVE 0x115FB RL_2D_A8_DU8 0 CM_IDENTITY 0 255 /begin AXIS_DESCR STD_AXIS NO_INPUT_QUANTITY CM_IDENTITY 7 0 255 /end AXIS_DESCR /end CHARACTERISTIC
/begin CHARACTERISTIC FAGRH "вероятная | damos-вероятно | адрес 0x11612, данные 0x11612 | масштаб x0.0078125 - | altitude correction of EGR set value" CURVE 0x11612 RL_GRID_DU8 0 CM_0p0078125_0 0 255
 /begin AXIS_DESCR FIX_AXIS NO_INPUT_QUANTITY CM_IDENTITY 4 0 3 FIX_AXIS_PAR_DIST 0 1 4 /end AXIS_DESCR
/end CHARACTERISTIC
/begin CHARACTERISTIC MAP_127_11616_8 "вероятная | mapscan | адрес 0x11616, данные 0x1161F" CURVE 0x11616 RL_2D_A8_DU8 0 CM_IDENTITY 0 255 /begin AXIS_DESCR STD_AXIS NO_INPUT_QUANTITY CM_IDENTITY 8 0 255 /end AXIS_DESCR /end CHARACTERISTIC
/begin CHARACTERISTIC MAP_128_11673_6 "вероятная | mapscan | адрес 0x11673, данные 0x1167A" CURVE 0x11673 RL_2D_A8_DU8 0 CM_IDENTITY 0 255 /begin AXIS_DESCR STD_AXIS NO_INPUT_QUANTITY CM_IDENTITY 6 0 255 /end AXIS_DESCR /end CHARACTERISTIC
/begin CHARACTERISTIC MAP_129_1168B_6 "вероятная | mapscan | адрес 0x1168B, данные 0x11692" CURVE 0x1168B RL_2D_A8_DU8 0 CM_IDENTITY 0 255 /begin AXIS_DESCR STD_AXIS NO_INPUT_QUANTITY CM_IDENTITY 6 0 255 /end AXIS_DESCR /end CHARACTERISTIC
/begin CHARACTERISTIC MAP_130_11698_12 "вероятная | mapscan | адрес 0x11698, данные 0x116A5" CURVE 0x11698 RL_2D_A8_DU8 0 CM_IDENTITY 0 255 /begin AXIS_DESCR STD_AXIS NO_INPUT_QUANTITY CM_IDENTITY 12 0 255 /end AXIS_DESCR /end CHARACTERISTIC
/begin CHARACTERISTIC MAP_131_116B2_6x6 "вероятная | mapscan | адрес 0x116B2, данные 0x116C0" MAP 0x116B2 RL_3D_A8_DU8 0 CM_IDENTITY 0 255 /begin AXIS_DESCR STD_AXIS NO_INPUT_QUANTITY CM_IDENTITY 6 0 255 /end AXIS_DESCR /begin AXIS_DESCR STD_AXIS NO_INPUT_QUANTITY CM_IDENTITY 6 0 255 /end AXIS_DESCR /end CHARACTERISTIC
/begin CHARACTERISTIC MAP_132_116E5_4 "вероятная | mapscan | адрес 0x116E5, данные 0x116EA" CURVE 0x116E5 RL_2D_A8_DU8 0 CM_IDENTITY 0 255 /begin AXIS_DESCR STD_AXIS NO_INPUT_QUANTITY CM_IDENTITY 4 0 255 /end AXIS_DESCR /end CHARACTERISTIC
/begin CHARACTERISTIC KFAGRS "подтверждена | damos-точно | адрес 0x1171F, данные 0x1171F | масштаб x0.0195312 V | map EGR set value, camshaft position late" MAP 0x1171F RL_GRID_DU8 0 CM_0p01953125_0_V 0 255
 /begin AXIS_DESCR FIX_AXIS NO_INPUT_QUANTITY CM_IDENTITY 12 0 11 FIX_AXIS_PAR_DIST 0 1 12 /end AXIS_DESCR
 /begin AXIS_DESCR FIX_AXIS NO_INPUT_QUANTITY CM_IDENTITY 16 0 15 FIX_AXIS_PAR_DIST 0 1 16 /end AXIS_DESCR
/end CHARACTERISTIC
/begin CHARACTERISTIC MAP_134_11986_5x6 "вероятная | mapscan | адрес 0x11986, данные 0x11993" MAP 0x11986 RL_3D_A8_DU8 0 CM_IDENTITY 0 255 /begin AXIS_DESCR STD_AXIS NO_INPUT_QUANTITY CM_IDENTITY 5 0 255 /end AXIS_DESCR /begin AXIS_DESCR STD_AXIS NO_INPUT_QUANTITY CM_IDENTITY 6 0 255 /end AXIS_DESCR /end CHARACTERISTIC
/begin CHARACTERISTIC KFAGRI "сомнительная | damos-сомнительно | адрес 0x119B2, данные 0x119B2 | масштаб x0.03125 1/s | I component map of EGR controller" MAP 0x119B2 RL_GRID_DU8 0 CM_0p03125_0_1s 0 255
 /begin AXIS_DESCR FIX_AXIS NO_INPUT_QUANTITY CM_IDENTITY 7 0 6 FIX_AXIS_PAR_DIST 0 1 7 /end AXIS_DESCR
 /begin AXIS_DESCR FIX_AXIS NO_INPUT_QUANTITY CM_IDENTITY 7 0 6 FIX_AXIS_PAR_DIST 0 1 7 /end AXIS_DESCR
/end CHARACTERISTIC
/begin CHARACTERISTIC KFAGRP "сомнительная | damos-сомнительно | адрес 0x119E3, данные 0x119E3 | масштаб x0.00390625 - | P component map of EGR controller" MAP 0x119E3 RL_GRID_DU8 0 CM_0p00390625_0 0 255
 /begin AXIS_DESCR FIX_AXIS NO_INPUT_QUANTITY CM_IDENTITY 7 0 6 FIX_AXIS_PAR_DIST 0 1 7 /end AXIS_DESCR
 /begin AXIS_DESCR FIX_AXIS NO_INPUT_QUANTITY CM_IDENTITY 7 0 6 FIX_AXIS_PAR_DIST 0 1 7 /end AXIS_DESCR
/end CHARACTERISTIC
/begin CHARACTERISTIC MAP_137_11A1A_6 "вероятная | mapscan | адрес 0x11A1A, данные 0x11A21" CURVE 0x11A1A RL_2D_A8_DU8 0 CM_IDENTITY 0 255 /begin AXIS_DESCR STD_AXIS NO_INPUT_QUANTITY CM_IDENTITY 6 0 255 /end AXIS_DESCR /end CHARACTERISTIC
/begin CHARACTERISTIC SUA08FEUB "подтверждена | damos | адрес 0x11A2D, данные 0x11A2D" CURVE 0x11A2D RL_GRID_DU8 0 CM_IDENTITY 0 255
 /begin AXIS_DESCR FIX_AXIS NO_INPUT_QUANTITY CM_IDENTITY 7 0 6 FIX_AXIS_PAR_DIST 0 1 7 /end AXIS_DESCR
/end CHARACTERISTIC
/begin CHARACTERISTIC MAP_139_11A40_10x10 "вероятная | mapscan | адрес 0x11A40, данные 0x11A56" MAP 0x11A40 RL_3D_A8_DU8 0 CM_IDENTITY 0 255 /begin AXIS_DESCR STD_AXIS NO_INPUT_QUANTITY CM_IDENTITY 10 0 255 /end AXIS_DESCR /begin AXIS_DESCR STD_AXIS NO_INPUT_QUANTITY CM_IDENTITY 10 0 255 /end AXIS_DESCR /end CHARACTERISTIC
/begin CHARACTERISTIC FFTEV6 "вероятная | damos-вероятно | адрес 0x11ABB, данные 0x11ABB | freeze frame table: injector power stage 6" CURVE 0x11ABB RL_GRID_DU8 0 CM_IDENTITY 0 255
 /begin AXIS_DESCR FIX_AXIS NO_INPUT_QUANTITY CM_IDENTITY 2 0 1 FIX_AXIS_PAR_DIST 0 1 2 /end AXIS_DESCR
/end CHARACTERISTIC
/begin CHARACTERISTIC FFTFRAO "вероятная | damos-вероятно | адрес 0x11ABD, данные 0x11ABD | freeze frame table: FRAO mixture adaptation" CURVE 0x11ABD RL_GRID_DU8 0 CM_IDENTITY 0 255
 /begin AXIS_DESCR FIX_AXIS NO_INPUT_QUANTITY CM_IDENTITY 2 0 1 FIX_AXIS_PAR_DIST 0 1 2 /end AXIS_DESCR
/end CHARACTERISTIC
/begin CHARACTERISTIC FFTFRAU "вероятная | damos-вероятно | адрес 0x11ABF, данные 0x11ABF | freeze frame table: FRAU mixture adaptation" CURVE 0x11ABF RL_GRID_DU8 0 CM_IDENTITY 0 255
 /begin AXIS_DESCR FIX_AXIS NO_INPUT_QUANTITY CM_IDENTITY 2 0 1 FIX_AXIS_PAR_DIST 0 1 2 /end AXIS_DESCR
/end CHARACTERISTIC
/begin CHARACTERISTIC FFTFRST "вероятная | damos-вероятно | адрес 0x11AC1, данные 0x11AC1 | freeze frame table: deviation of lambda loop control" CURVE 0x11AC1 RL_GRID_DU8 0 CM_IDENTITY 0 255
 /begin AXIS_DESCR FIX_AXIS NO_INPUT_QUANTITY CM_IDENTITY 2 0 1 FIX_AXIS_PAR_DIST 0 1 2 /end AXIS_DESCR
/end CHARACTERISTIC
/begin CHARACTERISTIC FFTGE "вероятная | damos-вероятно | адрес 0x11AC3, данные 0x11AC3 | freeze frame table: transmission intervention" CURVE 0x11AC3 RL_GRID_DU8 0 CM_IDENTITY 0 255
 /begin AXIS_DESCR FIX_AXIS NO_INPUT_QUANTITY CM_IDENTITY 2 0 1 FIX_AXIS_PAR_DIST 0 1 2 /end AXIS_DESCR
/end CHARACTERISTIC
/begin CHARACTERISTIC FFTHSH "вероятная | damos-вероятно | адрес 0x11AC5, данные 0x11AC5 | Table of ambient condition for heating O2-sensor post cat" CURVE 0x11AC5 RL_GRID_DU8 0 CM_IDENTITY 0 255
 /begin AXIS_DESCR FIX_AXIS NO_INPUT_QUANTITY CM_IDENTITY 2 0 1 FIX_AXIS_PAR_DIST 0 1 2 /end AXIS_DESCR
/end CHARACTERISTIC
/begin CHARACTERISTIC FFTHSHE "вероятная | damos-вероятно | адрес 0x11AC7, данные 0x11AC7 | Table of environmental cond.for output stage heating lambda sens. downstr.of cat" CURVE 0x11AC7 RL_GRID_DU8 0 CM_IDENTITY 0 255
 /begin AXIS_DESCR FIX_AXIS NO_INPUT_QUANTITY CM_IDENTITY 2 0 1 FIX_AXIS_PAR_DIST 0 1 2 /end AXIS_DESCR
/end CHARACTERISTIC
/begin CHARACTERISTIC FFTHSV "вероятная | damos-вероятно | адрес 0x11AC9, данные 0x11AC9 | Table of ambient condition for heating O2-sensor pre cat" CURVE 0x11AC9 RL_GRID_DU8 0 CM_IDENTITY 0 255
 /begin AXIS_DESCR FIX_AXIS NO_INPUT_QUANTITY CM_IDENTITY 2 0 1 FIX_AXIS_PAR_DIST 0 1 2 /end AXIS_DESCR
/end CHARACTERISTIC
/begin CHARACTERISTIC FFTHSVE "вероятная | damos-вероятно | адрес 0x11ACB, данные 0x11ACB | Freeze frame table: 02 Sensor Heater power stage" CURVE 0x11ACB RL_GRID_DU8 0 CM_IDENTITY 0 255
 /begin AXIS_DESCR FIX_AXIS NO_INPUT_QUANTITY CM_IDENTITY 2 0 1 FIX_AXIS_PAR_DIST 0 1 2 /end AXIS_DESCR
/end CHARACTERISTIC
/begin CHARACTERISTIC FFTKAT "вероятная | damos-вероятно | адрес 0x11ACD, данные 0x11ACD | Freeze frame table: catalyst" CURVE 0x11ACD RL_GRID_DU8 0 CM_IDENTITY 0 255
 /begin AXIS_DESCR FIX_AXIS NO_INPUT_QUANTITY CM_IDENTITY 2 0 1 FIX_AXIS_PAR_DIST 0 1 2 /end AXIS_DESCR
/end CHARACTERISTIC
/begin CHARACTERISTIC FFTKOSE "вероятная | damos-вероятно | адрес 0x11ACF, данные 0x11ACF | Freeze frame table: A/C compressor control power stage" CURVE 0x11ACF RL_GRID_DU8 0 CM_IDENTITY 0 255
 /begin AXIS_DESCR FIX_AXIS NO_INPUT_QUANTITY CM_IDENTITY 2 0 1 FIX_AXIS_PAR_DIST 0 1 2 /end AXIS_DESCR
/end CHARACTERISTIC
/begin CHARACTERISTIC FFTKPE "вероятная | damos-вероятно | адрес 0x11AD1, данные 0x11AD1 | Freeze frame table: fuel pump relay power stage" CURVE 0x11AD1 RL_GRID_DU8 0 CM_IDENTITY 0 255
 /begin AXIS_DESCR FIX_AXIS NO_INPUT_QUANTITY CM_IDENTITY 2 0 1 FIX_AXIS_PAR_DIST 0 1 2 /end AXIS_DESCR
/end CHARACTERISTIC
/begin CHARACTERISTIC MAP_152_11AD4_16x12 "вероятная | mapscan | адрес 0x11AD4, данные 0x11AF2" MAP 0x11AD4 RL_3D_A8_DU16 0 CM_IDENTITY 0 65535 /begin AXIS_DESCR STD_AXIS NO_INPUT_QUANTITY CM_IDENTITY 16 0 255 /end AXIS_DESCR /begin AXIS_DESCR STD_AXIS NO_INPUT_QUANTITY CM_IDENTITY 12 0 255 /end AXIS_DESCR /end CHARACTERISTIC
/begin CHARACTERISTIC KFLUAR2 "сомнительная | damos-сомнительно | адрес 0x11CB0, данные 0x11CB0 | map for engine roughness distance reference value" MAP 0x11CB0 RL_GRID_DU8 0 CM_IDENTITY 0 255
 /begin AXIS_DESCR FIX_AXIS NO_INPUT_QUANTITY CM_IDENTITY 8 0 7 FIX_AXIS_PAR_DIST 0 1 8 /end AXIS_DESCR
 /begin AXIS_DESCR FIX_AXIS NO_INPUT_QUANTITY CM_IDENTITY 8 0 7 FIX_AXIS_PAR_DIST 0 1 8 /end AXIS_DESCR
/end CHARACTERISTIC
/begin CHARACTERISTIC KFLUARZ "сомнительная | damos-сомнительно | адрес 0x11CF0, данные 0x11CF0 | map for engine roughness distance reference value at ZAS (cylinder cut-off)" MAP 0x11CF0 RL_GRID_DU8 0 CM_IDENTITY 0 255
 /begin AXIS_DESCR FIX_AXIS NO_INPUT_QUANTITY CM_IDENTITY 8 0 7 FIX_AXIS_PAR_DIST 0 1 8 /end AXIS_DESCR
 /begin AXIS_DESCR FIX_AXIS NO_INPUT_QUANTITY CM_IDENTITY 8 0 7 FIX_AXIS_PAR_DIST 0 1 8 /end AXIS_DESCR
/end CHARACTERISTIC
/begin CHARACTERISTIC DLURMIN "вероятная | damos-вероятно | адрес 0x11D30, данные 0x11D30 | speed dependensy of engine roughness referenz minimum value 1" CURVE 0x11D30 RL_GRID_DS8 0 CM_IDENTITY 0 127
 /begin AXIS_DESCR FIX_AXIS NO_INPUT_QUANTITY CM_IDENTITY 8 0 7 FIX_AXIS_PAR_DIST 0 1 8 /end AXIS_DESCR
/end CHARACTERISTIC
/begin CHARACTERISTIC KFDLUR1 "сомнительная | damos-сомнительно | адрес 0x11DB9, данные 0x11DB9 | map engine roughness difference dluts referenz value" MAP 0x11DB9 RL_GRID_DS8 0 CM_IDENTITY 0 127
 /begin AXIS_DESCR FIX_AXIS NO_INPUT_QUANTITY CM_IDENTITY 8 0 7 FIX_AXIS_PAR_DIST 0 1 8 /end AXIS_DESCR
 /begin AXIS_DESCR FIX_AXIS NO_INPUT_QUANTITY CM_IDENTITY 8 0 7 FIX_AXIS_PAR_DIST 0 1 8 /end AXIS_DESCR
/end CHARACTERISTIC
/begin CHARACTERISTIC KFDLUR2 "сомнительная | damos-сомнительно | адрес 0x11DF9, данные 0x11DF9 | map engine roughness difference dluts referenz value" MAP 0x11DF9 RL_GRID_DS8 0 CM_IDENTITY 0 127
 /begin AXIS_DESCR FIX_AXIS NO_INPUT_QUANTITY CM_IDENTITY 8 0 7 FIX_AXIS_PAR_DIST 0 1 8 /end AXIS_DESCR
 /begin AXIS_DESCR FIX_AXIS NO_INPUT_QUANTITY CM_IDENTITY 8 0 7 FIX_AXIS_PAR_DIST 0 1 8 /end AXIS_DESCR
/end CHARACTERISTIC
/begin CHARACTERISTIC KFDLURZ "подтверждена | damos-точно | адрес 0x11E39, данные 0x11E39 | map engine roughness difference dluts referenz value at ZAS (cylinder cut-off)" MAP 0x11E39 RL_GRID_DS8 0 CM_IDENTITY 0 127
 /begin AXIS_DESCR FIX_AXIS NO_INPUT_QUANTITY CM_IDENTITY 8 0 7 FIX_AXIS_PAR_DIST 0 1 8 /end AXIS_DESCR
 /begin AXIS_DESCR FIX_AXIS NO_INPUT_QUANTITY CM_IDENTITY 8 0 7 FIX_AXIS_PAR_DIST 0 1 8 /end AXIS_DESCR
/end CHARACTERISTIC
/begin CHARACTERISTIC ANALUN "вероятная | damos-вероятно | адрес 0x11E91, данные 0x11E91 | number of combustions for deactivation after detected misfire" CURVE 0x11E91 RL_GRID_DU8 0 CM_IDENTITY 0 255
 /begin AXIS_DESCR FIX_AXIS NO_INPUT_QUANTITY CM_IDENTITY 8 0 7 FIX_AXIS_PAR_DIST 0 1 8 /end AXIS_DESCR
/end CHARACTERISTIC
/begin CHARACTERISTIC MAP_160_11F22_8 "вероятная | mapscan | адрес 0x11F22, данные 0x11F2B" CURVE 0x11F22 RL_2D_A8_DU8 0 CM_IDENTITY 0 255 /begin AXIS_DESCR STD_AXIS NO_INPUT_QUANTITY CM_IDENTITY 8 0 255 /end AXIS_DESCR /end CHARACTERISTIC
/begin CHARACTERISTIC KFLURB1 "сомнительная | damos-сомнительно | адрес 0x11FDE, данные 0x11FDE | map for engine roughness - reference base value" MAP 0x11FDE RL_GRID_DS8 0 CM_IDENTITY 0 127
 /begin AXIS_DESCR FIX_AXIS NO_INPUT_QUANTITY CM_IDENTITY 8 0 7 FIX_AXIS_PAR_DIST 0 1 8 /end AXIS_DESCR
 /begin AXIS_DESCR FIX_AXIS NO_INPUT_QUANTITY CM_IDENTITY 8 0 7 FIX_AXIS_PAR_DIST 0 1 8 /end AXIS_DESCR
/end CHARACTERISTIC
/begin CHARACTERISTIC KFLURB2 "вероятная | damos-вероятно | адрес 0x1201E, данные 0x1201E | map for engine roughness - reference base value" MAP 0x1201E RL_GRID_DS8 0 CM_IDENTITY 0 127
 /begin AXIS_DESCR FIX_AXIS NO_INPUT_QUANTITY CM_IDENTITY 8 0 7 FIX_AXIS_PAR_DIST 0 1 8 /end AXIS_DESCR
 /begin AXIS_DESCR FIX_AXIS NO_INPUT_QUANTITY CM_IDENTITY 8 0 7 FIX_AXIS_PAR_DIST 0 1 8 /end AXIS_DESCR
/end CHARACTERISTIC
/begin CHARACTERISTIC KFLURBZ "сомнительная | damos-сомнительно | адрес 0x1205E, данные 0x1205E | map for engine roughness base value, in case of ZAS" MAP 0x1205E RL_GRID_DS8 0 CM_IDENTITY 0 127
 /begin AXIS_DESCR FIX_AXIS NO_INPUT_QUANTITY CM_IDENTITY 8 0 7 FIX_AXIS_PAR_DIST 0 1 8 /end AXIS_DESCR
 /begin AXIS_DESCR FIX_AXIS NO_INPUT_QUANTITY CM_IDENTITY 8 0 7 FIX_AXIS_PAR_DIST 0 1 8 /end AXIS_DESCR
/end CHARACTERISTIC
/begin CHARACTERISTIC KFLURM1 "подтверждена | damos-точно | адрес 0x1211E, данные 0x1211E | reference base value map for engine roughness for misfire detection" MAP 0x1211E RL_GRID_DS8 0 CM_IDENTITY 0 127
 /begin AXIS_DESCR FIX_AXIS NO_INPUT_QUANTITY CM_IDENTITY 8 0 7 FIX_AXIS_PAR_DIST 0 1 8 /end AXIS_DESCR
 /begin AXIS_DESCR FIX_AXIS NO_INPUT_QUANTITY CM_IDENTITY 8 0 7 FIX_AXIS_PAR_DIST 0 1 8 /end AXIS_DESCR
/end CHARACTERISTIC
/begin CHARACTERISTIC LURKTM "вероятная | damos-вероятно | адрес 0x1215E, данные 0x1215E | Tmot-dependent engine roughness reference correcting value" CURVE 0x1215E RL_GRID_DS8 0 CM_IDENTITY 0 127
 /begin AXIS_DESCR FIX_AXIS NO_INPUT_QUANTITY CM_IDENTITY 8 0 7 FIX_AXIS_PAR_DIST 0 1 8 /end AXIS_DESCR
/end CHARACTERISTIC
/begin CHARACTERISTIC LURMIN1 "вероятная | damos-вероятно | адрес 0x12166, данные 0x12166 | speed dependensy of engine roughness referenz minimum value 1" CURVE 0x12166 RL_GRID_DS8 0 CM_IDENTITY 0 127
 /begin AXIS_DESCR FIX_AXIS NO_INPUT_QUANTITY CM_IDENTITY 8 0 7 FIX_AXIS_PAR_DIST 0 1 8 /end AXIS_DESCR
/end CHARACTERISTIC
/begin CHARACTERISTIC LURMIN2 "вероятная | damos-вероятно | адрес 0x1216E, данные 0x1216E | speed dependensy of engine roughness referenz minimum value 2" CURVE 0x1216E RL_GRID_DS8 0 CM_IDENTITY 0 127
 /begin AXIS_DESCR FIX_AXIS NO_INPUT_QUANTITY CM_IDENTITY 8 0 7 FIX_AXIS_PAR_DIST 0 1 8 /end AXIS_DESCR
/end CHARACTERISTIC
/begin CHARACTERISTIC LURMIN3 "вероятная | damos-вероятно | адрес 0x12176, данные 0x12176 | speed dependensy of engine roughness referenz minimum value 3" CURVE 0x12176 RL_GRID_DS8 0 CM_IDENTITY 0 127
 /begin AXIS_DESCR FIX_AXIS NO_INPUT_QUANTITY CM_IDENTITY 8 0 7 FIX_AXIS_PAR_DIST 0 1 8 /end AXIS_DESCR
/end CHARACTERISTIC
/begin CHARACTERISTIC KFKSWF "вероятная | damos-вероятно | адрес 0x12192, данные 0x12192 | map for catalyst protection, weighting factors" MAP 0x12192 RL_GRID_DU8 0 CM_IDENTITY 0 255
 /begin AXIS_DESCR FIX_AXIS NO_INPUT_QUANTITY CM_IDENTITY 6 0 5 FIX_AXIS_PAR_DIST 0 1 6 /end AXIS_DESCR
 /begin AXIS_DESCR FIX_AXIS NO_INPUT_QUANTITY CM_IDENTITY 6 0 5 FIX_AXIS_PAR_DIST 0 1 6 /end AXIS_DESCR
/end CHARACTERISTIC
/begin CHARACTERISTIC KFFWK_0_A "подтверждена | damos-точно | адрес 0x1223F, данные 0x1223F | масштаб x0.0078125 - | factors - characteristic map for KFWK" MAP 0x1223F RL_GRID_DS8 0 CM_0p0078125_0 0 127
 /begin AXIS_DESCR FIX_AXIS NO_INPUT_QUANTITY CM_IDENTITY 16 0 15 FIX_AXIS_PAR_DIST 0 1 16 /end AXIS_DESCR
 /begin AXIS_DESCR FIX_AXIS NO_INPUT_QUANTITY CM_IDENTITY 24 0 23 FIX_AXIS_PAR_DIST 0 1 24 /end AXIS_DESCR
/end CHARACTERISTIC
/begin CHARACTERISTIC MAP_171_124D4_6 "вероятная | mapscan | адрес 0x124D4, данные 0x124DB" CURVE 0x124D4 RL_2D_A8_DU8 0 CM_IDENTITY 0 255 /begin AXIS_DESCR STD_AXIS NO_INPUT_QUANTITY CM_IDENTITY 6 0 255 /end AXIS_DESCR /end CHARACTERISTIC
/begin CHARACTERISTIC MAP_172_128BD_21 "вероятная | mapscan | адрес 0x128BD, данные 0x128E8" CURVE 0x128BD RL_2D_A16_DU16 0 CM_IDENTITY 0 65535 /begin AXIS_DESCR STD_AXIS NO_INPUT_QUANTITY CM_IDENTITY 21 0 65535 /end AXIS_DESCR /end CHARACTERISTIC
/begin CHARACTERISTIC SAN12ESUW "вероятная | damos-вероятно | адрес 0x148B8, данные 0x148B8 | Distribution for the limited injection counter anztib_w" CURVE 0x148B8 RL_GRID_DU8 0 CM_IDENTITY 0 255
 /begin AXIS_DESCR FIX_AXIS NO_INPUT_QUANTITY CM_IDENTITY 12 0 11 FIX_AXIS_PAR_DIST 0 1 12 /end AXIS_DESCR
/end CHARACTERISTIC
/begin CHARACTERISTIC SNM16OPUW "вероятная | damos-вероятно | адрес 0x148D2, данные 0x148D2 | set point distribution engine speed" CURVE 0x148D2 RL_GRID_DU8 0 CM_IDENTITY 0 255
 /begin AXIS_DESCR FIX_AXIS NO_INPUT_QUANTITY CM_IDENTITY 16 0 15 FIX_AXIS_PAR_DIST 0 1 16 /end AXIS_DESCR
/end CHARACTERISTIC
/begin CHARACTERISTIC MAP_175_14915_6 "вероятная | mapscan | адрес 0x14915, данные 0x14922" CURVE 0x14915 RL_2D_A16_DU16 0 CM_IDENTITY 0 65535 /begin AXIS_DESCR STD_AXIS NO_INPUT_QUANTITY CM_IDENTITY 6 0 65535 /end AXIS_DESCR /end CHARACTERISTIC
/begin CHARACTERISTIC NDFILOG "вероятная | damos-вероятно | адрес 0x14934, данные 0x14934 | масштаб x0.25 U/min | Threshold for filter output ndfil" CURVE 0x14934 RL_GRID_DU8 0 CM_0p25_0_Umin 0 255
 /begin AXIS_DESCR FIX_AXIS NO_INPUT_QUANTITY CM_IDENTITY 6 0 5 FIX_AXIS_PAR_DIST 0 1 6 /end AXIS_DESCR
/end CHARACTERISTIC
/begin CHARACTERISTIC TVKUPHS "вероятная | damos-вероятно | адрес 0x14940, данные 0x14940 | масштаб x0.01 s | delay time for clutch switch during shifting in higher gear" CURVE 0x14940 RL_GRID_DU8 0 CM_0p01_0_s 0 255
 /begin AXIS_DESCR FIX_AXIS NO_INPUT_QUANTITY CM_IDENTITY 6 0 5 FIX_AXIS_PAR_DIST 0 1 6 /end AXIS_DESCR
/end CHARACTERISTIC
/begin CHARACTERISTIC TVKUPRS "вероятная | damos-вероятно | адрес 0x1494C, данные 0x1494C | масштаб x0.01 s | delay time for clutch switch during shifting in lower gear" CURVE 0x1494C RL_GRID_DU8 0 CM_0p01_0_s 0 255
 /begin AXIS_DESCR FIX_AXIS NO_INPUT_QUANTITY CM_IDENTITY 6 0 5 FIX_AXIS_PAR_DIST 0 1 6 /end AXIS_DESCR
/end CHARACTERISTIC
/begin CHARACTERISTIC DETANN "вероятная | damos-вероятно | адрес 0x14959, данные 0x14959 | масштаб x0.00195312 % | negative change limitation of etazwvg for each 10ms" CURVE 0x14959 RL_GRID_DU8 0 CM_0p001953125_0 0 255
 /begin AXIS_DESCR FIX_AXIS NO_INPUT_QUANTITY CM_IDENTITY 10 0 9 FIX_AXIS_PAR_DIST 0 1 10 /end AXIS_DESCR
/end CHARACTERISTIC
/begin CHARACTERISTIC DETAPN "вероятная | damos-вероятно | адрес 0x14979, данные 0x14979 | масштаб x0.00195312 % | Positive change limitation of etazwvg for each 10ms" CURVE 0x14979 RL_GRID_DU8 0 CM_0p001953125_0 0 255
 /begin AXIS_DESCR FIX_AXIS NO_INPUT_QUANTITY CM_IDENTITY 10 0 9 FIX_AXIS_PAR_DIST 0 1 10 /end AXIS_DESCR
/end CHARACTERISTIC
/begin CHARACTERISTIC MAP_181_14998_10 "вероятная | mapscan | адрес 0x14998, данные 0x149A3" CURVE 0x14998 RL_2D_A8_DU16 0 CM_IDENTITY 0 65535 /begin AXIS_DESCR STD_AXIS NO_INPUT_QUANTITY CM_IDENTITY 10 0 255 /end AXIS_DESCR /end CHARACTERISTIC
/begin CHARACTERISTIC MAP_182_149B8_10 "вероятная | mapscan | адрес 0x149B8, данные 0x149C3" CURVE 0x149B8 RL_2D_A8_DU16 0 CM_IDENTITY 0 65535 /begin AXIS_DESCR STD_AXIS NO_INPUT_QUANTITY CM_IDENTITY 10 0 255 /end AXIS_DESCR /end CHARACTERISTIC
/begin CHARACTERISTIC MAP_183_149D8_10 "вероятная | mapscan | адрес 0x149D8, данные 0x149E3" CURVE 0x149D8 RL_2D_A8_DU16 0 CM_IDENTITY 0 65535 /begin AXIS_DESCR STD_AXIS NO_INPUT_QUANTITY CM_IDENTITY 10 0 255 /end AXIS_DESCR /end CHARACTERISTIC
/begin CHARACTERISTIC MAP_184_14A11_10 "вероятная | mapscan | адрес 0x14A11, данные 0x14A26" CURVE 0x14A11 RL_2D_A16_DU16 0 CM_IDENTITY 0 65535 /begin AXIS_DESCR STD_AXIS NO_INPUT_QUANTITY CM_IDENTITY 10 0 65535 /end AXIS_DESCR /end CHARACTERISTIC
/begin CHARACTERISTIC SRL11OPUW "вероятная | damos-вероятно | адрес 0x14B1A, данные 0x14B1A | set point distribution relative charge" CURVE 0x14B1A RL_GRID_DU8 0 CM_IDENTITY 0 255
 /begin AXIS_DESCR FIX_AXIS NO_INPUT_QUANTITY CM_IDENTITY 11 0 10 FIX_AXIS_PAR_DIST 0 1 11 /end AXIS_DESCR
/end CHARACTERISTIC
/begin CHARACTERISTIC DMLWWKMK "вероятная | damos-вероятно | адрес 0x14B33, данные 0x14B33 | масштаб x0.196078 % | Motor torque threshold for antijerking on an openned lockup clutch" CURVE 0x14B33 RL_GRID_DU8 0 CM_0p1960784314_0 0 255
 /begin AXIS_DESCR FIX_AXIS NO_INPUT_QUANTITY CM_IDENTITY 6 0 5 FIX_AXIS_PAR_DIST 0 1 6 /end AXIS_DESCR
/end CHARACTERISTIC
/begin CHARACTERISTIC KLDMLWSDO "вероятная | damos-вероятно | адрес 0x14B41, данные 0x14B41 | масштаб x0.196078 % | Delta torque for enabling impact limitation" CURVE 0x14B41 RL_GRID_DU8 0 CM_0p1960784314_0 0 255
 /begin AXIS_DESCR FIX_AXIS NO_INPUT_QUANTITY CM_IDENTITY 6 0 5 FIX_AXIS_PAR_DIST 0 1 6 /end AXIS_DESCR
/end CHARACTERISTIC
/begin CHARACTERISTIC KLMKLWSD "вероятная | damos-вероятно | адрес 0x14B4E, данные 0x14B4E | масштаб x0.00305176 % | Torgue threshold value for impact damping" CURVE 0x14B4E RL_GRID_DS8 0 CM_0p003051757812_0 0 127
 /begin AXIS_DESCR FIX_AXIS NO_INPUT_QUANTITY CM_IDENTITY 6 0 5 FIX_AXIS_PAR_DIST 0 1 6 /end AXIS_DESCR
/end CHARACTERISTIC
/begin CHARACTERISTIC MAP_189_14BC5_12 "вероятная | mapscan | адрес 0x14BC5, данные 0x14BDE" CURVE 0x14BC5 RL_2D_A16_DU16 0 CM_IDENTITY 0 65535 /begin AXIS_DESCR STD_AXIS NO_INPUT_QUANTITY CM_IDENTITY 12 0 65535 /end AXIS_DESCR /end CHARACTERISTIC
/begin CHARACTERISTIC MAP_190_14BFB_5 "вероятная | mapscan | адрес 0x14BFB, данные 0x14C06" CURVE 0x14BFB RL_2D_A16_DU16 0 CM_IDENTITY 0 65535 /begin AXIS_DESCR STD_AXIS NO_INPUT_QUANTITY CM_IDENTITY 5 0 65535 /end AXIS_DESCR /end CHARACTERISTIC
/begin CHARACTERISTIC MAP_191_14C2D_4 "вероятная | mapscan | адрес 0x14C2D, данные 0x14C36" CURVE 0x14C2D RL_2D_A16_DU16 0 CM_IDENTITY 0 65535 /begin AXIS_DESCR STD_AXIS NO_INPUT_QUANTITY CM_IDENTITY 4 0 65535 /end AXIS_DESCR /end CHARACTERISTIC
/begin CHARACTERISTIC MAP_192_14C45_4 "вероятная | mapscan | адрес 0x14C45, данные 0x14C4E" CURVE 0x14C45 RL_2D_A16_DU16 0 CM_IDENTITY 0 65535 /begin AXIS_DESCR STD_AXIS NO_INPUT_QUANTITY CM_IDENTITY 4 0 65535 /end AXIS_DESCR /end CHARACTERISTIC
/begin CHARACTERISTIC MAP_193_14C5D_4 "вероятная | mapscan | адрес 0x14C5D, данные 0x14C66" CURVE 0x14C5D RL_2D_A16_DU16 0 CM_IDENTITY 0 65535 /begin AXIS_DESCR STD_AXIS NO_INPUT_QUANTITY CM_IDENTITY 4 0 65535 /end AXIS_DESCR /end CHARACTERISTIC
/begin CHARACTERISTIC MAP_194_14C75_4 "вероятная | mapscan | адрес 0x14C75, данные 0x14C7E" CURVE 0x14C75 RL_2D_A16_DU16 0 CM_IDENTITY 0 65535 /begin AXIS_DESCR STD_AXIS NO_INPUT_QUANTITY CM_IDENTITY 4 0 65535 /end AXIS_DESCR /end CHARACTERISTIC
/begin CHARACTERISTIC MAP_195_14C8D_4 "вероятная | mapscan | адрес 0x14C8D, данные 0x14C96" CURVE 0x14C8D RL_2D_A16_DU16 0 CM_IDENTITY 0 65535 /begin AXIS_DESCR STD_AXIS NO_INPUT_QUANTITY CM_IDENTITY 4 0 65535 /end AXIS_DESCR /end CHARACTERISTIC
/begin CHARACTERISTIC MAP_196_14CA5_4 "вероятная | mapscan | адрес 0x14CA5, данные 0x14CAE" CURVE 0x14CA5 RL_2D_A16_DU16 0 CM_IDENTITY 0 65535 /begin AXIS_DESCR STD_AXIS NO_INPUT_QUANTITY CM_IDENTITY 4 0 65535 /end AXIS_DESCR /end CHARACTERISTIC
/begin CHARACTERISTIC MAP_197_14CBD_4 "вероятная | mapscan | адрес 0x14CBD, данные 0x14CC6" CURVE 0x14CBD RL_2D_A16_DU16 0 CM_IDENTITY 0 65535 /begin AXIS_DESCR STD_AXIS NO_INPUT_QUANTITY CM_IDENTITY 4 0 65535 /end AXIS_DESCR /end CHARACTERISTIC
/begin CHARACTERISTIC MAP_198_14CD5_4 "вероятная | mapscan | адрес 0x14CD5, данные 0x14CDE" CURVE 0x14CD5 RL_2D_A16_DU16 0 CM_IDENTITY 0 65535 /begin AXIS_DESCR STD_AXIS NO_INPUT_QUANTITY CM_IDENTITY 4 0 65535 /end AXIS_DESCR /end CHARACTERISTIC
/begin CHARACTERISTIC MAP_199_14CED_4 "вероятная | mapscan | адрес 0x14CED, данные 0x14CF6" CURVE 0x14CED RL_2D_A16_DU16 0 CM_IDENTITY 0 65535 /begin AXIS_DESCR STD_AXIS NO_INPUT_QUANTITY CM_IDENTITY 4 0 65535 /end AXIS_DESCR /end CHARACTERISTIC
/begin CHARACTERISTIC MAP_200_14D05_4 "вероятная | mapscan | адрес 0x14D05, данные 0x14D0E" CURVE 0x14D05 RL_2D_A16_DU16 0 CM_IDENTITY 0 65535 /begin AXIS_DESCR STD_AXIS NO_INPUT_QUANTITY CM_IDENTITY 4 0 65535 /end AXIS_DESCR /end CHARACTERISTIC
/begin CHARACTERISTIC MAP_201_14D1D_4 "вероятная | mapscan | адрес 0x14D1D, данные 0x14D26" CURVE 0x14D1D RL_2D_A16_DU16 0 CM_IDENTITY 0 65535 /begin AXIS_DESCR STD_AXIS NO_INPUT_QUANTITY CM_IDENTITY 4 0 65535 /end AXIS_DESCR /end CHARACTERISTIC
/begin CHARACTERISTIC MAP_202_14D35_4 "вероятная | mapscan | адрес 0x14D35, данные 0x14D3E" CURVE 0x14D35 RL_2D_A16_DU16 0 CM_IDENTITY 0 65535 /begin AXIS_DESCR STD_AXIS NO_INPUT_QUANTITY CM_IDENTITY 4 0 65535 /end AXIS_DESCR /end CHARACTERISTIC
/begin CHARACTERISTIC MAP_203_14D4D_4 "вероятная | mapscan | адрес 0x14D4D, данные 0x14D56" CURVE 0x14D4D RL_2D_A16_DU16 0 CM_IDENTITY 0 65535 /begin AXIS_DESCR STD_AXIS NO_INPUT_QUANTITY CM_IDENTITY 4 0 65535 /end AXIS_DESCR /end CHARACTERISTIC
/begin CHARACTERISTIC MAP_204_14D65_4 "вероятная | mapscan | адрес 0x14D65, данные 0x14D6E" CURVE 0x14D65 RL_2D_A16_DU16 0 CM_IDENTITY 0 65535 /begin AXIS_DESCR STD_AXIS NO_INPUT_QUANTITY CM_IDENTITY 4 0 65535 /end AXIS_DESCR /end CHARACTERISTIC
/begin CHARACTERISTIC SRL03MFUW "вероятная | damos-вероятно | адрес 0x14D78, данные 0x14D78" CURVE 0x14D78 RL_GRID_DU8 0 CM_IDENTITY 0 255
 /begin AXIS_DESCR FIX_AXIS NO_INPUT_QUANTITY CM_IDENTITY 3 0 2 FIX_AXIS_PAR_DIST 0 1 3 /end AXIS_DESCR
/end CHARACTERISTIC
/begin CHARACTERISTIC KFZWMN "подтверждена | профиль | адрес 0x14DA4, данные 0x14DA4 | масштаб x0.75 grad KW | Карта минимального угла зажигания. Изменена калибровщиком." MAP 0x14DA4 RL_GRID_DS8 0 CM_0p75_0_gradKW 0 127
 /begin AXIS_DESCR FIX_AXIS NO_INPUT_QUANTITY CM_IDENTITY 12 0 11 FIX_AXIS_PAR_DIST 0 1 12 /end AXIS_DESCR
 /begin AXIS_DESCR FIX_AXIS NO_INPUT_QUANTITY CM_IDENTITY 16 0 15 FIX_AXIS_PAR_DIST 0 1 16 /end AXIS_DESCR
/end CHARACTERISTIC
/begin CHARACTERISTIC KFZWMNST "подтверждена | damos-точно | адрес 0x14EA0, данные 0x14EA0 | масштаб x0.75 grad KW | minimal ignition spark advance for engine start and after start" MAP 0x14EA0 RL_GRID_DS8 0 CM_0p75_0_gradKW 0 127
 /begin AXIS_DESCR FIX_AXIS NO_INPUT_QUANTITY CM_IDENTITY 12 0 11 FIX_AXIS_PAR_DIST 0 1 12 /end AXIS_DESCR
 /begin AXIS_DESCR FIX_AXIS NO_INPUT_QUANTITY CM_IDENTITY 16 0 15 FIX_AXIS_PAR_DIST 0 1 16 /end AXIS_DESCR
/end CHARACTERISTIC
/begin CHARACTERISTIC MAP_208_14F60_8 "вероятная | mapscan | адрес 0x14F60, данные 0x14F69" CURVE 0x14F60 RL_2D_A8_DU16 0 CM_IDENTITY 0 65535 /begin AXIS_DESCR STD_AXIS NO_INPUT_QUANTITY CM_IDENTITY 8 0 255 /end AXIS_DESCR /end CHARACTERISTIC
/begin CHARACTERISTIC MAP_209_14F7F_6 "вероятная | mapscan | адрес 0x14F7F, данные 0x14F86" CURVE 0x14F7F RL_2D_A8_DU8 0 CM_IDENTITY 0 255 /begin AXIS_DESCR STD_AXIS NO_INPUT_QUANTITY CM_IDENTITY 6 0 255 /end AXIS_DESCR /end CHARACTERISTIC
/begin CHARACTERISTIC KFZWWLNM "подтверждена | damos-точно | адрес 0x14F96, данные 0x14F96 | масштаб x0.75 grad KW | Delta ignition sparc advance during engine warm up phase" MAP 0x14F96 RL_GRID_DS8 0 CM_0p75_0_gradKW 0 127
 /begin AXIS_DESCR FIX_AXIS NO_INPUT_QUANTITY CM_IDENTITY 6 0 5 FIX_AXIS_PAR_DIST 0 1 6 /end AXIS_DESCR
 /begin AXIS_DESCR FIX_AXIS NO_INPUT_QUANTITY CM_IDENTITY 16 0 15 FIX_AXIS_PAR_DIST 0 1 16 /end AXIS_DESCR
/end CHARACTERISTIC
/begin CHARACTERISTIC MAP_211_14FF7_5 "вероятная | mapscan | адрес 0x14FF7, данные 0x14FFD" CURVE 0x14FF7 RL_2D_A8_DU8 0 CM_IDENTITY 0 255 /begin AXIS_DESCR STD_AXIS NO_INPUT_QUANTITY CM_IDENTITY 5 0 255 /end AXIS_DESCR /end CHARACTERISTIC
/begin CHARACTERISTIC MAP_212_15005_6 "вероятная | mapscan | адрес 0x15005, данные 0x1500C" CURVE 0x15005 RL_2D_A8_DU8 0 CM_IDENTITY 0 255 /begin AXIS_DESCR STD_AXIS NO_INPUT_QUANTITY CM_IDENTITY 6 0 255 /end AXIS_DESCR /end CHARACTERISTIC
/begin CHARACTERISTIC KFWK_0_A "подтверждена | damos-точно | адрес 0x1502E, данные 0x1502E | spark-advance-angle characteristic map for knock-protection function" MAP 0x1502E RL_GRID_DS8 0 CM_IDENTITY 0 127
 /begin AXIS_DESCR FIX_AXIS NO_INPUT_QUANTITY CM_IDENTITY 6 0 5 FIX_AXIS_PAR_DIST 0 1 6 /end AXIS_DESCR
 /begin AXIS_DESCR FIX_AXIS NO_INPUT_QUANTITY CM_IDENTITY 6 0 5 FIX_AXIS_PAR_DIST 0 1 6 /end AXIS_DESCR
/end CHARACTERISTIC
/begin CHARACTERISTIC DMLLNGV "вероятная | damos-вероятно | адрес 0x15064, данные 0x15064 | масштаб x0.00305156 %/(U/min) | LLR: D-gain depending of ngasf for air path" CURVE 0x15064 RL_GRID_DS8 0 CM_0p0030515625_0_Umin 0 127
 /begin AXIS_DESCR FIX_AXIS NO_INPUT_QUANTITY CM_IDENTITY 6 0 5 FIX_AXIS_PAR_DIST 0 1 6 /end AXIS_DESCR
/end CHARACTERISTIC
/begin CHARACTERISTIC MDST "подтверждена | damos | адрес 0x1507E, данные 0x1507E | масштаб x0.78 % | Starting torque" CURVE 0x1507E RL_GRID_DS8 0 CM_0p78_0 0 127
 /begin AXIS_DESCR FIX_AXIS NO_INPUT_QUANTITY CM_IDENTITY 8 0 7 FIX_AXIS_PAR_DIST 0 1 8 /end AXIS_DESCR
/end CHARACTERISTIC
/begin CHARACTERISTIC FNSTABNV "подтверждена | damos | адрес 0x1509D, данные 0x1509D | масштаб x0.00012207 - | Factor for engine speed stabilisation by torque" CURVE 0x1509D RL_GRID_DU16 0 CM_0p0001220703125_0 0 65535
 /begin AXIS_DESCR FIX_AXIS NO_INPUT_QUANTITY CM_IDENTITY 6 0 5 FIX_AXIS_PAR_DIST 0 1 6 /end AXIS_DESCR
/end CHARACTERISTIC
/begin CHARACTERISTIC MAP_217_15137_6 "вероятная | mapscan | адрес 0x15137, данные 0x15144" CURVE 0x15137 RL_2D_A16_DU16 0 CM_IDENTITY 0 65535 /begin AXIS_DESCR STD_AXIS NO_INPUT_QUANTITY CM_IDENTITY 6 0 65535 /end AXIS_DESCR /end CHARACTERISTIC
/begin CHARACTERISTIC DMDNSM_0_A "вероятная | damos-вероятно | адрес 0x151DD, данные 0x151DD | масштаб x0.390625 % | Torque offset for after cranking compensation" CURVE 0x151DD RL_GRID_DU8 0 CM_0p390625_0 0 255
 /begin AXIS_DESCR FIX_AXIS NO_INPUT_QUANTITY CM_IDENTITY 8 0 7 FIX_AXIS_PAR_DIST 0 1 8 /end AXIS_DESCR
/end CHARACTERISTIC
/begin CHARACTERISTIC ZMDNSM_0_A "вероятная | damos-вероятно | адрес 0x151E5, данные 0x151E5 | time constant for decay of torque offset after cranking" CURVE 0x151E5 RL_GRID_DU8 0 CM_IDENTITY 0 255
 /begin AXIS_DESCR FIX_AXIS NO_INPUT_QUANTITY CM_IDENTITY 8 0 7 FIX_AXIS_PAR_DIST 0 1 8 /end AXIS_DESCR
/end CHARACTERISTIC
/begin CHARACTERISTIC MDSM_0_A "вероятная | damos-вероятно | адрес 0x151ED, данные 0x151ED | масштаб x0.00152588 % | temperatuer share of enginie friction torque" CURVE 0x151ED RL_GRID_DU16 0 CM_0p001525878906_0 0 65535
 /begin AXIS_DESCR FIX_AXIS NO_INPUT_QUANTITY CM_IDENTITY 10 0 9 FIX_AXIS_PAR_DIST 0 1 10 /end AXIS_DESCR
/end CHARACTERISTIC
/begin CHARACTERISTIC MAP_221_15261_6 "вероятная | mapscan | адрес 0x15261, данные 0x1526E" CURVE 0x15261 RL_2D_A16_DU16 0 CM_IDENTITY 0 65535 /begin AXIS_DESCR STD_AXIS NO_INPUT_QUANTITY CM_IDENTITY 6 0 65535 /end AXIS_DESCR /end CHARACTERISTIC
/begin CHARACTERISTIC MAP_222_15281_6 "вероятная | mapscan | адрес 0x15281, данные 0x1528E" CURVE 0x15281 RL_2D_A16_DU16 0 CM_IDENTITY 0 65535 /begin AXIS_DESCR STD_AXIS NO_INPUT_QUANTITY CM_IDENTITY 6 0 65535 /end AXIS_DESCR /end CHARACTERISTIC
/begin CHARACTERISTIC MAP_223_152A1_6x7 "вероятная | mapscan | адрес 0x152A1, данные 0x152BD" MAP 0x152A1 RL_3D_A16_DU16 0 CM_IDENTITY 0 65535 /begin AXIS_DESCR STD_AXIS NO_INPUT_QUANTITY CM_IDENTITY 6 0 65535 /end AXIS_DESCR /begin AXIS_DESCR STD_AXIS NO_INPUT_QUANTITY CM_IDENTITY 7 0 65535 /end AXIS_DESCR /end CHARACTERISTIC
/begin CHARACTERISTIC MAP_224_15311_7 "вероятная | mapscan | адрес 0x15311, данные 0x15320" CURVE 0x15311 RL_2D_A16_DU16 0 CM_IDENTITY 0 65535 /begin AXIS_DESCR STD_AXIS NO_INPUT_QUANTITY CM_IDENTITY 7 0 65535 /end AXIS_DESCR /end CHARACTERISTIC
/begin CHARACTERISTIC MAP_225_15331_7 "вероятная | mapscan | адрес 0x15331, данные 0x15340" CURVE 0x15331 RL_2D_A16_DU16 0 CM_IDENTITY 0 65535 /begin AXIS_DESCR STD_AXIS NO_INPUT_QUANTITY CM_IDENTITY 7 0 65535 /end AXIS_DESCR /end CHARACTERISTIC
/begin CHARACTERISTIC MAP_226_15362_8x24 "вероятная | mapscan | адрес 0x15362, данные 0x153A4" MAP 0x15362 RL_3D_A16_DU16 0 CM_IDENTITY 0 65535 /begin AXIS_DESCR STD_AXIS NO_INPUT_QUANTITY CM_IDENTITY 8 0 65535 /end AXIS_DESCR /begin AXIS_DESCR STD_AXIS NO_INPUT_QUANTITY CM_IDENTITY 24 0 65535 /end AXIS_DESCR /end CHARACTERISTIC
/begin CHARACTERISTIC MAP_227_15528_12 "вероятная | mapscan | адрес 0x15528, данные 0x15541" CURVE 0x15528 RL_2D_A16_DU16 0 CM_IDENTITY 0 65535 /begin AXIS_DESCR STD_AXIS NO_INPUT_QUANTITY CM_IDENTITY 12 0 65535 /end AXIS_DESCR /end CHARACTERISTIC
/begin CHARACTERISTIC MAP_228_15559_16 "вероятная | mapscan | адрес 0x15559, данные 0x1557A" CURVE 0x15559 RL_2D_A16_DU16 0 CM_IDENTITY 0 65535 /begin AXIS_DESCR STD_AXIS NO_INPUT_QUANTITY CM_IDENTITY 16 0 65535 /end AXIS_DESCR /end CHARACTERISTIC
/begin CHARACTERISTIC WDKUGDN "вероятная | damos-вероятно | адрес 0x15672, данные 0x15672 | масштаб x0.00152588 % | throttle angle necessary for 95 % of the maximum possible air charge" CURVE 0x15672 RL_GRID_DU16 0 CM_0p001525878906_0 0 65535
 /begin AXIS_DESCR FIX_AXIS NO_INPUT_QUANTITY CM_IDENTITY 12 0 11 FIX_AXIS_PAR_DIST 0 1 12 /end AXIS_DESCR
/end CHARACTERISTIC
/begin CHARACTERISTIC ZKMSDK "вероятная | damos-вероятно | адрес 0x1568B, данные 0x1568B | масштаб x0.000244141 - | integrator speed for fast constant mass-flow adaption" CURVE 0x1568B RL_GRID_DU16 0 CM_0p000244140625_0 0 65535
 /begin AXIS_DESCR FIX_AXIS NO_INPUT_QUANTITY CM_IDENTITY 8 0 7 FIX_AXIS_PAR_DIST 0 1 8 /end AXIS_DESCR
/end CHARACTERISTIC
/begin CHARACTERISTIC ZKPVDK "вероятная | damos-вероятно | адрес 0x156AD, данные 0x156AD | масштаб x0.000244141 - | integrator speed for slow constant mass-flow adaption" CURVE 0x156AD RL_GRID_DU16 0 CM_0p000244140625_0 0 65535
 /begin AXIS_DESCR FIX_AXIS NO_INPUT_QUANTITY CM_IDENTITY 8 0 7 FIX_AXIS_PAR_DIST 0 1 8 /end AXIS_DESCR
/end CHARACTERISTIC
/begin CHARACTERISTIC KLSIS "вероятная | damos-вероятно | адрес 0x156D3, данные 0x156D3 | масштаб x0.00152588 % | Charachteristic map of idle throttle on switch on" CURVE 0x156D3 RL_GRID_DU16 0 CM_0p001525878906_0 0 65535
 /begin AXIS_DESCR FIX_AXIS NO_INPUT_QUANTITY CM_IDENTITY 8 0 7 FIX_AXIS_PAR_DIST 0 1 8 /end AXIS_DESCR
/end CHARACTERISTIC
/begin CHARACTERISTIC LLSPMSN "подтверждена | damos | адрес 0x156F9, данные 0x156F9 | масштаб x0.00152588 % | char. line of ISA pos. dependent on standardised air mass flow" CURVE 0x156F9 RL_GRID_DU16 0 CM_0p001525878906_0 0 65535
 /begin AXIS_DESCR FIX_AXIS NO_INPUT_QUANTITY CM_IDENTITY 16 0 15 FIX_AXIS_PAR_DIST 0 1 16 /end AXIS_DESCR
/end CHARACTERISTIC
/begin CHARACTERISTIC MSNLLSP "вероятная | damos-вероятно | адрес 0x1573B, данные 0x1573B | масштаб x0.0015625 kg/h | chara. line standardised air mass flow dependent on ISA position" CURVE 0x1573B RL_GRID_DU16 0 CM_0p0015625_0_kgh 0 65535
 /begin AXIS_DESCR FIX_AXIS NO_INPUT_QUANTITY CM_IDENTITY 16 0 15 FIX_AXIS_PAR_DIST 0 1 16 /end AXIS_DESCR
/end CHARACTERISTIC
/begin CHARACTERISTIC KFMSNTAG "подтверждена | damos-точно | адрес 0x1579A, данные 0x1579A | масштаб x0.1 kg/h | EGR mass flow standardised" MAP 0x1579A RL_GRID_DU8 0 CM_0p1_0_kgh 0 255
 /begin AXIS_DESCR FIX_AXIS NO_INPUT_QUANTITY CM_IDENTITY 12 0 11 FIX_AXIS_PAR_DIST 0 1 12 /end AXIS_DESCR
 /begin AXIS_DESCR FIX_AXIS NO_INPUT_QUANTITY CM_IDENTITY 10 0 9 FIX_AXIS_PAR_DIST 0 1 10 /end AXIS_DESCR
/end CHARACTERISTIC
/begin CHARACTERISTIC TLRVAMW "вероятная | damos-вероятно | адрес 0x15A78, данные 0x15A78 | масштаб x0.02 s | blocking time for activation LC after VA (word)" CURVE 0x15A78 RL_GRID_DU8 0 CM_0p02_0_s 0 255
 /begin AXIS_DESCR FIX_AXIS NO_INPUT_QUANTITY CM_IDENTITY 8 0 7 FIX_AXIS_PAR_DIST 0 1 8 /end AXIS_DESCR
/end CHARACTERISTIC
/begin CHARACTERISTIC TLRZWTMS "неоднозначная | damos-сомнительно | адрес 0x15A89, данные 0x15A89 | масштаб x0.1 s | Time until hard LC switch on after start (CARB)" CURVE 0x15A89 RL_GRID_DU8 0 CM_0p1_0_s 0 255
 /begin AXIS_DESCR FIX_AXIS NO_INPUT_QUANTITY CM_IDENTITY 4 0 3 FIX_AXIS_PAR_DIST 0 1 4 /end AXIS_DESCR
/end CHARACTERISTIC
/begin CHARACTERISTIC LALIUSH "неоднозначная | damos-сомнительно | адрес 0x15A97, данные 0x15A97 | масштаб x0.000244141 - | lambda linearization, sensor behind catalyst" CURVE 0x15A97 RL_GRID_DU16 0 CM_0p000244140625_0 0 65535
 /begin AXIS_DESCR FIX_AXIS NO_INPUT_QUANTITY CM_IDENTITY 10 0 9 FIX_AXIS_PAR_DIST 0 1 10 /end AXIS_DESCR
/end CHARACTERISTIC
/begin CHARACTERISTIC LALIUSRH "вероятная | damos-вероятно | адрес 0x15AC1, данные 0x15AC1 | масштаб x0.000244141 - | lambda linearization, sensor behind catalyst" CURVE 0x15AC1 RL_GRID_DU16 0 CM_0p000244140625_0 0 65535
 /begin AXIS_DESCR FIX_AXIS NO_INPUT_QUANTITY CM_IDENTITY 10 0 9 FIX_AXIS_PAR_DIST 0 1 10 /end AXIS_DESCR
/end CHARACTERISTIC
/begin CHARACTERISTIC FLRFKATE "неоднозначная | damos-сомнительно | адрес 0x15AD7, данные 0x15AD7 | масштаб x0.0078125 - | Rating of factor fkatei from %TEB to optimize the regulation parameter" CURVE 0x15AD7 RL_GRID_DU8 0 CM_0p0078125_0 0 255
 /begin AXIS_DESCR FIX_AXIS NO_INPUT_QUANTITY CM_IDENTITY 5 0 4 FIX_AXIS_PAR_DIST 0 1 5 /end AXIS_DESCR
/end CHARACTERISTIC
/begin CHARACTERISTIC ZLASOHML "неоднозначная | damos-сомнительно | адрес 0x15AE7, данные 0x15AE7 | time constant for PT1-filter of the pseude lambda behind catalyst" CURVE 0x15AE7 RL_GRID_DU8 0 CM_IDENTITY 0 255
 /begin AXIS_DESCR FIX_AXIS NO_INPUT_QUANTITY CM_IDENTITY 8 0 7 FIX_AXIS_PAR_DIST 0 1 8 /end AXIS_DESCR
/end CHARACTERISTIC
/begin CHARACTERISTIC RLSALUN_0_A "вероятная | damos-вероятно | адрес 0x15B20, данные 0x15B20 | масштаб x0.75 % | threshold load fuel cut-off detection for deactivating misfire detection" CURVE 0x15B20 RL_GRID_DU8 0 CM_0p75_0 0 255
 /begin AXIS_DESCR FIX_AXIS NO_INPUT_QUANTITY CM_IDENTITY 8 0 7 FIX_AXIS_PAR_DIST 0 1 8 /end AXIS_DESCR
/end CHARACTERISTIC
/begin CHARACTERISTIC NGALU_0_A "вероятная | damos-вероятно | адрес 0x15B28, данные 0x15B28 | масштаб x0.39063 U/min/s | Misfire Detection : treshold for gradient of engine speed" CURVE 0x15B28 RL_GRID_DU8 0 CM_0p39063_0_Umins 0 255
 /begin AXIS_DESCR FIX_AXIS NO_INPUT_QUANTITY CM_IDENTITY 8 0 7 FIX_AXIS_PAR_DIST 0 1 8 /end AXIS_DESCR
/end CHARACTERISTIC
/begin CHARACTERISTIC NGKRWN "вероятная | damos-вероятно | адрес 0x15B4A, данные 0x15B4A | масштаб x0.39063 U/min/s | threshold revolution gradient for dynamics detection" CURVE 0x15B4A RL_GRID_DS8 0 CM_0p39063_0_Umins 0 127
 /begin AXIS_DESCR FIX_AXIS NO_INPUT_QUANTITY CM_IDENTITY 16 0 15 FIX_AXIS_PAR_DIST 0 1 16 /end AXIS_DESCR
/end CHARACTERISTIC
/begin CHARACTERISTIC AZKELDYN_0_A "вероятная | damos-вероятно | адрес 0x15B6A, данные 0x15B6A | ignition per cylinder for load dynamics => knock detection" CURVE 0x15B6A RL_GRID_DU8 0 CM_IDENTITY 0 255
 /begin AXIS_DESCR FIX_AXIS NO_INPUT_QUANTITY CM_IDENTITY 16 0 15 FIX_AXIS_PAR_DIST 0 1 16 /end AXIS_DESCR
/end CHARACTERISTIC
/begin CHARACTERISTIC KFDYES_0_A "подтверждена | damos-точно | адрес 0x15B82, данные 0x15B82 | масштаб x0.0234375 % | Threshold for dynamic presetting values" MAP 0x15B82 RL_GRID_DU8 0 CM_0p0234375_0 0 255
 /begin AXIS_DESCR FIX_AXIS NO_INPUT_QUANTITY CM_IDENTITY 4 0 3 FIX_AXIS_PAR_DIST 0 1 4 /end AXIS_DESCR
 /begin AXIS_DESCR FIX_AXIS NO_INPUT_QUANTITY CM_IDENTITY 16 0 15 FIX_AXIS_PAR_DIST 0 1 16 /end AXIS_DESCR
/end CHARACTERISTIC
/begin CHARACTERISTIC MAP_247_15BCB_7 "вероятная | mapscan | адрес 0x15BCB, данные 0x15BDA" CURVE 0x15BCB RL_2D_A16_DU16 0 CM_IDENTITY 0 65535 /begin AXIS_DESCR STD_AXIS NO_INPUT_QUANTITY CM_IDENTITY 7 0 65535 /end AXIS_DESCR /end CHARACTERISTIC
/begin CHARACTERISTIC MAP_248_15C2D_7 "вероятная | mapscan | адрес 0x15C2D, данные 0x15C3C" CURVE 0x15C2D RL_2D_A16_DU16 0 CM_IDENTITY 0 65535 /begin AXIS_DESCR STD_AXIS NO_INPUT_QUANTITY CM_IDENTITY 7 0 65535 /end AXIS_DESCR /end CHARACTERISTIC
/begin CHARACTERISTIC FNSSM_0_A "вероятная | damos-вероятно | адрес 0x15DC2, данные 0x15DC2 | масштаб x0.015625 - | after start increase" CURVE 0x15DC2 RL_GRID_DU8 0 CM_0p015625_0 0 255
 /begin AXIS_DESCR FIX_AXIS NO_INPUT_QUANTITY CM_IDENTITY 12 0 11 FIX_AXIS_PAR_DIST 0 1 12 /end AXIS_DESCR
/end CHARACTERISTIC
/begin CHARACTERISTIC WFRL "вероятная | damos-вероятно | адрес 0x15DEA, данные 0x15DEA | масштаб x0.09375 % | fuel wall hang.up" CURVE 0x15DEA RL_GRID_DU16 0 CM_0p09375_0 0 65535
 /begin AXIS_DESCR FIX_AXIS NO_INPUT_QUANTITY CM_IDENTITY 26 0 25 FIX_AXIS_PAR_DIST 0 1 26 /end AXIS_DESCR
/end CHARACTERISTIC
/begin CHARACTERISTIC TVUB "подтверждена | damos | адрес 0x15E35, данные 0x15E35 | масштаб x0.00266667 ms | voltage correction" CURVE 0x15E35 RL_GRID_DU8 0 CM_0p002666666667_0_ms 0 255
 /begin AXIS_DESCR FIX_AXIS NO_INPUT_QUANTITY CM_IDENTITY 5 0 4 FIX_AXIS_PAR_DIST 0 1 5 /end AXIS_DESCR
/end CHARACTERISTIC
/begin CHARACTERISTIC KLLAMFA_0_A "вероятная | damos-вероятно | адрес 0x15E73, данные 0x15E73 | масштаб x0.0078125 - | full load enrichment" CURVE 0x15E73 RL_GRID_DU8 0 CM_0p0078125_0 0 255
 /begin AXIS_DESCR FIX_AXIS NO_INPUT_QUANTITY CM_IDENTITY 6 0 5 FIX_AXIS_PAR_DIST 0 1 6 /end AXIS_DESCR
/end CHARACTERISTIC
/begin CHARACTERISTIC TVCO "подтверждена | damos | адрес 0x15E87, данные 0x15E87 | масштаб x0.046875 % | idle-speed potentiometer correction" CURVE 0x15E87 RL_GRID_DS16 0 CM_0p046875_0 0 32767
 /begin AXIS_DESCR FIX_AXIS NO_INPUT_QUANTITY CM_IDENTITY 8 0 7 FIX_AXIS_PAR_DIST 0 1 8 /end AXIS_DESCR
/end CHARACTERISTIC
/begin CHARACTERISTIC DMSTES "подтверждена | damos | адрес 0x15EAB, данные 0x15EAB | масштаб x3.2 kg/h | characteristic line maximum increase of purge mass flow" CURVE 0x15EAB RL_GRID_DU8 0 CM_3p2_0_kgh 0 255
 /begin AXIS_DESCR FIX_AXIS NO_INPUT_QUANTITY CM_IDENTITY 6 0 5 FIX_AXIS_PAR_DIST 0 1 6 /end AXIS_DESCR
/end CHARACTERISTIC
/begin CHARACTERISTIC FVERZDYN "вероятная | damos-вероятно | адрес 0x15EC6, данные 0x15EC6 | масштаб x5.96e-08 Min | dynamic factor delay of purge flow in the manifold" CURVE 0x15EC6 RL_GRID_DU8 0 CM_5p96En08_0_Min 0 255
 /begin AXIS_DESCR FIX_AXIS NO_INPUT_QUANTITY CM_IDENTITY 5 0 4 FIX_AXIS_PAR_DIST 0 1 5 /end AXIS_DESCR
/end CHARACTERISTIC
/begin CHARACTERISTIC KFTADMS "сомнительная | damos-сомнительно | адрес 0x15EDB, данные 0x15EDB | масштаб x0.0078125 - | dynamic evaluation factor for close off of PCV" MAP 0x15EDB RL_GRID_DU8 0 CM_0p0078125_0 0 255
 /begin AXIS_DESCR FIX_AXIS NO_INPUT_QUANTITY CM_IDENTITY 4 0 3 FIX_AXIS_PAR_DIST 0 1 4 /end AXIS_DESCR
 /begin AXIS_DESCR FIX_AXIS NO_INPUT_QUANTITY CM_IDENTITY 5 0 4 FIX_AXIS_PAR_DIST 0 1 5 /end AXIS_DESCR
/end CHARACTERISTIC
/begin CHARACTERISTIC TATEMSN "вероятная | damos-вероятно | адрес 0x15F14, данные 0x15F14 | масштаб x0.00152588 % | characteristic line of the PCV duty-cycle depending on the desired mass-flow" CURVE 0x15F14 RL_GRID_DU16 0 CM_0p001525878906_0 0 65535
 /begin AXIS_DESCR FIX_AXIS NO_INPUT_QUANTITY CM_IDENTITY 10 0 9 FIX_AXIS_PAR_DIST 0 1 10 /end AXIS_DESCR
/end CHARACTERISTIC
/begin CHARACTERISTIC AGREDRLS "подтверждена | damos | адрес 0x15F40, данные 0x15F40 | масштаб x1.52588e-05 - | EGR-reduction depending on drlsol" CURVE 0x15F40 RL_GRID_DU16 0 CM_1p525878906En05_0 0 65535
 /begin AXIS_DESCR FIX_AXIS NO_INPUT_QUANTITY CM_IDENTITY 5 0 4 FIX_AXIS_PAR_DIST 0 1 5 /end AXIS_DESCR
/end CHARACTERISTIC
/begin CHARACTERISTIC KLAFTE "вероятная | damos-вероятно | адрес 0x15F4C, данные 0x15F4C | масштаб x3.05176e-05 - | characteristic of Saint-Venant of purge control valve an line AKF-TEV" CURVE 0x15F4C RL_GRID_DU16 0 CM_3p051757812En05_0 0 65535
 /begin AXIS_DESCR FIX_AXIS NO_INPUT_QUANTITY CM_IDENTITY 14 0 13 FIX_AXIS_PAR_DIST 0 1 14 /end AXIS_DESCR
/end CHARACTERISTIC
/begin CHARACTERISTIC MSNTATE "подтверждена | damos | адрес 0x15F6D, данные 0x15F6D | масштаб x0.000390625 kg/h | Characteristic standardized mass flow through TEV" CURVE 0x15F6D RL_GRID_DU16 0 CM_0p000390625_0_kgh 0 65535
 /begin AXIS_DESCR FIX_AXIS NO_INPUT_QUANTITY CM_IDENTITY 10 0 9 FIX_AXIS_PAR_DIST 0 1 10 /end AXIS_DESCR
/end CHARACTERISTIC
/begin CHARACTERISTIC MAP_261_15F88_12 "вероятная | mapscan | адрес 0x15F88, данные 0x15FA1" CURVE 0x15F88 RL_2D_A16_DU16 0 CM_IDENTITY 0 65535 /begin AXIS_DESCR STD_AXIS NO_INPUT_QUANTITY CM_IDENTITY 12 0 65535 /end AXIS_DESCR /end CHARACTERISTIC
/begin CHARACTERISTIC CDCAAA "вероятная | damos-вероятно | адрес 0x15FD1, данные 0x15FD1 | Dummy: top of table" CURVE 0x15FD1 RL_GRID_DU8 0 CM_IDENTITY 0 255
 /begin AXIS_DESCR FIX_AXIS NO_INPUT_QUANTITY CM_IDENTITY 4 0 3 FIX_AXIS_PAR_DIST 0 1 4 /end AXIS_DESCR
/end CHARACTERISTIC
/begin CHARACTERISTIC CDCAGRF "вероятная | damos-вероятно | адрес 0x15FD9, данные 0x15FD9 | code word CARB: EGR flow monitoring" CURVE 0x15FD9 RL_GRID_DU8 0 CM_IDENTITY 0 255
 /begin AXIS_DESCR FIX_AXIS NO_INPUT_QUANTITY CM_IDENTITY 4 0 3 FIX_AXIS_PAR_DIST 0 1 4 /end AXIS_DESCR
/end CHARACTERISTIC
/begin CHARACTERISTIC CDCAGRL "вероятная | damos-вероятно | адрес 0x15FE1, данные 0x15FE1 | code word CARB: EGR valve position sensor" CURVE 0x15FE1 RL_GRID_DU8 0 CM_IDENTITY 0 255
 /begin AXIS_DESCR FIX_AXIS NO_INPUT_QUANTITY CM_IDENTITY 4 0 3 FIX_AXIS_PAR_DIST 0 1 4 /end AXIS_DESCR
/end CHARACTERISTIC
/begin CHARACTERISTIC CDCAGRV "вероятная | damos-вероятно | адрес 0x15FE9, данные 0x15FE9 | code word CARB: diagnosis EGR valve" CURVE 0x15FE9 RL_GRID_DU8 0 CM_IDENTITY 0 255
 /begin AXIS_DESCR FIX_AXIS NO_INPUT_QUANTITY CM_IDENTITY 4 0 3 FIX_AXIS_PAR_DIST 0 1 4 /end AXIS_DESCR
/end CHARACTERISTIC
/begin CHARACTERISTIC CDCAHC "вероятная | damos-вероятно | адрес 0x15FF1, данные 0x15FF1 | code word CARB: MT/AT encoding" CURVE 0x15FF1 RL_GRID_DU8 0 CM_IDENTITY 0 255
 /begin AXIS_DESCR FIX_AXIS NO_INPUT_QUANTITY CM_IDENTITY 4 0 3 FIX_AXIS_PAR_DIST 0 1 4 /end AXIS_DESCR
/end CHARACTERISTIC
/begin CHARACTERISTIC CDCBM "вероятная | damos-вероятно | адрес 0x15FF9, данные 0x15FF9 | code word CARB: reference mark sensor" CURVE 0x15FF9 RL_GRID_DU8 0 CM_IDENTITY 0 255
 /begin AXIS_DESCR FIX_AXIS NO_INPUT_QUANTITY CM_IDENTITY 4 0 3 FIX_AXIS_PAR_DIST 0 1 4 /end AXIS_DESCR
/end CHARACTERISTIC
/begin CHARACTERISTIC CDCDK "вероятная | damos-вероятно | адрес 0x16001, данные 0x16001 | code word CARB: throttle position sensor" CURVE 0x16001 RL_GRID_DU8 0 CM_IDENTITY 0 255
 /begin AXIS_DESCR FIX_AXIS NO_INPUT_QUANTITY CM_IDENTITY 4 0 3 FIX_AXIS_PAR_DIST 0 1 4 /end AXIS_DESCR
/end CHARACTERISTIC
/begin CHARACTERISTIC CDCDUMMY "вероятная | damos-вероятно | адрес 0x16009, данные 0x16009" CURVE 0x16009 RL_GRID_DU8 0 CM_IDENTITY 0 255
 /begin AXIS_DESCR FIX_AXIS NO_INPUT_QUANTITY CM_IDENTITY 4 0 3 FIX_AXIS_PAR_DIST 0 1 4 /end AXIS_DESCR
/end CHARACTERISTIC
/begin CHARACTERISTIC CDCEGFE "вероятная | damos-вероятно | адрес 0x16011, данные 0x16011 | code word CARB: charge detection" CURVE 0x16011 RL_GRID_DU8 0 CM_IDENTITY 0 255
 /begin AXIS_DESCR FIX_AXIS NO_INPUT_QUANTITY CM_IDENTITY 4 0 3 FIX_AXIS_PAR_DIST 0 1 4 /end AXIS_DESCR
/end CHARACTERISTIC
/begin CHARACTERISTIC CDCEV1 "вероятная | damos-вероятно | адрес 0x16019, данные 0x16019 | code word CARB: injector 1" CURVE 0x16019 RL_GRID_DU8 0 CM_IDENTITY 0 255
 /begin AXIS_DESCR FIX_AXIS NO_INPUT_QUANTITY CM_IDENTITY 4 0 3 FIX_AXIS_PAR_DIST 0 1 4 /end AXIS_DESCR
/end CHARACTERISTIC
/begin CHARACTERISTIC CDCEV2 "вероятная | damos-вероятно | адрес 0x16021, данные 0x16021 | code word CARB: injector 2" CURVE 0x16021 RL_GRID_DU8 0 CM_IDENTITY 0 255
 /begin AXIS_DESCR FIX_AXIS NO_INPUT_QUANTITY CM_IDENTITY 4 0 3 FIX_AXIS_PAR_DIST 0 1 4 /end AXIS_DESCR
/end CHARACTERISTIC
/begin CHARACTERISTIC CDCEV3 "вероятная | damos-вероятно | адрес 0x16029, данные 0x16029 | code word CARB: injector 3" CURVE 0x16029 RL_GRID_DU8 0 CM_IDENTITY 0 255
 /begin AXIS_DESCR FIX_AXIS NO_INPUT_QUANTITY CM_IDENTITY 4 0 3 FIX_AXIS_PAR_DIST 0 1 4 /end AXIS_DESCR
/end CHARACTERISTIC
/begin CHARACTERISTIC CDCEV4 "вероятная | damos-вероятно | адрес 0x16031, данные 0x16031 | code word CARB: injector 4" CURVE 0x16031 RL_GRID_DU8 0 CM_IDENTITY 0 255
 /begin AXIS_DESCR FIX_AXIS NO_INPUT_QUANTITY CM_IDENTITY 4 0 3 FIX_AXIS_PAR_DIST 0 1 4 /end AXIS_DESCR
/end CHARACTERISTIC
/begin CHARACTERISTIC CDCEV5 "вероятная | damos-вероятно | адрес 0x16039, данные 0x16039 | code word CARB: injector 5" CURVE 0x16039 RL_GRID_DU8 0 CM_IDENTITY 0 255
 /begin AXIS_DESCR FIX_AXIS NO_INPUT_QUANTITY CM_IDENTITY 4 0 3 FIX_AXIS_PAR_DIST 0 1 4 /end AXIS_DESCR
/end CHARACTERISTIC
/begin CHARACTERISTIC CDCEV6 "вероятная | damos-вероятно | адрес 0x16041, данные 0x16041 | code word CARB: injector 6" CURVE 0x16041 RL_GRID_DU8 0 CM_IDENTITY 0 255
 /begin AXIS_DESCR FIX_AXIS NO_INPUT_QUANTITY CM_IDENTITY 4 0 3 FIX_AXIS_PAR_DIST 0 1 4 /end AXIS_DESCR
/end CHARACTERISTIC
/begin CHARACTERISTIC CDCFRAO "вероятная | damos-вероятно | адрес 0x16049, данные 0x16049 | code word CARB: mixture adaptation factor frao" CURVE 0x16049 RL_GRID_DU8 0 CM_IDENTITY 0 255
 /begin AXIS_DESCR FIX_AXIS NO_INPUT_QUANTITY CM_IDENTITY 4 0 3 FIX_AXIS_PAR_DIST 0 1 4 /end AXIS_DESCR
/end CHARACTERISTIC
/begin CHARACTERISTIC CDCFRAU "вероятная | damos-вероятно | адрес 0x16051, данные 0x16051 | code word CARB: mixture adaptation factor frau" CURVE 0x16051 RL_GRID_DU8 0 CM_IDENTITY 0 255
 /begin AXIS_DESCR FIX_AXIS NO_INPUT_QUANTITY CM_IDENTITY 4 0 3 FIX_AXIS_PAR_DIST 0 1 4 /end AXIS_DESCR
/end CHARACTERISTIC
/begin CHARACTERISTIC CDCFRST "вероятная | damos-вероятно | адрес 0x16059, данные 0x16059 | code word CARB: deiation of lambda loop control" CURVE 0x16059 RL_GRID_DU8 0 CM_IDENTITY 0 255
 /begin AXIS_DESCR FIX_AXIS NO_INPUT_QUANTITY CM_IDENTITY 4 0 3 FIX_AXIS_PAR_DIST 0 1 4 /end AXIS_DESCR
/end CHARACTERISTIC
/begin CHARACTERISTIC CDCGE "вероятная | damos-вероятно | адрес 0x16061, данные 0x16061 | code word CARB: transmission controlled spark advance GE" CURVE 0x16061 RL_GRID_DU8 0 CM_IDENTITY 0 255
 /begin AXIS_DESCR FIX_AXIS NO_INPUT_QUANTITY CM_IDENTITY 4 0 3 FIX_AXIS_PAR_DIST 0 1 4 /end AXIS_DESCR
/end CHARACTERISTIC
/begin CHARACTERISTIC CDCHSH "вероятная | damos-вероятно | адрес 0x16069, данные 0x16069 | code word CARB: lambda sensor heating downstream cat" CURVE 0x16069 RL_GRID_DU8 0 CM_IDENTITY 0 255
 /begin AXIS_DESCR FIX_AXIS NO_INPUT_QUANTITY CM_IDENTITY 4 0 3 FIX_AXIS_PAR_DIST 0 1 4 /end AXIS_DESCR
/end CHARACTERISTIC
/begin CHARACTERISTIC CDCHSHE "вероятная | damos-вероятно | адрес 0x16071, данные 0x16071 | Code word CARB: O2 Sensor Heater power stage" CURVE 0x16071 RL_GRID_DU8 0 CM_IDENTITY 0 255
 /begin AXIS_DESCR FIX_AXIS NO_INPUT_QUANTITY CM_IDENTITY 4 0 3 FIX_AXIS_PAR_DIST 0 1 4 /end AXIS_DESCR
/end CHARACTERISTIC
/begin CHARACTERISTIC CDCHSV "вероятная | damos-вероятно | адрес 0x16079, данные 0x16079 | code word CARB: lambda sensor heating upstream cat" CURVE 0x16079 RL_GRID_DU8 0 CM_IDENTITY 0 255
 /begin AXIS_DESCR FIX_AXIS NO_INPUT_QUANTITY CM_IDENTITY 4 0 3 FIX_AXIS_PAR_DIST 0 1 4 /end AXIS_DESCR
/end CHARACTERISTIC
/begin CHARACTERISTIC CDCHSVE "вероятная | damos-вероятно | адрес 0x16081, данные 0x16081 | code word CARB: lambda sensor heating power stage upstream cat" CURVE 0x16081 RL_GRID_DU8 0 CM_IDENTITY 0 255
 /begin AXIS_DESCR FIX_AXIS NO_INPUT_QUANTITY CM_IDENTITY 4 0 3 FIX_AXIS_PAR_DIST 0 1 4 /end AXIS_DESCR
/end CHARACTERISTIC
/begin CHARACTERISTIC CDCKAT "вероятная | damos-вероятно | адрес 0x16089, данные 0x16089 | code word CARB: catalyst conversion" CURVE 0x16089 RL_GRID_DU8 0 CM_IDENTITY 0 255
 /begin AXIS_DESCR FIX_AXIS NO_INPUT_QUANTITY CM_IDENTITY 4 0 3 FIX_AXIS_PAR_DIST 0 1 4 /end AXIS_DESCR
/end CHARACTERISTIC
/begin CHARACTERISTIC CDCKOSE "вероятная | damos-вероятно | адрес 0x16091, данные 0x16091 | Code word CARB: A/C control power stage" CURVE 0x16091 RL_GRID_DU8 0 CM_IDENTITY 0 255
 /begin AXIS_DESCR FIX_AXIS NO_INPUT_QUANTITY CM_IDENTITY 4 0 3 FIX_AXIS_PAR_DIST 0 1 4 /end AXIS_DESCR
/end CHARACTERISTIC
/begin CHARACTERISTIC CDCKPE "вероятная | damos-вероятно | адрес 0x16099, данные 0x16099 | Code word CARB: fuel pump relay power stage" CURVE 0x16099 RL_GRID_DU8 0 CM_IDENTITY 0 255
 /begin AXIS_DESCR FIX_AXIS NO_INPUT_QUANTITY CM_IDENTITY 4 0 3 FIX_AXIS_PAR_DIST 0 1 4 /end AXIS_DESCR
/end CHARACTERISTIC
/begin CHARACTERISTIC CDCKRNT "вероятная | damos-вероятно | адрес 0x160A1, данные 0x160A1 | code word CARB: knock control zero test pulse" CURVE 0x160A1 RL_GRID_DU8 0 CM_IDENTITY 0 255
 /begin AXIS_DESCR FIX_AXIS NO_INPUT_QUANTITY CM_IDENTITY 4 0 3 FIX_AXIS_PAR_DIST 0 1 4 /end AXIS_DESCR
/end CHARACTERISTIC
/begin CHARACTERISTIC CDCKROF "вероятная | damos-вероятно | адрес 0x160A9, данные 0x160A9 | codeword CARB: knock control offset" CURVE 0x160A9 RL_GRID_DU8 0 CM_IDENTITY 0 255
 /begin AXIS_DESCR FIX_AXIS NO_INPUT_QUANTITY CM_IDENTITY 4 0 3 FIX_AXIS_PAR_DIST 0 1 4 /end AXIS_DESCR
/end CHARACTERISTIC
/begin CHARACTERISTIC CDCKRTP "вероятная | damos-вероятно | адрес 0x160B1, данные 0x160B1 | code word CARB: knock control test pulse" CURVE 0x160B1 RL_GRID_DU8 0 CM_IDENTITY 0 255
 /begin AXIS_DESCR FIX_AXIS NO_INPUT_QUANTITY CM_IDENTITY 4 0 3 FIX_AXIS_PAR_DIST 0 1 4 /end AXIS_DESCR
/end CHARACTERISTIC
/begin CHARACTERISTIC CDCKS1 "вероятная | damos-вероятно | адрес 0x160B9, данные 0x160B9 | code word CARB: knock sensor 1" CURVE 0x160B9 RL_GRID_DU8 0 CM_IDENTITY 0 255
 /begin AXIS_DESCR FIX_AXIS NO_INPUT_QUANTITY CM_IDENTITY 4 0 3 FIX_AXIS_PAR_DIST 0 1 4 /end AXIS_DESCR
/end CHARACTERISTIC
/begin CHARACTERISTIC CDCKS2 "вероятная | damos-вероятно | адрес 0x160C1, данные 0x160C1 | code word CARB: knock sensor 2" CURVE 0x160C1 RL_GRID_DU8 0 CM_IDENTITY 0 255
 /begin AXIS_DESCR FIX_AXIS NO_INPUT_QUANTITY CM_IDENTITY 4 0 3 FIX_AXIS_PAR_DIST 0 1 4 /end AXIS_DESCR
/end CHARACTERISTIC
/begin CHARACTERISTIC CDCKS3 "вероятная | damos-вероятно | адрес 0x160C9, данные 0x160C9 | code word CARB: knock sensor 3" CURVE 0x160C9 RL_GRID_DU8 0 CM_IDENTITY 0 255
 /begin AXIS_DESCR FIX_AXIS NO_INPUT_QUANTITY CM_IDENTITY 4 0 3 FIX_AXIS_PAR_DIST 0 1 4 /end AXIS_DESCR
/end CHARACTERISTIC
/begin CHARACTERISTIC CDCKS4 "вероятная | damos-вероятно | адрес 0x160D1, данные 0x160D1 | code word CARB: knock sensor 4" CURVE 0x160D1 RL_GRID_DU8 0 CM_IDENTITY 0 255
 /begin AXIS_DESCR FIX_AXIS NO_INPUT_QUANTITY CM_IDENTITY 4 0 3 FIX_AXIS_PAR_DIST 0 1 4 /end AXIS_DESCR
/end CHARACTERISTIC
/begin CHARACTERISTIC CDCLASH "вероятная | damos-вероятно | адрес 0x160D9, данные 0x160D9 | code word CARB: lambda sensor aging downstream cat" CURVE 0x160D9 RL_GRID_DU8 0 CM_IDENTITY 0 255
 /begin AXIS_DESCR FIX_AXIS NO_INPUT_QUANTITY CM_IDENTITY 4 0 3 FIX_AXIS_PAR_DIST 0 1 4 /end AXIS_DESCR
/end CHARACTERISTIC
/begin CHARACTERISTIC CDCLATP "вероятная | damos-вероятно | адрес 0x160E1, данные 0x160E1 | code word CARB: lambda sensor aging tp" CURVE 0x160E1 RL_GRID_DU8 0 CM_IDENTITY 0 255
 /begin AXIS_DESCR FIX_AXIS NO_INPUT_QUANTITY CM_IDENTITY 4 0 3 FIX_AXIS_PAR_DIST 0 1 4 /end AXIS_DESCR
/end CHARACTERISTIC
/begin CHARACTERISTIC CDCLATV "вероятная | damos-вероятно | адрес 0x160E9, данные 0x160E9 | code word CARB: lambda sensor aging tv" CURVE 0x160E9 RL_GRID_DU8 0 CM_IDENTITY 0 255
 /begin AXIS_DESCR FIX_AXIS NO_INPUT_QUANTITY CM_IDENTITY 4 0 3 FIX_AXIS_PAR_DIST 0 1 4 /end AXIS_DESCR
/end CHARACTERISTIC
/begin CHARACTERISTIC CDCLLR "вероятная | damos-вероятно | адрес 0x160F1, данные 0x160F1 | code word CARB: idle speed control at limit" CURVE 0x160F1 RL_GRID_DU8 0 CM_IDENTITY 0 255
 /begin AXIS_DESCR FIX_AXIS NO_INPUT_QUANTITY CM_IDENTITY 4 0 3 FIX_AXIS_PAR_DIST 0 1 4 /end AXIS_DESCR
/end CHARACTERISTIC
/begin CHARACTERISTIC CDCLM "вероятная | damos-вероятно | адрес 0x160F9, данные 0x160F9 | code word CARB: air flow sensor" CURVE 0x160F9 RL_GRID_DU8 0 CM_IDENTITY 0 255
 /begin AXIS_DESCR FIX_AXIS NO_INPUT_QUANTITY CM_IDENTITY 4 0 3 FIX_AXIS_PAR_DIST 0 1 4 /end AXIS_DESCR
/end CHARACTERISTIC
/begin CHARACTERISTIC CDCLSH "вероятная | damos-вероятно | адрес 0x16101, данные 0x16101 | code word CARB: lambda sensor downstream catalyst" CURVE 0x16101 RL_GRID_DU8 0 CM_IDENTITY 0 255
 /begin AXIS_DESCR FIX_AXIS NO_INPUT_QUANTITY CM_IDENTITY 4 0 3 FIX_AXIS_PAR_DIST 0 1 4 /end AXIS_DESCR
/end CHARACTERISTIC
/begin CHARACTERISTIC CDCLSV "вероятная | damos-вероятно | адрес 0x16109, данные 0x16109 | code word CARB: lambda sensor upstream cat" CURVE 0x16109 RL_GRID_DU8 0 CM_IDENTITY 0 255
 /begin AXIS_DESCR FIX_AXIS NO_INPUT_QUANTITY CM_IDENTITY 4 0 3 FIX_AXIS_PAR_DIST 0 1 4 /end AXIS_DESCR
/end CHARACTERISTIC
/begin CHARACTERISTIC CDCLUEA "вероятная | damos-вероятно | адрес 0x16111, данные 0x16111 | code word CARB: Power stage engine fan A" CURVE 0x16111 RL_GRID_DU8 0 CM_IDENTITY 0 255
 /begin AXIS_DESCR FIX_AXIS NO_INPUT_QUANTITY CM_IDENTITY 4 0 3 FIX_AXIS_PAR_DIST 0 1 4 /end AXIS_DESCR
/end CHARACTERISTIC
/begin CHARACTERISTIC MAP_303_1611B_4 "вероятная | mapscan | адрес 0x1611B, данные 0x16124" CURVE 0x1611B RL_2D_A16_DU16 0 CM_IDENTITY 0 65535 /begin AXIS_DESCR STD_AXIS NO_INPUT_QUANTITY CM_IDENTITY 4 0 65535 /end AXIS_DESCR /end CHARACTERISTIC
/begin CHARACTERISTIC CDCMD01 "вероятная | damos-вероятно | адрес 0x16131, данные 0x16131 | Code word CARB: misfire cyl. 1" CURVE 0x16131 RL_GRID_DU8 0 CM_IDENTITY 0 255
 /begin AXIS_DESCR FIX_AXIS NO_INPUT_QUANTITY CM_IDENTITY 4 0 3 FIX_AXIS_PAR_DIST 0 1 4 /end AXIS_DESCR
/end CHARACTERISTIC
/begin CHARACTERISTIC CDCMD02 "вероятная | damos-вероятно | адрес 0x16139, данные 0x16139 | Code word CARB: misfire cylinder 2" CURVE 0x16139 RL_GRID_DU8 0 CM_IDENTITY 0 255
 /begin AXIS_DESCR FIX_AXIS NO_INPUT_QUANTITY CM_IDENTITY 4 0 3 FIX_AXIS_PAR_DIST 0 1 4 /end AXIS_DESCR
/end CHARACTERISTIC
/begin CHARACTERISTIC CDCMD03 "вероятная | damos-вероятно | адрес 0x16141, данные 0x16141 | Code word CARB: misfire cylinder 3" CURVE 0x16141 RL_GRID_DU8 0 CM_IDENTITY 0 255
 /begin AXIS_DESCR FIX_AXIS NO_INPUT_QUANTITY CM_IDENTITY 4 0 3 FIX_AXIS_PAR_DIST 0 1 4 /end AXIS_DESCR
/end CHARACTERISTIC
/begin CHARACTERISTIC CDCMFA "вероятная | damos-вероятно | адрес 0x16149, данные 0x16149 | code word CARB: MIL not local fixed" CURVE 0x16149 RL_GRID_DU8 0 CM_IDENTITY 0 255
 /begin AXIS_DESCR FIX_AXIS NO_INPUT_QUANTITY CM_IDENTITY 4 0 3 FIX_AXIS_PAR_DIST 0 1 4 /end AXIS_DESCR
/end CHARACTERISTIC
/begin CHARACTERISTIC CDCMFB "вероятная | damos-вероятно | адрес 0x16151, данные 0x16151 | code word CARB: MIL external request" CURVE 0x16151 RL_GRID_DU8 0 CM_IDENTITY 0 255
 /begin AXIS_DESCR FIX_AXIS NO_INPUT_QUANTITY CM_IDENTITY 4 0 3 FIX_AXIS_PAR_DIST 0 1 4 /end AXIS_DESCR
/end CHARACTERISTIC
/begin CHARACTERISTIC MAP_309_16156_5 "вероятная | mapscan | адрес 0x16156, данные 0x1615C" CURVE 0x16156 RL_2D_A8_DU16 0 CM_IDENTITY 0 65535 /begin AXIS_DESCR STD_AXIS NO_INPUT_QUANTITY CM_IDENTITY 5 0 255 /end AXIS_DESCR /end CHARACTERISTIC
/begin CHARACTERISTIC CDCPH "вероятная | damos-вероятно | адрес 0x16169, данные 0x16169 | code word CARB: phase sensor" CURVE 0x16169 RL_GRID_DU8 0 CM_IDENTITY 0 255
 /begin AXIS_DESCR FIX_AXIS NO_INPUT_QUANTITY CM_IDENTITY 4 0 3 FIX_AXIS_PAR_DIST 0 1 4 /end AXIS_DESCR
/end CHARACTERISTIC
/begin CHARACTERISTIC CDCPUA "вероятная | damos-вероятно | адрес 0x16171, данные 0x16171 | Code word CARB: ambient pressure adaptation" CURVE 0x16171 RL_GRID_DU8 0 CM_IDENTITY 0 255
 /begin AXIS_DESCR FIX_AXIS NO_INPUT_QUANTITY CM_IDENTITY 4 0 3 FIX_AXIS_PAR_DIST 0 1 4 /end AXIS_DESCR
/end CHARACTERISTIC
/begin CHARACTERISTIC CDCRKAT "вероятная | damos-вероятно | адрес 0x16179, данные 0x16179 | code word CARB: additive adaptive mixture correction rkat" CURVE 0x16179 RL_GRID_DU8 0 CM_IDENTITY 0 255
 /begin AXIS_DESCR FIX_AXIS NO_INPUT_QUANTITY CM_IDENTITY 4 0 3 FIX_AXIS_PAR_DIST 0 1 4 /end AXIS_DESCR
/end CHARACTERISTIC
/begin CHARACTERISTIC CDCRKAZ "вероятная | damos-вероятно | адрес 0x16181, данные 0x16181 | code word CARB: additive adaptive mixture correction rkaz" CURVE 0x16181 RL_GRID_DU8 0 CM_IDENTITY 0 255
 /begin AXIS_DESCR FIX_AXIS NO_INPUT_QUANTITY CM_IDENTITY 4 0 3 FIX_AXIS_PAR_DIST 0 1 4 /end AXIS_DESCR
/end CHARACTERISTIC
/begin CHARACTERISTIC CDCSGROM "вероятная | damos-вероятно | адрес 0x16189, данные 0x16189 | code word CARB: control unit defective (ROM)" CURVE 0x16189 RL_GRID_DU8 0 CM_IDENTITY 0 255
 /begin AXIS_DESCR FIX_AXIS NO_INPUT_QUANTITY CM_IDENTITY 4 0 3 FIX_AXIS_PAR_DIST 0 1 4 /end AXIS_DESCR
/end CHARACTERISTIC
/begin CHARACTERISTIC CDCSWE "вероятная | damos-вероятно | адрес 0x16191, данные 0x16191 | code word CARB: acceleration sensor for rough surface detection" CURVE 0x16191 RL_GRID_DU8 0 CM_IDENTITY 0 255
 /begin AXIS_DESCR FIX_AXIS NO_INPUT_QUANTITY CM_IDENTITY 4 0 3 FIX_AXIS_PAR_DIST 0 1 4 /end AXIS_DESCR
/end CHARACTERISTIC
/begin CHARACTERISTIC CDCTA "вероятная | damos-вероятно | адрес 0x16199, данные 0x16199 | code word CARB: intake air temperature" CURVE 0x16199 RL_GRID_DU8 0 CM_IDENTITY 0 255
 /begin AXIS_DESCR FIX_AXIS NO_INPUT_QUANTITY CM_IDENTITY 4 0 3 FIX_AXIS_PAR_DIST 0 1 4 /end AXIS_DESCR
/end CHARACTERISTIC
/begin CHARACTERISTIC CDCTES "вероятная | damos-вероятно | адрес 0x161A1, данные 0x161A1 | code word CARB: canister purge system" CURVE 0x161A1 RL_GRID_DU8 0 CM_IDENTITY 0 255
 /begin AXIS_DESCR FIX_AXIS NO_INPUT_QUANTITY CM_IDENTITY 4 0 3 FIX_AXIS_PAR_DIST 0 1 4 /end AXIS_DESCR
/end CHARACTERISTIC
/begin CHARACTERISTIC CDCTEVE "вероятная | damos-вероятно | адрес 0x161A9, данные 0x161A9 | code word CARB: canister purge valve power stage" CURVE 0x161A9 RL_GRID_DU8 0 CM_IDENTITY 0 255
 /begin AXIS_DESCR FIX_AXIS NO_INPUT_QUANTITY CM_IDENTITY 4 0 3 FIX_AXIS_PAR_DIST 0 1 4 /end AXIS_DESCR
/end CHARACTERISTIC
/begin CHARACTERISTIC CDCTHM "вероятная | damos-вероятно | адрес 0x161B1, данные 0x161B1 | code word CARB: engine thermostat monitoring THM" CURVE 0x161B1 RL_GRID_DU8 0 CM_IDENTITY 0 255
 /begin AXIS_DESCR FIX_AXIS NO_INPUT_QUANTITY CM_IDENTITY 4 0 3 FIX_AXIS_PAR_DIST 0 1 4 /end AXIS_DESCR
/end CHARACTERISTIC
/begin CHARACTERISTIC CDCTM "вероятная | damos-вероятно | адрес 0x161B9, данные 0x161B9 | code word CARB: engine coolant temperature TMOT" CURVE 0x161B9 RL_GRID_DU8 0 CM_IDENTITY 0 255
 /begin AXIS_DESCR FIX_AXIS NO_INPUT_QUANTITY CM_IDENTITY 4 0 3 FIX_AXIS_PAR_DIST 0 1 4 /end AXIS_DESCR
/end CHARACTERISTIC
/begin CHARACTERISTIC CDCUB "вероятная | damos-вероятно | адрес 0x161C1, данные 0x161C1 | code word CARB: battery voltage UB (onboard)" CURVE 0x161C1 RL_GRID_DU8 0 CM_IDENTITY 0 255
 /begin AXIS_DESCR FIX_AXIS NO_INPUT_QUANTITY CM_IDENTITY 4 0 3 FIX_AXIS_PAR_DIST 0 1 4 /end AXIS_DESCR
/end CHARACTERISTIC
/begin CHARACTERISTIC CDCVFZ "вероятная | damos-вероятно | адрес 0x161C9, данные 0x161C9 | code word CARB: vehicle speed signal" CURVE 0x161C9 RL_GRID_DU8 0 CM_IDENTITY 0 255
 /begin AXIS_DESCR FIX_AXIS NO_INPUT_QUANTITY CM_IDENTITY 4 0 3 FIX_AXIS_PAR_DIST 0 1 4 /end AXIS_DESCR
/end CHARACTERISTIC
/begin CHARACTERISTIC CDCZOE "вероятная | damos-вероятно | адрес 0x161D1, данные 0x161D1 | code word CARB: idle speed actuator opening" CURVE 0x161D1 RL_GRID_DU8 0 CM_IDENTITY 0 255
 /begin AXIS_DESCR FIX_AXIS NO_INPUT_QUANTITY CM_IDENTITY 4 0 3 FIX_AXIS_PAR_DIST 0 1 4 /end AXIS_DESCR
/end CHARACTERISTIC
/begin CHARACTERISTIC CDCZSE "вероятная | damos-вероятно | адрес 0x161D9, данные 0x161D9 | code word CARB: idle speed actuator closing" CURVE 0x161D9 RL_GRID_DU8 0 CM_IDENTITY 0 255
 /begin AXIS_DESCR FIX_AXIS NO_INPUT_QUANTITY CM_IDENTITY 4 0 3 FIX_AXIS_PAR_DIST 0 1 4 /end AXIS_DESCR
/end CHARACTERISTIC
/begin CHARACTERISTIC CDCZZZ "вероятная | damos-вероятно | адрес 0x161E1, данные 0x161E1 | Dummy: end of table" CURVE 0x161E1 RL_GRID_DU8 0 CM_IDENTITY 0 255
 /begin AXIS_DESCR FIX_AXIS NO_INPUT_QUANTITY CM_IDENTITY 4 0 3 FIX_AXIS_PAR_DIST 0 1 4 /end AXIS_DESCR
/end CHARACTERISTIC
/begin CHARACTERISTIC GRID_326_1637C_16x7 "вероятная | gridscan | адрес 0x1637C, данные 0x1637C" MAP 0x1637C RL_GRID_DU8 0 CM_IDENTITY 0 255
 /begin AXIS_DESCR FIX_AXIS NO_INPUT_QUANTITY CM_IDENTITY 16 0 15 FIX_AXIS_PAR_DIST 0 1 16 /end AXIS_DESCR
 /begin AXIS_DESCR FIX_AXIS NO_INPUT_QUANTITY CM_IDENTITY 7 0 6 FIX_AXIS_PAR_DIST 0 1 7 /end AXIS_DESCR
/end CHARACTERISTIC
/begin CHARACTERISTIC NNSTA "подтверждена | damos | адрес 0x18195, данные 0x18195 | масштаб x40 Upm | engine-speed transition normal -> start" CURVE 0x18195 RL_GRID_DU8 0 CM_40_0_Upm 0 255
 /begin AXIS_DESCR FIX_AXIS NO_INPUT_QUANTITY CM_IDENTITY 3 0 2 FIX_AXIS_PAR_DIST 0 1 3 /end AXIS_DESCR
/end CHARACTERISTIC
/begin CHARACTERISTIC NSTNM "подтверждена | damos | адрес 0x1819C, данные 0x1819C | масштаб x40 Upm | transition start -> normal" CURVE 0x1819C RL_GRID_DU8 0 CM_40_0_Upm 0 255
 /begin AXIS_DESCR FIX_AXIS NO_INPUT_QUANTITY CM_IDENTITY 3 0 2 FIX_AXIS_PAR_DIST 0 1 3 /end AXIS_DESCR
/end CHARACTERISTIC
/begin CHARACTERISTIC SDK10TEUB "подтверждена | damos | адрес 0x181A2, данные 0x181A2 | wdkba dependet basic point (number 10)" CURVE 0x181A2 RL_GRID_DU8 0 CM_IDENTITY 0 255
 /begin AXIS_DESCR FIX_AXIS NO_INPUT_QUANTITY CM_IDENTITY 10 0 9 FIX_AXIS_PAR_DIST 0 1 10 /end AXIS_DESCR
/end CHARACTERISTIC
/begin CHARACTERISTIC SEZ06TMUB "подтверждена | damos | адрес 0x181AD, данные 0x181AD | Datapoint distribution of ignition timing efficiency" CURVE 0x181AD RL_GRID_DU8 0 CM_IDENTITY 0 255
 /begin AXIS_DESCR FIX_AXIS NO_INPUT_QUANTITY CM_IDENTITY 6 0 5 FIX_AXIS_PAR_DIST 0 1 6 /end AXIS_DESCR
/end CHARACTERISTIC
/begin CHARACTERISTIC SFR05TEUB "подтверждена | damos | адрес 0x181B4, данные 0x181B4 | frmit dependet basic point (number 5)" CURVE 0x181B4 RL_GRID_DU8 0 CM_IDENTITY 0 255
 /begin AXIS_DESCR FIX_AXIS NO_INPUT_QUANTITY CM_IDENTITY 5 0 4 FIX_AXIS_PAR_DIST 0 1 5 /end AXIS_DESCR
/end CHARACTERISTIC
/begin CHARACTERISTIC SGA06MFUB "подтверждена | damos | адрес 0x181BA, данные 0x181BA" CURVE 0x181BA RL_GRID_DU8 0 CM_IDENTITY 0 255
 /begin AXIS_DESCR FIX_AXIS NO_INPUT_QUANTITY CM_IDENTITY 6 0 5 FIX_AXIS_PAR_DIST 0 1 6 /end AXIS_DESCR
/end CHARACTERISTIC
/begin CHARACTERISTIC SKS06ESUB "подтверждена | damos | адрес 0x181C1, данные 0x181C1 | Distribution for the start adaption factor kstaa" CURVE 0x181C1 RL_GRID_DU8 0 CM_IDENTITY 0 255
 /begin AXIS_DESCR FIX_AXIS NO_INPUT_QUANTITY CM_IDENTITY 6 0 5 FIX_AXIS_PAR_DIST 0 1 6 /end AXIS_DESCR
/end CHARACTERISTIC
/begin CHARACTERISTIC SML06TEUB "подтверждена | damos | адрес 0x181C8, данные 0x181C8 | ml dependet basic point (number 6)" CURVE 0x181C8 RL_GRID_DU8 0 CM_IDENTITY 0 255
 /begin AXIS_DESCR FIX_AXIS NO_INPUT_QUANTITY CM_IDENTITY 6 0 5 FIX_AXIS_PAR_DIST 0 1 6 /end AXIS_DESCR
/end CHARACTERISTIC
/begin CHARACTERISTIC SML06TMUB "подтверждена | damos | адрес 0x181CF, данные 0x181CF | ml dependet basic point (number 6)" CURVE 0x181CF RL_GRID_DU8 0 CM_IDENTITY 0 255
 /begin AXIS_DESCR FIX_AXIS NO_INPUT_QUANTITY CM_IDENTITY 6 0 5 FIX_AXIS_PAR_DIST 0 1 6 /end AXIS_DESCR
/end CHARACTERISTIC
/begin CHARACTERISTIC SNM06LHUB "подтверждена | damos | адрес 0x181D6, данные 0x181D6" CURVE 0x181D6 RL_GRID_DU8 0 CM_IDENTITY 0 255
 /begin AXIS_DESCR FIX_AXIS NO_INPUT_QUANTITY CM_IDENTITY 6 0 5 FIX_AXIS_PAR_DIST 0 1 6 /end AXIS_DESCR
/end CHARACTERISTIC
/begin CHARACTERISTIC SNM06MFUB "подтверждена | damos | адрес 0x181DD, данные 0x181DD" CURVE 0x181DD RL_GRID_DU8 0 CM_IDENTITY 0 255
 /begin AXIS_DESCR FIX_AXIS NO_INPUT_QUANTITY CM_IDENTITY 6 0 5 FIX_AXIS_PAR_DIST 0 1 6 /end AXIS_DESCR
/end CHARACTERISTIC
/begin CHARACTERISTIC SNM07ESUB "подтверждена | damos | адрес 0x181E4, данные 0x181E4 | Base point distribution of engine speed, 7 base pts." CURVE 0x181E4 RL_GRID_DU8 0 CM_IDENTITY 0 255
 /begin AXIS_DESCR FIX_AXIS NO_INPUT_QUANTITY CM_IDENTITY 7 0 6 FIX_AXIS_PAR_DIST 0 1 7 /end AXIS_DESCR
/end CHARACTERISTIC
/begin CHARACTERISTIC SNM10TEUB "подтверждена | damos | адрес 0x181EC, данные 0x181EC | nmot dependet basic point (number 10)" CURVE 0x181EC RL_GRID_DU8 0 CM_IDENTITY 0 255
 /begin AXIS_DESCR FIX_AXIS NO_INPUT_QUANTITY CM_IDENTITY 10 0 9 FIX_AXIS_PAR_DIST 0 1 10 /end AXIS_DESCR
/end CHARACTERISTIC
/end MODULE
/end PROJECT
